## CMakeLists.txt
```
cmake_minimum_required(VERSION 3.20.0)

find_package(Zephyr REQUIRED HINTS $ENV{ZEPHYR_BASE})
project(gateway_ethernet)

target_include_directories(app PRIVATE
    ${CMAKE_CURRENT_SOURCE_DIR}/src
    ${CMAKE_CURRENT_SOURCE_DIR}/../common/include
)

target_sources(app PRIVATE
    src/main.c
    src/ethernet.c
    ../common/src/azure_mqtt.c
    ../common/src/bluetooth.c
    ../common/src/my_json.c
    ../common/src/sntp_sync.c
    ../common/src/time_sync_writer.c
    ../common/src/http_time_sync.c
)
```

## Kconfig
```
mainmenu "Gateway Ethernet Configuration"

source "Kconfig.zephyr"

config ETH_GATEWAY
    bool "Use Ethernet (ESP32-POE) instead of WiFi"
    default y
```

## prj.conf
```kconfig
# –– Core ––
CONFIG_INIT_STACKS=y
CONFIG_MAIN_STACK_SIZE=2048
CONFIG_SYSTEM_WORKQUEUE_STACK_SIZE=1536
CONFIG_PRINTK=y
CONFIG_CBPRINTF_FP_SUPPORT=y

# –– Logging ––
CONFIG_LOG=y
CONFIG_LOG_DEFAULT_LEVEL=3
CONFIG_LOG_MODE_DEFERRED=y
CONFIG_LOG_BUFFER_SIZE=2048
CONFIG_LOG_BACKEND_UART=y
CONFIG_SHELL=n
CONFIG_SHELL_LOG_BACKEND=n

# –– JSON / UUID ––
CONFIG_JSON_LIBRARY=y
CONFIG_UUID=y
CONFIG_UUID_V4=y

# –– Peripherals ––
CONFIG_GPIO=y
CONFIG_I2C=y
CONFIG_SENSOR=y

# –– Bluetooth Central (GATT client) ––
CONFIG_BT=y
CONFIG_BT_CENTRAL=y
CONFIG_BT_PERIPHERAL=n
CONFIG_BT_GATT_CLIENT=y
CONFIG_BT_MAX_CONN=3
CONFIG_BT_MAX_PAIRED=0
# ACL buffer sizes — must match or exceed sensor side (251)
CONFIG_BT_BUF_ACL_RX_SIZE=251
CONFIG_BT_BUF_ACL_TX_SIZE=251
# L2CAP TX MTU — must be ≥ 238 bytes + 4 byte L2CAP header = 242, set to 244
CONFIG_BT_L2CAP_TX_MTU=247
# Increases TX buffer count to handle back-to-back notifications without drops
CONFIG_BT_L2CAP_TX_BUF_COUNT=12

# Increases buffers for multi BLE connections and SD Draining
CONFIG_BT_ATT_TX_COUNT=12
CONFIG_BT_BUF_ACL_TX_COUNT=6
CONFIG_BT_BUF_EVT_RX_COUNT=7
CONFIG_BT_BUF_ACL_RX_COUNT_EXTRA=7

# –– Networking Core ––
CONFIG_NETWORKING=y
CONFIG_NET_MGMT=y
CONFIG_NET_MGMT_EVENT=y
CONFIG_NET_MGMT_EVENT_INFO=y
CONFIG_NET_CONFIG_AUTO_INIT=n
CONFIG_NET_CONFIG_SETTINGS=n

# –– Ethernet ––
CONFIG_NET_L2_ETHERNET=y
CONFIG_ETH_DRIVER=y
CONFIG_ETH_ESP32=y

# –– IP / DHCP / Sockets ––
CONFIG_NET_IPV4=y
CONFIG_NET_IPV6=n
CONFIG_NET_DHCPV4=y
CONFIG_NET_TCP=y
CONFIG_NET_SOCKETS=y
CONFIG_POSIX_API=y

# –– DNS ––
CONFIG_DNS_RESOLVER=y
CONFIG_DNS_RESOLVER_AI_MAX_ENTRIES=2

# –– MQTT (plaintext — no TLS) ––
CONFIG_MQTT_LIB=y
CONFIG_MQTT_LIB_TLS=n
CONFIG_MQTT_KEEPALIVE=10

# –– Network Buffers ––
CONFIG_NET_TX_STACK_SIZE=1536
CONFIG_NET_RX_STACK_SIZE=1536
CONFIG_NET_MAX_CONTEXTS=6
CONFIG_NET_PKT_RX_COUNT=12
CONFIG_NET_PKT_TX_COUNT=8
CONFIG_NET_BUF_RX_COUNT=24
CONFIG_NET_BUF_TX_COUNT=16
CONFIG_NET_BUF_DATA_SIZE=512

# # –– SNTP ––
# CONFIG_SNTP=y

# –– ESP32 memory ––
CONFIG_ESP32_REGION_1_NOINIT=y

# Enables Gateway config (need to merge the WIFI and ETHERNET main.c files again)
CONFIG_ETH_GATEWAY=y

CONFIG_NET_UDP=y

CONFIG_REBOOT=y
```

## src/main.c
```c
/*
 * main.c — Combined BLE Central + Network + Azure IoT Hub Gateway
 *   CONFIG_ETH_GATEWAY=y   →  ESP32-POE
 *   CONFIG_ETH_GATEWAY=n   →  ESP32-WROVER (WiFi)
 */

#include <zephyr/kernel.h>
#include <zephyr/logging/log.h>

#include "azure_mqtt.h"
#include "bluetooth.h"
// #include "sntp_sync.h"
#include "http_time_sync.h"

#if defined(CONFIG_ETH_GATEWAY)
#  include "ethernet.h"
#  define NET_THREAD_STACK   2048
#  define NET_THREAD_FN      ethernet_thread
#  define GATEWAY_BOARD_STR  "ESP32-POE"
#else
#  include "wifi.h"
#  define NET_THREAD_STACK   4096
#  define NET_THREAD_FN      wifi_thread
#  define GATEWAY_BOARD_STR  "ESP32-WROVER"
#endif

#define NET_THREAD_PRIO  4

LOG_MODULE_REGISTER(main, LOG_LEVEL_INF);

K_THREAD_STACK_DEFINE(net_stack, NET_THREAD_STACK);
static struct k_thread net_tid;

/*
 * BLE threads — delay 5s so the network + Azure MQTT are fully up
 * before BLE starts trying to publish.
 */
K_THREAD_DEFINE(process_data_tid,
                BASE_PROCESS_STACK_SIZE,
                process_data_thread,
                NULL, NULL, NULL,
                BASE_PROCESS_PRIORITY, 0,
                5000);

K_THREAD_DEFINE(base_tid,
                BASE_CONTROL_STACK_SIZE,
                base_thread,
                NULL, NULL, NULL,
                BASE_CONTROL_PRIORITY, 0,
                5000);

int main(void) {
    LOG_INF("=== Combined BLE+Network Gateway starting (%s) ===",
            GATEWAY_BOARD_STR);

    /*
     * Start the network thread and block until it returns.
     * It only returns after a DHCP lease is obtained.
     */
    k_thread_create(&net_tid,
                    net_stack,
                    K_THREAD_STACK_SIZEOF(net_stack),
                    (k_thread_entry_t)NET_THREAD_FN,
                    NULL, NULL, NULL,
                    NET_THREAD_PRIO, 0, K_NO_WAIT);
    k_thread_name_set(&net_tid, "net");
    // k_thread_join(&net_tid, K_FOREVER);   /* block until IP obtained */
    ethernet_wait_ready(K_FOREVER);
    
    LOG_INF("Network ready — starting Azure MQTT");
    azure_mqtt_thread_start();

    /* Gives MQTT a moment before SNTP tries DNS */
    k_sleep(K_SECONDS(3));

    LOG_INF("Starting SNTP sync");
    // sntp_sync_start();
    http_time_sync_start();
    // http_time_sync_start();
    LOG_INF("Boot complete — BLE threads will start in ~15s");

    return 0;
}
```

## src/ethernet.c
```c
#include "ethernet.h"

#include <zephyr/kernel.h>
#include <zephyr/logging/log.h>
#include <zephyr/net/net_if.h>
#include <zephyr/net/net_event.h>
#include <zephyr/net/net_mgmt.h>
#include <zephyr/net/dhcpv4.h>
#include <zephyr/net/net_ip.h>
#include <zephyr/net/ethernet.h>

LOG_MODULE_REGISTER(ethernet, LOG_LEVEL_INF);

/* Signalled from the event handler when the link drops or the
 * IPv4 address is removed.*/
static K_SEM_DEFINE(eth_lost_sem, 0, 1);

static K_SEM_DEFINE(eth_ready_sem, 0, 1);
static volatile bool eth_ready_flag;

/* Cached IP for logging */
static char ip_addr_str[NET_IPV4_ADDR_LEN];

/* ── Net-mgmt event mask ────────────────────────────────── */
#define ETH_EVENTS  (NET_EVENT_IF_UP            | \
                     NET_EVENT_IF_DOWN          | \
                     NET_EVENT_IPV4_ADDR_ADD    | \
                     NET_EVENT_IPV4_ADDR_DEL)

static struct net_mgmt_event_callback eth_cb;

/**
 * @brief Net-mgmt event handler for Ethernet link and IPv4 events.
 *
 * Logs link state changes. On IF_DOWN or IPV4_ADDR_DEL, clears the
 * ready flag and signals the watchdog loop via eth_lost_sem.
 */
static void eth_event_handler(struct net_mgmt_event_callback *cb,
                              uint64_t event,
                              struct net_if *iface) {
    switch (event) {

    case NET_EVENT_IF_UP:
        LOG_INF("Ethernet event: IF_UP");
        break;

    case NET_EVENT_IF_DOWN:
        LOG_WRN("Ethernet event: IF_DOWN");
        eth_ready_flag = false;
        k_sem_reset(&eth_ready_sem);
        k_sem_give(&eth_lost_sem);
        break;

    case NET_EVENT_IPV4_ADDR_ADD: {
        struct net_if_ipv4 *ipv4 = iface->config.ip.ipv4;
        if (ipv4) {
            net_addr_ntop(AF_INET,
                          &ipv4->unicast[0].ipv4.address.in_addr,
                          ip_addr_str, sizeof(ip_addr_str));
            LOG_INF("Ethernet event: IPV4_ADDR_ADD %s", ip_addr_str);
        }
        break;
    }

    case NET_EVENT_IPV4_ADDR_DEL:
        LOG_WRN("Ethernet event: IPV4_ADDR_DEL");
        eth_ready_flag = false;
        k_sem_reset(&eth_ready_sem);
        k_sem_give(&eth_lost_sem);
        break;

    default:
        break;
    }
}

static struct net_if *carrier_poll_iface;

/**
 * @brief Background thread polling the interface operational state.
 *
 * Checks the link every 2 s and signals eth_lost_sem on an up-to-down
 * transition; acting as a fallback for missed net-mgmt events.
 */
static void carrier_poll_thread(void *a, void *b, void *c) {
    ARG_UNUSED(a); ARG_UNUSED(b); ARG_UNUSED(c);

    bool was_up = true;

    while (true) {
        k_sleep(K_SECONDS(2));

        if (!carrier_poll_iface) {
            continue;
        }

        bool is_up = net_if_is_up(carrier_poll_iface) &&
                     net_if_oper_state(carrier_poll_iface) == NET_IF_OPER_UP;

        if (was_up && !is_up) {
            LOG_WRN("Carrier poll: link lost (oper_state changed)");
            eth_ready_flag = false;
            k_sem_reset(&eth_ready_sem);
            k_sem_give(&eth_lost_sem);
        }

        was_up = is_up;
    }
}

K_THREAD_DEFINE(carrier_poll_tid, 1024, carrier_poll_thread,
                NULL, NULL, NULL, 10, 0, 0);

/* ── Acquisition routine ──*/

/**
 * @brief Start DHCP on the interface and block until a lease is held.
 *
 * Polls every 3 s for a non-zero IPv4 address, then logs the IP,
 * gateway, and netmask, sets the ready flag, and wakes waiters on
 * eth_ready_sem.
 */
static void dhcp_acquire(struct net_if *iface) {
    net_dhcpv4_start(iface);
    LOG_INF("DHCP started — polling for lease...");

    while (true) {
        struct net_if_ipv4 *ipv4 = iface->config.ip.ipv4;
        if (ipv4 && ipv4->unicast[0].ipv4.address.in_addr.s_addr != 0) {
            char gw_str[NET_IPV4_ADDR_LEN];
            char nm_str[NET_IPV4_ADDR_LEN];
            net_addr_ntop(AF_INET,
                          &ipv4->unicast[0].ipv4.address.in_addr,
                          ip_addr_str, sizeof(ip_addr_str));
            net_addr_ntop(AF_INET, &ipv4->gw,
                          gw_str, sizeof(gw_str));
            net_addr_ntop(AF_INET,
                          &ipv4->unicast[0].netmask,
                          nm_str, sizeof(nm_str));
            LOG_INF("Ethernet ready — IP: %s  GW: %s  NM: %s",
                    ip_addr_str, gw_str, nm_str);

            /* Mark ready and wake any threads waiting in
             * ethernet_wait_ready()*/
            eth_ready_flag = true;
            k_sem_give(&eth_ready_sem);
            return;
        }
        LOG_INF("DHCP state: %d  IP: none",
                iface->config.dhcpv4.state);
        k_sleep(K_SECONDS(3));
    }
}


/**
 * @brief Block until Ethernet has an IPv4 address or the timeout expires.
 *
 * @param timeout Maximum time to wait.
 * @return true if Ethernet is ready, false on timeout.
 */
bool ethernet_wait_ready(k_timeout_t timeout) {
    if (eth_ready_flag) {
        return true;
    }

    int ret = k_sem_take(&eth_ready_sem, timeout);
    if (ret != 0) {
        return false;
    }

    /* Re-arm so the next waiter also unblocks. The flag is the
     * authoritative state; the semaphore is just a wakeup. */
    k_sem_give(&eth_ready_sem);
    return eth_ready_flag;
}

/**
 * @brief Gets Ethernet readiness flag
 *
 * @return true if the interface currently holds an IPv4 address.
 */
bool ethernet_is_ready(void) {
    return eth_ready_flag;
}

/**
 * @brief Main Ethernet management thread.
 *
 * Registers event callbacks, brings the interface up, performs the
 * initial DHCP acquisition, then loops as a watchdog: on connectivity
 * loss, waits for the link to return and re-acquires DHCP.
 */
void ethernet_thread(void) {

    LOG_INF("ethernet_thread: starting (watchdog + carrier poll)");

    net_mgmt_init_event_callback(&eth_cb, eth_event_handler, ETH_EVENTS);
    net_mgmt_add_event_callback(&eth_cb);

    struct net_if *iface = net_if_get_first_by_type(&NET_L2_GET_NAME(ETHERNET));
    if (!iface) {
        LOG_ERR("No Ethernet interface found");
        while (true) { k_sleep(K_SECONDS(5)); }
    }

    net_if_up(iface);
    k_sleep(K_SECONDS(2));

    /* Hand the iface to the carrier-poll thread. */
    carrier_poll_iface = iface;

    /* First acquisition*/
    dhcp_acquire(iface);

    /* ── Watchdog loop ────────────────────────────────────*/
    while (true) {
        k_sem_reset(&eth_lost_sem);
        k_sem_take(&eth_lost_sem, K_FOREVER);

        LOG_WRN("Connectivity lost — waiting for link to return...");
        eth_ready_flag = false;

        while (net_if_oper_state(iface) != NET_IF_OPER_UP) {
            k_sleep(K_SECONDS(1));
        }

        /* Settle delay */
        k_sleep(K_SECONDS(2));

        LOG_INF("Link returned — re-acquiring DHCP");
        dhcp_acquire(iface);
    }
}
```

## src/ethernet.h
```c
#ifndef ETHERNET_H_
#define ETHERNET_H_

#include <stdbool.h>
#include <zephyr/kernel.h>

#define ETH_DHCP_RETRY_COUNT  0

/**
 * @brief Main Ethernet management thread.
 *
 * Registers event callbacks, brings the interface up, performs the
 * initial DHCP acquisition, then loops as a watchdog: on connectivity
 * loss, waits for the link to return and re-acquires DHCP.
 */
void ethernet_thread(void);

/**
 * @brief Block until Ethernet has an IPv4 address or the timeout expires.
 *
 * @param timeout Maximum time to wait.
 * @return true if Ethernet is ready, false on timeout.
 */
bool ethernet_wait_ready(k_timeout_t timeout);

/**
 * @brief Gets Ethernet readiness flag
 *
 * @return true if the interface currently holds an IPv4 address.
 */
bool ethernet_is_ready(void);

#endif /* ETHERNET_H_ */
```
