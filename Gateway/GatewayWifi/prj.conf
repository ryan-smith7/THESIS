## CMakeLists.txt
```
cmake_minimum_required(VERSION 3.20.0)

find_package(Zephyr REQUIRED HINTS $ENV{ZEPHYR_BASE})
project(gateway_wifi)

target_include_directories(app PRIVATE
    ${CMAKE_CURRENT_SOURCE_DIR}/src
    ${CMAKE_CURRENT_SOURCE_DIR}/../common/include
)

target_sources(app PRIVATE
    src/main.c
    src/wifi.c
    ../common/src/azure_mqtt.c
    ../common/src/bluetooth.c
    ../common/src/my_json.c
    ../common/src/sntp_sync.c
    ../common/src/time_sync_writer.c
    ../common/src/http_time_sync.c
)
```

## prj.conf
```kconfig
# –– Core ––
CONFIG_INIT_STACKS=y
CONFIG_MAIN_STACK_SIZE=1024
CONFIG_SYSTEM_WORKQUEUE_STACK_SIZE=1536
CONFIG_PRINTK=y
CONFIG_CBPRINTF_FP_SUPPORT=y

# –– Logging ––
CONFIG_LOG=y
CONFIG_LOG_DEFAULT_LEVEL=3
CONFIG_LOG_MODE_DEFERRED=n
CONFIG_LOG_BUFFER_SIZE=256
# CONFIG_LOG_MODE_IMMEDIATE=y
CONFIG_LOG_BACKEND_UART=y
CONFIG_SHELL=n
CONFIG_SHELL_LOG_BACKEND=n

# –– JSON ––
CONFIG_JSON_LIBRARY=y

# –– UUID ––
CONFIG_UUID=y
CONFIG_UUID_V4=y

# –– Peripherals ––
CONFIG_GPIO=y
CONFIG_I2C=y
CONFIG_SENSOR=y

# –– Bluetooth Central (GATT client) ––

CONFIG_BT=y
CONFIG_BT_CENTRAL=y
CONFIG_BT_PERIPHERAL=n
CONFIG_BT_GATT_CLIENT=y
CONFIG_BT_MAX_CONN=3

# ACL buffer sizes — must match or exceed sensor side (251)
CONFIG_BT_BUF_ACL_RX_SIZE=251
CONFIG_BT_BUF_ACL_TX_SIZE=251
# L2CAP TX MTU — must be ≥ 238 bytes + 4 byte L2CAP header = 242, set to 244
CONFIG_BT_L2CAP_TX_MTU=247
# Increase TX buffer count to handle back-to-back notifications without drops
CONFIG_BT_L2CAP_TX_BUF_COUNT=12
CONFIG_BT_ATT_TX_COUNT=12

# Increases buffers for multi BLE connections and SD Draining
CONFIG_BT_BUF_ACL_TX_COUNT=6
CONFIG_BT_BUF_EVT_RX_COUNT=7
CONFIG_BT_BUF_ACL_RX_COUNT_EXTRA=7

# –– Networking Core ––
CONFIG_NETWORKING=y
CONFIG_NET_MGMT=y
CONFIG_NET_MGMT_EVENT=y
CONFIG_NET_MGMT_EVENT_INFO=y
CONFIG_NET_CONFIG_AUTO_INIT=y
CONFIG_NET_CONFIG_SETTINGS=y
CONFIG_NET_CONFIG_INIT_TIMEOUT=0

# –– WiFi ––
CONFIG_WIFI=y
CONFIG_WIFI_ESP32=y
CONFIG_NET_L2_WIFI_MGMT=y
# Dual-heap routes WiFi management allocs to PSRAM

# CONFIG_ESP_WIFI_HEAP_SPIRAM=y
CONFIG_ESP32_WIFI_NET_ALLOC_SPIRAM=y

# –– ESP32 WiFi internal buffer sizing ––
CONFIG_ESP32_WIFI_RX_BA_WIN=16

# –– IP (IPv4 only) ––
CONFIG_NET_IPV4=y
CONFIG_NET_IPV6=n
CONFIG_NET_ARP=y

# –– DHCP ––
CONFIG_NET_DHCPV4=y

# –– Sockets ––
CONFIG_NET_TCP=y
CONFIG_NET_SOCKETS=y
CONFIG_POSIX_API=y

# –– DNS ––
CONFIG_DNS_RESOLVER=y
CONFIG_DNS_RESOLVER_AI_MAX_ENTRIES=2

# –– MQTT ––
CONFIG_MQTT_LIB=y
CONFIG_MQTT_LIB_TLS=n
CONFIG_MQTT_KEEPALIVE=10


# –– TLS / MbedTLS ––

# –– Network Buffers ––
# 128-byte data size keeps net_buf allocations small enough to stay in DRAM.
CONFIG_NET_TX_STACK_SIZE=1536
CONFIG_NET_RX_STACK_SIZE=1536
CONFIG_NET_MAX_CONTEXTS=6
CONFIG_NET_PKT_RX_COUNT=12
CONFIG_NET_PKT_TX_COUNT=8
CONFIG_NET_BUF_RX_COUNT=24
CONFIG_NET_BUF_TX_COUNT=16
CONFIG_NET_BUF_DATA_SIZE=512

# –– Heap ––
# 16KB DRAM anchor for early boot and general Zephyr allocations.
CONFIG_HEAP_MEM_POOL_SIZE=16384

# –– SNTP ––
# CONFIG_SNTP=y

# –– PSRAM ––
# Skip memtest to reduce boot time — saves ~1 second which previously
CONFIG_ESP_SPIRAM=y

CONFIG_NET_UDP=y

CONFIG_REBOOT=y
```

## src/main.c
```c
/*
 * main.c — Combined BLE Central + Network + Azure IoT Hub Gateway
 *   CONFIG_ETH_GATEWAY=y   →  ESP32-POE
 *   CONFIG_ETH_GATEWAY=n   →  ESP32-WROVER (WiFi)
 */

#include <zephyr/kernel.h>
#include <zephyr/logging/log.h>

#include "azure_mqtt.h"
#include "bluetooth.h"
// #include "sntp_sync.h"
#include "http_time_sync.h"

#if defined(CONFIG_ETH_GATEWAY)
#  include "ethernet.h"
#  define NET_THREAD_STACK   2048
#  define NET_THREAD_FN      ethernet_thread
#  define GATEWAY_BOARD_STR  "ESP32-POE"
#else
#  include "wifi.h"
#  define NET_THREAD_STACK   4096
#  define NET_THREAD_FN      wifi_thread
#  define GATEWAY_BOARD_STR  "ESP32-WROVER"
#endif

#define NET_THREAD_PRIO  4

LOG_MODULE_REGISTER(main, LOG_LEVEL_INF);

K_THREAD_STACK_DEFINE(net_stack, NET_THREAD_STACK);
static struct k_thread net_tid;

/*
 * BLE threads — delay 5s so the network + Azure MQTT are fully up
 * before BLE starts trying to publish.
 */
K_THREAD_DEFINE(process_data_tid,
                BASE_PROCESS_STACK_SIZE,
                process_data_thread,
                NULL, NULL, NULL,
                BASE_PROCESS_PRIORITY, 0,
                5000);

K_THREAD_DEFINE(base_tid,
                BASE_CONTROL_STACK_SIZE,
                base_thread,
                NULL, NULL, NULL,
                BASE_CONTROL_PRIORITY, 0,
                5000);

int main(void) {
    LOG_INF("=== Combined BLE+Network Gateway starting (%s) ===",
            GATEWAY_BOARD_STR);

    /*
     * Start the network thread and block until it returns.
     * It only returns after a DHCP lease is obtained.
     */
    k_thread_create(&net_tid,
                    net_stack,
                    K_THREAD_STACK_SIZEOF(net_stack),
                    (k_thread_entry_t)NET_THREAD_FN,
                    NULL, NULL, NULL,
                    NET_THREAD_PRIO, 0, K_NO_WAIT);
    k_thread_name_set(&net_tid, "net");
    k_thread_join(&net_tid, K_FOREVER);   /* block until IP obtained */

    LOG_INF("Network ready — starting Azure MQTT");
    azure_mqtt_thread_start();

    /* Gives MQTT a moment before SNTP tries DNS */
    k_sleep(K_SECONDS(3));

    LOG_INF("Starting SNTP sync");
    // sntp_sync_start();
    http_time_sync_start();

    LOG_INF("Boot complete — BLE threads will start in ~15s");

    return 0;
}
```

## src/wifi.c
```c
#include <zephyr/kernel.h>
#include <zephyr/net/net_if.h>
#include <zephyr/net/wifi_mgmt.h>
#include <zephyr/net/net_event.h>
#include <zephyr/logging/log.h>
#include <zephyr/net/dns_resolve.h>
#include <wifi.h>
#include <env.h>

char wifi_ssid[MAX_SSID_LEN] = CONFIG_WIFI_DEFAULT_SSID;
char wifi_psk [MAX_PSK_LEN]  = CONFIG_WIFI_DEFAULT_PSK;

K_MUTEX_DEFINE(wifi_retry_mutex);

static uint8_t wifi_connection_retry_count = 0;

static K_SEM_DEFINE(wifi_connected, 0, 1);
static K_SEM_DEFINE(ipv4_address_obtained, 0, 1);

static bool got_ipv4 = false;

static struct net_mgmt_event_callback wifi_cb;
static struct net_mgmt_event_callback ipv4_cb;
static struct net_mgmt_event_callback l4_cb;
static struct net_mgmt_event_callback scan_cb;

/* Cached AP info from scan — used to lock BSSID at connect time */
static struct wifi_scan_result cached_ap = {0};
static bool have_cached_ap = false;

static Z_KERNEL_STACK_DEFINE_IN(wifi_retry_stack, 2048,
    __attribute__((section(".ext_ram.bss"))));
    
static struct k_thread wifi_retry_thread_data;

LOG_MODULE_REGISTER(wifi_module, LOG_LEVEL_INF);


/**
 * @brief Scan result callback — caches BSSID of the target AP.
 *
 * Stores the scan entry matching wifi_ssid so the BSSID can be
 * locked at connect time to avoid iPhone hotspot MAC rotation.
 */
static void wifi_scan_result_cb(struct net_mgmt_event_callback *cb,
                                uint64_t mgmt_event,
                                struct net_if *iface) {
    if (mgmt_event != NET_EVENT_WIFI_SCAN_RESULT) {
        return;
    }

    const struct wifi_scan_result *entry =
        (const struct wifi_scan_result *)cb->info;

    if (strncmp(entry->ssid, wifi_ssid, entry->ssid_length) == 0) {
        memcpy(&cached_ap, entry, sizeof(cached_ap));
        have_cached_ap = true;
    }
}

/**
 * @brief Handle a WiFi connect result event.
 *
 * On success, resets the retry counter and signals wifi_connected.
 * On failure, logs the error code.
 */
static void handle_wifi_connect_result(struct net_mgmt_event_callback *cb) {
    const struct wifi_status *status = (const struct wifi_status *)cb->info;

    if (status->status) {
        LOG_ERR("Connection request failed (%d)", status->status);
    } else {
        LOG_INF("WiFi connected");
        k_mutex_lock(&wifi_retry_mutex, K_FOREVER);
        wifi_connection_retry_count = 0;
        k_mutex_unlock(&wifi_retry_mutex);
        k_sem_give(&wifi_connected);
    }
}

static void wifi_retry_thread_fn(void *a, void *b, void *c);

/**
 * @brief Handle a WiFi disconnect event.
 *
 * Clears the connected and IPv4 state, then spawns a retry thread
 * to reconnect off event-handler context.
 */
static void handle_wifi_disconnect_result(struct net_mgmt_event_callback *cb) {
    const struct wifi_status *status = (const struct wifi_status *)cb->info;

    LOG_INF("WiFi disconnected (status=%d) — reconnecting", status->status);

    k_sem_take(&wifi_connected, K_NO_WAIT);
    got_ipv4 = false;

    k_thread_create(&wifi_retry_thread_data, wifi_retry_stack,
                    K_THREAD_STACK_SIZEOF(wifi_retry_stack),
                    wifi_retry_thread_fn,
                    NULL, NULL, NULL,
                    K_PRIO_COOP(7), 0, K_NO_WAIT);
}

/**
 * @brief Handle IPv4 address assignment events.
 *
 * Logs IP, subnet, and gateway on the first DHCP-assigned address
 * and signals ipv4_address_obtained.
 */
static void handle_ipv4_result(struct net_if *iface) {
    if (got_ipv4) {
        return;
    }

    struct net_if_config *cfg  = net_if_get_config(iface);
    struct net_if_ipv4   *ipv4 = cfg->ip.ipv4;
    char buf[NET_IPV4_ADDR_LEN];

    for (int i = 0; i < NET_IF_MAX_IPV4_ADDR; i++) {
        const struct net_if_addr_ipv4 *u = &ipv4->unicast[i];

        if (u->ipv4.addr_type != NET_ADDR_DHCP) {
            continue;
        }

        net_addr_ntop(AF_INET, &u->ipv4.address.in_addr, buf, sizeof(buf));
        LOG_INF("IP: %s", buf);

        net_addr_ntop(AF_INET, &u->netmask, buf, sizeof(buf));
        LOG_INF("Subnet: %s", buf);

        net_addr_ntop(AF_INET, &ipv4->gw, buf, sizeof(buf));
        LOG_INF("Gateway: %s", buf);

        got_ipv4 = true;
        k_sem_give(&ipv4_address_obtained);
        break;
    }
}

/**
 * @brief Top-level net-mgmt event dispatcher.
 *
 * Routes connect, disconnect, and IPv4 events to their handlers.
 */
static void wifi_mgmt_event_handler(struct net_mgmt_event_callback *cb,
                                    uint64_t mgmt_event,
                                    struct net_if *iface) {
    if (mgmt_event == NET_EVENT_WIFI_CONNECT_RESULT) {
        handle_wifi_connect_result(cb);
    } else if (mgmt_event == NET_EVENT_WIFI_DISCONNECT_RESULT) {
        handle_wifi_disconnect_result(cb);
    } else if (mgmt_event == NET_EVENT_IPV4_ADDR_ADD ||
               mgmt_event == NET_EVENT_IPV4_DHCP_BOUND ||
               mgmt_event == NET_EVENT_L4_CONNECTED) {
        handle_ipv4_result(iface);
    }
}

/**
 * @brief Scan for the target AP, then connect with BSSID locked.
 *
 * Waits up to 5s for a scan result matching wifi_ssid. If found,
 * the cached channel and BSSID are included in the connect request
 * to pin the association to a specific AP.
 */
void wifi_connect_with_bssid(void) {
    struct net_if *iface = net_if_get_default();

    /* Register scan callback and trigger scan */
    have_cached_ap = false;
    net_mgmt_init_event_callback(&scan_cb, wifi_scan_result_cb,
                                 NET_EVENT_WIFI_SCAN_RESULT |
                                 NET_EVENT_WIFI_SCAN_DONE);
    net_mgmt_add_event_callback(&scan_cb);

    net_mgmt(NET_REQUEST_WIFI_SCAN, iface, NULL, 0);

    /* Wait up to 5 seconds for scan to find our AP */
    int waited = 0;

    while (!have_cached_ap && waited < 5000) {
        k_msleep(100);
        waited += 100;
    }

    net_mgmt_del_event_callback(&scan_cb);

    struct wifi_connect_req_params wifi_params = {0};

    wifi_params.ssid        = wifi_ssid;
    wifi_params.ssid_length = strlen(wifi_ssid);
    wifi_params.psk         = wifi_psk;
    wifi_params.psk_length  = strlen(wifi_psk);
    wifi_params.security    = WIFI_SECURITY_TYPE_PSK;
    wifi_params.band        = WIFI_FREQ_BAND_2_4_GHZ;
    wifi_params.mfp         = WIFI_MFP_OPTIONAL;

    if (have_cached_ap) {
        wifi_params.channel = cached_ap.channel;
        memcpy(wifi_params.bssid, cached_ap.mac, WIFI_MAC_ADDR_LEN);
        LOG_INF("Connecting to SSID: %s (BSSID locked, ch %d)",
                wifi_params.ssid, wifi_params.channel);
    } else {
        wifi_params.channel = WIFI_CHANNEL_ANY;
        LOG_INF("Connecting to SSID: %s (no BSSID lock — AP not found in scan)",
                wifi_params.ssid);
    }

    if (net_mgmt(NET_REQUEST_WIFI_CONNECT, iface, &wifi_params,
                 sizeof(struct wifi_connect_req_params))) {
        LOG_ERR("WiFi connection request failed");
    }
}

/**
 * @brief Retry thread — reconnects with exponential backoff.
 *
 * Increments the global retry counter, waits 1s, then calls
 * wifi_connect_with_bssid(). Runs off event-handler context.
 */
static void wifi_retry_thread_fn(void *a, void *b, void *c) {
    ARG_UNUSED(a);
    ARG_UNUSED(b);
    ARG_UNUSED(c);

    k_mutex_lock(&wifi_retry_mutex, K_FOREVER);
    uint8_t retry = wifi_connection_retry_count++;
    k_mutex_unlock(&wifi_retry_mutex);

    LOG_INF("Retrying WiFi connection (%d) in 1s", retry + 1);
    k_msleep(1000);

    wifi_connect_with_bssid();
}

/**
 * @brief Register all WiFi and IPv4 net-mgmt event callbacks.
 *
 * Must be called before the first connection attempt.
 */
void wifi_callbacks_init(void) {
    got_ipv4 = false;

    net_mgmt_init_event_callback(&wifi_cb,
        wifi_mgmt_event_handler,
        NET_EVENT_WIFI_CONNECT_RESULT | NET_EVENT_WIFI_DISCONNECT_RESULT);
    net_mgmt_add_event_callback(&wifi_cb);

    net_mgmt_init_event_callback(&ipv4_cb,
        wifi_mgmt_event_handler,
        NET_EVENT_IPV4_ADDR_ADD | NET_EVENT_IPV4_DHCP_BOUND);
    net_mgmt_add_event_callback(&ipv4_cb);

    net_mgmt_init_event_callback(&l4_cb,
        wifi_mgmt_event_handler,
        NET_EVENT_L4_CONNECTED);
    net_mgmt_add_event_callback(&l4_cb);
}

/**
 * @brief Main WiFi management thread.
 *
 * Initialises callbacks, initiates the first connection, then blocks
 * until both association and an IPv4 address are confirmed.
 */
void wifi_thread(void) {
    LOG_INF("WiFi thread started");

    wifi_callbacks_init();
    wifi_connect_with_bssid();

    k_sem_take(&wifi_connected, K_FOREVER);
    LOG_INF("WiFi associated");

    k_sem_take(&ipv4_address_obtained, K_FOREVER);
    LOG_INF("IP address obtained — WiFi ready");

    /* Thread exits; main.c proceeds to start azure_mqtt_thread */
}
```

## src/wifi.h
```c
#ifndef WIFI_H_
#define WIFI_H_

#define MAX_SSID_LEN     32
#define MAX_PSK_LEN      64

extern char wifi_ssid[MAX_SSID_LEN];
extern char wifi_psk [MAX_PSK_LEN];

void wifi_callbacks_init(void);
void wifi_thread(void);

#endif /* WIFI_H_ */
```
