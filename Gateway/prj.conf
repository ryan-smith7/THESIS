## prj.conf
```kconfig
# ============================================================
# BLE Gateway Board (ESP32 #1) — BLE Central + UART TX
# ============================================================

# –– Core ––
CONFIG_MAIN_STACK_SIZE=2048
CONFIG_SYSTEM_WORKQUEUE_STACK_SIZE=4096   
CONFIG_PRINTK=y
CONFIG_CBPRINTF_FP_SUPPORT=y

# –– Logging ––
CONFIG_LOG=y
CONFIG_LOG_DEFAULT_LEVEL=3
CONFIG_LOG_MODE_DEFERRED=n
CONFIG_LOG_BUFFER_SIZE=4096              
CONFIG_LOG_BACKEND_UART=y
CONFIG_SHELL=y
CONFIG_SHELL_LOG_BACKEND=n

# –– Libraries ––
CONFIG_JSON_LIBRARY=y
CONFIG_UUID=y
CONFIG_UUID_V4=y

# –– Peripherals ––
CONFIG_GPIO=y
CONFIG_I2C=y
CONFIG_SENSOR=y
CONFIG_RTC=y

# –– UART (TX to WiFi board on UART2 GPIO17) ––
CONFIG_SERIAL=y
CONFIG_UART_INTERRUPT_DRIVEN=y

# –– Bluetooth Central ––
CONFIG_BT=y
CONFIG_BT_CENTRAL=y
CONFIG_BT_PERIPHERAL=n
CONFIG_BT_GATT_CLIENT=y
CONFIG_BT_MAX_CONN=4
CONFIG_BT_MAX_PAIRED=4
CONFIG_BT_SMP=y

# ACL buffers — must fit largest sound notification (238 bytes payload)
# ATT header (3) + L2CAP header (4) + payload (238) = 245 → round to 251
CONFIG_BT_BUF_ACL_RX_SIZE=251          
CONFIG_BT_BUF_ACL_TX_SIZE=251          

# L2CAP TX MTU — must be ≥ 244 (BLE max for LE Data Packets)
CONFIG_BT_L2CAP_TX_MTU=244           

# TX buffer count — 2 subscriptions per connection × 4 connections
CONFIG_BT_L2CAP_TX_BUF_COUNT=16
CONFIG_BT_CONN_TX_MAX=16

# GATT — need enough attribute buffers for 2 characteristics × 4 connections
CONFIG_BT_GATT_READ_MULTIPLE=y

# –– Heap ––
# Reassembly buffers: 4 connections × sound_reassembly struct (~700 bytes each)
# + BLE stack internals
CONFIG_HEAP_MEM_POOL_SIZE=29696

# –– ESP32 ––
CONFIG_ESP32_USE_UNSUPPORTED_REVISION=y
```

## src/main.c
```c
/*
 * main.c — BLE Board (ESP32 #1)
 *
 * Starts two threads:
 *   base_thread        — BLE init, scan, connect to tracker peripherals
 *   process_data_thread — dequeue BLE packets, encode JSON, TX over UART2
 *
 * No WiFi, no MQTT, no Azure on this board.
 * All data goes to the WiFi board (ESP32 #2) via UART2 GPIO17 (TX).
 */

#include <zephyr/kernel.h>
#include <zephyr/types.h>
#include <zephyr/sys/printk.h>
#include <zephyr/bluetooth/bluetooth.h>
#include <zephyr/bluetooth/conn.h>
#include <zephyr/bluetooth/gatt.h>
#include <zephyr/bluetooth/hci.h>
#include <zephyr/bluetooth/uuid.h>
#include <zephyr/logging/log.h>

#include "bluetooth.h"

LOG_MODULE_REGISTER(main, LOG_LEVEL_INF);

K_THREAD_DEFINE(process_data_tid,
                BASE_PROCESS_STACK_SIZE,
                process_data_thread,
                NULL, NULL, NULL,
                BASE_PROCESS_PRIORITY, 0, 0);

K_THREAD_DEFINE(base_tid,
                BASE_CONTROL_STACK_SIZE,
                base_thread,
                NULL, NULL, NULL,
                BASE_CONTROL_PRIORITY, 0, 0);
```

## src/uart.c
```c
/**
 * @file uart.c
 * @brief UART TX/RX implementation for the gateway board.
 *
 * Outbound (TX):
 *   uart_tx_frame() sends framed sensor and sound packets to the WiFi board
 *   using uart_poll_out() (blocking, one byte at a time).
 *
 * Inbound (RX):
 *   An interrupt-driven state machine receives UTC sync frames from the
 *   WiFi board. On receipt of a complete 0xCC frame, calls
 *   time_sync_writer_set_utc() to update the gateway's UTC reference,
 *   which is then distributed to all connected sensor nodes.
 */

#include "uart.h"
#include "time_sync_writer.h"

#include <zephyr/kernel.h>
#include <zephyr/device.h>
#include <zephyr/drivers/uart.h>
#include <zephyr/logging/log.h>

LOG_MODULE_REGISTER(gateway_uart, LOG_LEVEL_INF);

/* ── Device ─────────────────────────────────────────────── */
#define UART_DEVICE_NODE DT_NODELABEL(uart2)

static const struct device *uart_dev;
static bool uart_ready = false;

/* ── RX state machine ───────────────────────────────────────
 *
 * Parses the inbound UTC frame byte by byte inside the UART ISR:
 *
 *   Byte 0:   0xCC magic — starts a new frame
 *   Bytes 1–4: UTC unix timestamp, big-endian MSB first
 *
 * Any byte that is not 0xCC while idle is silently discarded,
 * making the parser self-synchronising after line noise or resets.
 */
#define UART_RX_FRAME_LEN  7   /* magic(1) + utc_sec(4) + utc_ms(2) */

static uint8_t uart_rx_buf[UART_RX_FRAME_LEN];
static uint8_t uart_rx_pos      = 0;
static bool    uart_rx_in_frame = false;

/**
 * @brief Process a single received byte inside the UART ISR.
 *
 * Implements the state machine:
 *   IDLE        — wait for 0xCC magic byte
 *   IN_FRAME    — accumulate remaining 4 UTC bytes
 *   COMPLETE    — parse and call time_sync_writer_set_utc(), reset to IDLE
 *
 * @param byte  The byte just read from the UART FIFO.
 */
static void uart_rx_handle_byte(uint8_t byte)
{
    // LOG_INF("in uart handler");
    if (!uart_rx_in_frame) {
        /* IDLE — wait for magic */
        if (byte == FRAME_MAGIC_UTC) {
            uart_rx_buf[0]   = byte;
            uart_rx_pos      = 1;
            uart_rx_in_frame = true;
        }
        return;
    }

    /* IN_FRAME — accumulate bytes */
    uart_rx_buf[uart_rx_pos++] = byte;

    if (uart_rx_pos == UART_RX_FRAME_LEN) {
        /* COMPLETE — parse UTC seconds (bytes 1–4) and ms (bytes 5–6) */
        uint32_t utc_sec = ((uint32_t)uart_rx_buf[1] << 24) |
                           ((uint32_t)uart_rx_buf[2] << 16) |
                           ((uint32_t)uart_rx_buf[3] <<  8) |
                            (uint32_t)uart_rx_buf[4];

        uint16_t utc_ms  = ((uint16_t)uart_rx_buf[5] << 8) |
                            (uint16_t)uart_rx_buf[6];

        time_sync_writer_set_utc(utc_sec, utc_ms);

        /* Reset to IDLE */
        uart_rx_pos      = 0;
        uart_rx_in_frame = false;
    }
}

/**
 * @brief UART interrupt handler — drains the RX FIFO byte by byte.
 *
 * Registered via uart_irq_callback_set() during uart_gateway_init().
 * Called by the Zephyr UART driver on each RX FIFO ready event.
 *
 * @param dev        UART device pointer (unused directly).
 * @param user_data  Not used.
 */
static void uart_irq_handler(const struct device *dev, void *user_data)
{
    ARG_UNUSED(user_data);

    while (uart_irq_update(dev) && uart_irq_rx_ready(dev)) {
        uint8_t byte;
        if (uart_fifo_read(dev, &byte, 1) == 1) {
            uart_rx_handle_byte(byte);
        }
    }
}

/* ── Public API ─────────────────────────────────────────── */

void uart_gateway_init(void)
{
    uart_dev = DEVICE_DT_GET(UART_DEVICE_NODE);

    if (!device_is_ready(uart_dev)) {
        LOG_ERR("UART2 not ready — TX and RX disabled");
        return;
    }

    uart_ready = true;
    LOG_INF("UART2 TX ready (GPIO17)");

    /* Register ISR and enable RX interrupts */
    uart_irq_callback_set(uart_dev, uart_irq_handler);
    uart_irq_rx_enable(uart_dev);
    LOG_INF("UART2 RX interrupt enabled (GPIO16)");
}

bool uart_gateway_is_ready(void)
{
    return uart_ready;
}

void uart_tx_frame(uint8_t magic, const uint8_t *data, uint16_t len)
{
    if (!uart_ready) {
        LOG_WRN("uart_tx_frame: UART2 not ready — dropping frame 0x%02x", magic);
        return;
    }

    /* Header: magic + 2-byte big-endian length */
    uart_poll_out(uart_dev, magic);
    uart_poll_out(uart_dev, (uint8_t)(len >> 8));
    uart_poll_out(uart_dev, (uint8_t)(len & 0xFF));

    /* Payload */
    for (uint16_t i = 0; i < len; i++) {
        uart_poll_out(uart_dev, data[i]);
    }
}
```

## src/uart.h
```c
/**
 * @file uart.h
 * @brief UART TX/RX interface for the gateway board.
 *
 * Handles all UART2 communication between the gateway (ESP32 #1) and
 * the WiFi board (ESP32 #2):
 *
 * Outbound (TX — GPIO17):
 *   Sensor frames  [ 0xAA ] [ len_hi ] [ len_lo ] [ 57 bytes  ]
 *   Sound frames   [ 0xBB ] [ len_hi ] [ len_lo ] [ 698 bytes ]
 *
 * Inbound (RX — GPIO16):
 *   UTC sync frame [ 0xCC ] [ sec_b3..sec_b0 ] [ ms_hi ] [ ms_lo ]
 *   Parsed by interrupt-driven state machine; calls
 *   time_sync_writer_set_utc() on receipt of a complete frame.
 */

#ifndef GATEWAY_UART_H
#define GATEWAY_UART_H

#include <zephyr/kernel.h>
#include <zephyr/types.h>

/* ── Frame magic bytes ──────────────────────────────────── */
#define FRAME_MAGIC_SENSOR  0xAA   /* outbound: main sensor packet  */
#define FRAME_MAGIC_SOUND   0xBB   /* outbound: sound spectrum      */
#define FRAME_MAGIC_UTC     0xCC   /* inbound:  UTC time sync       */

/* ── Frame lengths ──────────────────────────────────────── */
#define FRAME_UTC_RX_LEN    7      /* magic(1) + utc_sec(4) + utc_ms(2) */

/**
 * @brief Initialise UART2 for TX and RX.
 *
 * Acquires the uart2 device, enables TX polling, and registers the
 * interrupt-driven RX handler. Must be called once before any other
 * uart_ functions, typically at the start of process_data_thread().
 */
void uart_gateway_init(void);

/**
 * @brief Transmit a framed packet over UART2.
 *
 * Frame layout: [ magic(1) ] [ len_hi(1) ] [ len_lo(1) ] [ data(len) ]
 *
 * Uses uart_poll_out() — blocking per byte, safe to call from any
 * thread context. Not safe to call concurrently from multiple threads
 * without external locking.
 *
 * @param magic  Frame type identifier (FRAME_MAGIC_SENSOR or FRAME_MAGIC_SOUND).
 * @param data   Pointer to payload buffer.
 * @param len    Number of payload bytes to transmit.
 */
void uart_tx_frame(uint8_t magic, const uint8_t *data, uint16_t len);

/**
 * @brief Check whether UART2 initialised successfully.
 *
 * @return true if the device is ready and TX/RX are active.
 */
bool uart_gateway_is_ready(void);

#endif /* GATEWAY_UART_H */
```
