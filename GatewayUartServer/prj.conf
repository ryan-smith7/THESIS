## prj.conf
```kconfig
# ============================================================
# WiFi Board (ESP32 #2) — UART RX from BLE board + Azure MQTT
# ============================================================

# –– Core ––
CONFIG_INIT_STACKS=y
CONFIG_MAIN_STACK_SIZE=2048
CONFIG_SYSTEM_WORKQUEUE_STACK_SIZE=2048
CONFIG_PRINTK=y

# –– Logging (INFO only) ––
CONFIG_LOG=y
CONFIG_LOG_DEFAULT_LEVEL=3
CONFIG_LOG_MODE_DEFERRED=n
CONFIG_LOG_BUFFER_SIZE=2048
CONFIG_LOG_BACKEND_UART=y

# –– UART (for receiving JSON from BLE board) ––
CONFIG_SERIAL=y
CONFIG_UART_INTERRUPT_DRIVEN=y

# –– Networking Core ––
CONFIG_NETWORKING=y
CONFIG_NET_MGMT=y
CONFIG_NET_MGMT_EVENT=y
CONFIG_NET_MGMT_EVENT_INFO=y
CONFIG_NET_CONFIG_AUTO_INIT=y
CONFIG_NET_CONFIG_SETTINGS=y
CONFIG_NET_CONFIG_INIT_TIMEOUT=1

# –– WiFi ––
CONFIG_WIFI=y
CONFIG_WIFI_ESP32=y
CONFIG_NET_L2_WIFI_MGMT=y

# SNTP
CONFIG_SNTP=y

# –– IP (IPv4 only) ––
CONFIG_NET_IPV4=y
CONFIG_NET_IPV6=n
CONFIG_NET_ARP=y

# –– DHCP ––
CONFIG_NET_DHCPV4=y

# –– Sockets ––
CONFIG_NET_TCP=y
CONFIG_NET_SOCKETS=y
CONFIG_POSIX_API=y

# –– DNS ––
CONFIG_DNS_RESOLVER=y
CONFIG_DNS_RESOLVER_AI_MAX_ENTRIES=4

# –– MQTT ––
CONFIG_MQTT_LIB=y
CONFIG_MQTT_LIB_TLS=y
CONFIG_MQTT_KEEPALIVE=60

# –– TLS / MbedTLS ––
CONFIG_TLS_CREDENTIALS=y
CONFIG_NET_SOCKETS_SOCKOPT_TLS=y
CONFIG_NET_SOCKETS_TLS_MAX_CONTEXTS=2
CONFIG_MBEDTLS=y
CONFIG_MBEDTLS_BUILTIN=y
CONFIG_MBEDTLS_ENABLE_HEAP=y
CONFIG_MBEDTLS_HEAP_SIZE=45000
CONFIG_MBEDTLS_SSL_MAX_CONTENT_LEN=4096
CONFIG_MBEDTLS_PEM_CERTIFICATE_FORMAT=y
CONFIG_MBEDTLS_TLS_VERSION_1_2=y
CONFIG_MBEDTLS_SERVER_NAME_INDICATION=y
CONFIG_MBEDTLS_CIPHER_AES_ENABLED=y
CONFIG_MBEDTLS_CIPHER_GCM_ENABLED=y
CONFIG_MBEDTLS_ECDH_C=y
CONFIG_MBEDTLS_ECP_C=y
CONFIG_MBEDTLS_PKCS1_V15=y
CONFIG_MBEDTLS_KEY_EXCHANGE_ECDHE_RSA_ENABLED=y
CONFIG_MBEDTLS_ECP_DP_SECP256R1_ENABLED=y
CONFIG_MBEDTLS_RSA_C=y

# –– Network Buffers ––
CONFIG_NET_TX_STACK_SIZE=2048
CONFIG_NET_RX_STACK_SIZE=2048
CONFIG_NET_PKT_RX_COUNT=8
CONFIG_NET_PKT_TX_COUNT=8
CONFIG_NET_BUF_RX_COUNT=16
CONFIG_NET_BUF_TX_COUNT=16
CONFIG_NET_BUF_DATA_SIZE=512
CONFIG_NET_MAX_CONTEXTS=6

# –– Heap ––
CONFIG_HEAP_MEM_POOL_SIZE=52000

# –– JSON + UUID ––
CONFIG_JSON_LIBRARY=y
CONFIG_UUID=y
CONFIG_UUID_V4=y


# Enable float formatting in cbprintf
CONFIG_CBPRINTF_FP_SUPPORT=y

# ── ESP32-specific ────────────────────────────────────────
CONFIG_ESP32_USE_UNSUPPORTED_REVISION=y

# CONFIG_ESP_SPIRAM=y
# CONFIG_ESP_WIFI_HEAP_SPIRAM=y
# # CONFIG_ESP32_WIFI_NET_ALLOC_SPIRAM=y
```

## include/my_json.h
```c
#ifndef BASE_JSON_H
#define BASE_JSON_H

#include <zephyr/kernel.h>
#include <stdint.h>

/* ── Buffer sizes ───────────────────────────────────────── */
#define JSON_BUFFER_SIZE        1600   /* sensor telemetry JSON (increased for soil field) */
#define SOUND_JSON_BUFFER_SIZE  8192   /* sound spectrum JSON (348 floats)                 */

/* ── AS7343 ─────────────────────────────────────────────── */
#define AS7343_NUM_CH  13
static const uint16_t AS7343_WL[AS7343_NUM_CH] = {
    405, 425, 450, 475, 515, 550, 555, 600, 640, 690, 745, 855, 999
};

/* ── Sound ──────────────────────────────────────────────── */
#define SOUND_NUM_BINS  348

/* ═══════════════════════════════════════════════════════════
 * Sensor packet payload  (61-byte UART frame, magic 0xAA)
 *
 * Byte layout:
 *   [0..3]   time              uint32 BE — UTC seconds
 *   [4..5]   time_ms           uint16 BE — UTC milliseconds (0–999)
 *   [6..9]   uptime_ms         uint32 BE
 *   [10]     proto_ver
 *   [11]     dev_id
 *   [12..13] temp_c_x100       int16  BE
 *   [14..15] rh_x100           int16  BE
 *   [16..19] press_hPa_x1000   int32  BE
 *   [20..21] eco2_ppm          uint16 BE
 *   [22..23] tvoc_ppb          uint16 BE
 *   [24]     aqi
 *   [25..50] AS7343 ×13        uint16 BE each (26 bytes)
 *   [51..52] batt_mV           uint16 BE
 *   [53..54] snd_rms_dbfs_x100 int16  BE
 *   [55..56] snd_peak_freq_hz  uint16 BE
 *   [57..58] snd_peak_mag_x10  uint16 BE
 *   [59..60] soil_vwc_x100     uint16 BE — VWC % × 100 (0–10000)
 * ═══════════════════════════════════════════════════════════ */
typedef struct {
    uint32_t time;
    uint16_t time_ms;          /* UTC sub-second milliseconds (0–999)    */
    uint32_t uptime_ms;
    uint8_t  proto_ver;
    uint8_t  dev_id;

    int16_t  temp_c_x100;
    int16_t  rh_x100;
    int32_t  press_hPa_x1000;

    uint16_t eco2_ppm;
    uint16_t tvoc_ppb;
    uint8_t  aqi;

    uint16_t as7343[AS7343_NUM_CH];
    uint16_t batt_mV;

    int16_t  snd_rms_dbfs_x100;
    uint16_t snd_peak_freq_hz;
    uint16_t snd_peak_mag_x10;

    uint16_t soil_vwc_x100;    /* VWC % × 100, e.g. 4567 = 45.67%       */
} tracker_payload_t;

/* ═══════════════════════════════════════════════════════════
 * Sound spectrum payload  (698-byte UART frame, magic 0xBB)
 * ═══════════════════════════════════════════════════════════ */
typedef struct {
    uint8_t  dev_id;
    uint32_t uptime_ms;
    int16_t  rms_dbfs_x100;
    uint16_t bins[SOUND_NUM_BINS];
} sound_payload_t;

/* ── JSON struct blocks (sensor telemetry) ───────────────── */
struct json_payload_environment {
    double   temperature_c;
    double   humidity_percent;
    double   pressure_hpa;
    uint16_t eco2_ppm;
    uint16_t tvoc_ppb;
    uint8_t  aqi;
    uint16_t batt_mV;
};

struct json_payload_spectrum {
    uint16_t AS7343_405nm;
    uint16_t AS7343_425nm;
    uint16_t AS7343_450nm;
    uint16_t AS7343_475nm;
    uint16_t AS7343_515nm;
    uint16_t AS7343_550nm;
    uint16_t AS7343_555nm;
    uint16_t AS7343_600nm;
    uint16_t AS7343_640nm;
    uint16_t AS7343_690nm;
    uint16_t AS7343_745nm;
    uint16_t AS7343_855nm;
    uint16_t AS7343_VISIBLE;
};

struct json_payload_sound_summary {
    double   rms_dbfs;
    uint16_t peak_freq_hz;
    double   peak_mag;
};

struct json_payload {
    char     deviceId[20];
    char     timestamp[72];
    uint32_t uptime_ms;
    uint8_t  proto_ver;
    struct json_payload_environment   environment;
    struct json_payload_spectrum      spectrum;
    struct json_payload_sound_summary sound;
    double   soil_vwc;          /* VWC % as double, e.g. 45.67           */
};

struct json_header {
    char messageId[40];
    char gatewayId[12];
    char schemaVersion[8];
    char messageType[16];
};

struct json_signature {
    char alg[16];
    char keyId[24];
    char value[65];
};

struct json_full_packet {
    struct json_header    header;
    struct json_payload   payload;
    struct json_signature signature;
};

/* ── Sensor telemetry JSON format string ─────────────────── */
static const char JSON_FORMAT[] =
    "{"
      "\"header\":{"
        "\"messageId\":\"%s\","
        "\"gatewayId\":\"%s\","
        "\"schemaVersion\":\"%s\","
        "\"messageType\":\"%s\""
      "},"
      "\"payload\":{"
        "\"deviceId\":\"%s\","
        "\"timestamp\":\"%s\","
        "\"uptime_ms\":%u,"
        "\"proto_ver\":%u,"
        "\"environment\":{"
          "\"temperature_c\":%.2f,"
          "\"humidity_percent\":%.2f,"
          "\"pressure_hpa\":%.3f,"
          "\"eco2_ppm\":%u,"
          "\"tvoc_ppb\":%u,"
          "\"aqi\":%u,"
          "\"batt_mV\":%u"
        "},"
        "\"spectrum\":{"
          "\"AS7343_405nm\":%u,"
          "\"AS7343_425nm\":%u,"
          "\"AS7343_450nm\":%u,"
          "\"AS7343_475nm\":%u,"
          "\"AS7343_515nm\":%u,"
          "\"AS7343_550nm\":%u,"
          "\"AS7343_555nm\":%u,"
          "\"AS7343_600nm\":%u,"
          "\"AS7343_640nm\":%u,"
          "\"AS7343_690nm\":%u,"
          "\"AS7343_745nm\":%u,"
          "\"AS7343_855nm\":%u,"
          "\"AS7343_VISIBLE\":%u"
        "},"
        "\"sound\":{"
          "\"rms_dbfs\":%.2f,"
          "\"peak_freq_hz\":%u,"
          "\"peak_mag\":%.1f"
        "},"
        "\"soil\":{"
          "\"vwc_percent\":%.2f"
        "}"
      "}"
    "}";

/* ── Public API ─────────────────────────────────────────── */
void fill_json_packet(const tracker_payload_t *payload,
                      struct json_full_packet  *packet);

void encode_and_print_json(const struct json_full_packet *packet);

int encode_sound_json(const sound_payload_t *sp, char *buf, size_t buf_size);

#endif /* BASE_JSON_H */
```

## include/uart_bridge.h
```c
#ifndef UART_BRIDGE_H
#define UART_BRIDGE_H

#include <stdint.h>
/*
 * uart_bridge.h — UART JSON receiver for WiFi board (ESP32 #2)
 *
 * Wiring:
 *   BLE board GPIO17 (TX2) --> WiFi board GPIO16 (RX2)
 *   BLE board GPIO16 (RX2) <-- WiFi board GPIO17 (TX2)
 *   BLE board GND          --- WiFi board GND
 *
 * Protocol: newline-terminated JSON strings at 115200 baud.
 * Each complete line is published to Azure IoT Hub via azure_mqtt_publish().
 */

/* Start the UART bridge receive thread */
void uart_bridge_start(void);

/**
 * @brief Send a UTC sync frame to the BLE gateway (7 bytes).
 *
 *   [ 0xCC ][ sec_b3 ][ sec_b2 ][ sec_b1 ][ sec_b0 ][ ms_hi ][ ms_lo ]
 *
 * Safe to call from any thread. Blocks ~70µs for polling TX at 115200.
 *
 * @param utc_time  Unix UTC timestamp (seconds since epoch).
 * @param utc_ms    Sub-second milliseconds (0–999).
 */
void uart_bridge_send_utc(uint32_t utc_time, uint16_t utc_ms);

#endif /* UART_BRIDGE_H */
```

## src/azure_mqtt.c
```c
/*
 * azure_mqtt.c — Azure IoT Hub MQTT/TLS client for WiFi board (ESP32 #2)
 *
 * Change from standalone version:
 *   azure_mqtt_thread no longer publishes its own test telemetry.
 *   It only maintains the MQTT connection and processes keepalives.
 *   All publish calls come from uart_bridge.c via azure_mqtt_publish().
 */

#include "azure_mqtt.h"

#include <zephyr/kernel.h>
#include <zephyr/logging/log.h>
#include <zephyr/net/mqtt.h>
#include <zephyr/net/socket.h>
#include <zephyr/net/tls_credentials.h>
#include <zephyr/random/random.h>
#include <string.h>
#include <errno.h>

LOG_MODULE_REGISTER(azure_mqtt, LOG_LEVEL_INF);

static struct mqtt_client     client;
static struct sockaddr_storage broker_addr;

static uint8_t rx_buf[1024];
static uint8_t tx_buf[1024];
static uint8_t payload_buf[5120];

static bool connected = false;

static const char root_ca[] = AZURE_ROOT_CA_CERT;

static int tls_credentials_register(void)
{
    int ret = tls_credential_add(AZURE_TLS_TAG,
                                 TLS_CREDENTIAL_CA_CERTIFICATE,
                                 root_ca, sizeof(root_ca));
    if (ret < 0 && ret != -EEXIST) {
        LOG_ERR("Failed to register CA cert: %d", ret);
        return ret;
    }
    return 0;
}

static void mqtt_evt_handler(struct mqtt_client *c, const struct mqtt_evt *evt)
{
    switch (evt->type) {
    case MQTT_EVT_CONNACK:
        if (evt->result == 0) {
            LOG_INF("CONNACK: connected to Azure IoT Hub");
            connected = true;
        } else {
            LOG_ERR("CONNACK error: %d", evt->result);
        }
        break;
    case MQTT_EVT_DISCONNECT:
        LOG_WRN("Disconnected: %d", evt->result);
        connected = false;
        break;
    case MQTT_EVT_PUBACK:
        LOG_DBG("PUBACK mid=%u", evt->param.puback.message_id);
        break;
    case MQTT_EVT_PINGRESP:
        LOG_DBG("PINGRESP");
        break;
    default:
        LOG_DBG("MQTT evt %d", evt->type);
        break;
    }
}

static int do_connect(void)
{
    struct addrinfo *result;
    struct sockaddr_in *broker4;
    char port_str[8];
    static sec_tag_t sec_tags[] = { AZURE_TLS_TAG };
    struct mqtt_sec_config *tls_config;

    const struct addrinfo hints = {
        .ai_family   = AF_INET,
        .ai_socktype = SOCK_STREAM,
    };

    snprintf(port_str, sizeof(port_str), "%d", AZURE_MQTT_PORT);

    LOG_INF("Resolving %s ...", AZURE_IOT_HUB_HOSTNAME);
    int ret = getaddrinfo(AZURE_IOT_HUB_HOSTNAME, port_str, &hints, &result);
    if (ret != 0) {
        LOG_ERR("DNS failed: %d", ret);
        return -ENETUNREACH;
    }

    broker4 = (struct sockaddr_in *)&broker_addr;
    broker4->sin_addr.s_addr =
        ((struct sockaddr_in *)result->ai_addr)->sin_addr.s_addr;
    broker4->sin_family = AF_INET;
    broker4->sin_port   =
        ((struct sockaddr_in *)result->ai_addr)->sin_port;
    freeaddrinfo(result);
    LOG_INF("DNS resolved");

    static const char username_str[] = AZURE_MQTT_USERNAME;
    static const char password_str[] = AZURE_SAS_TOKEN;
    static const char client_id_str[] = AZURE_MQTT_CLIENT_ID;

    static struct mqtt_utf8 password;
    static struct mqtt_utf8 username;

    password.utf8 = (uint8_t *)password_str;
    password.size = strlen(password_str);
    username.utf8 = (uint8_t *)username_str;
    username.size = strlen(username_str);

    mqtt_client_init(&client);
    client.broker           = &broker_addr;
    client.evt_cb           = mqtt_evt_handler;
    client.client_id.utf8   = (uint8_t *)client_id_str;
    client.client_id.size   = strlen(client_id_str);
    client.password         = &password;
    client.user_name        = &username;
    client.protocol_version = MQTT_VERSION_3_1_1;
    client.rx_buf           = rx_buf;
    client.rx_buf_size      = sizeof(rx_buf);
    client.tx_buf           = tx_buf;
    client.tx_buf_size      = sizeof(tx_buf);
    client.transport.type   = MQTT_TRANSPORT_SECURE;
    client.keepalive        = CONFIG_MQTT_KEEPALIVE;
    client.clean_session    = 1;

    tls_config = &client.transport.tls.config;
    tls_config->peer_verify   = TLS_PEER_VERIFY_REQUIRED;
    tls_config->cipher_list   = NULL;
    tls_config->sec_tag_list  = sec_tags;
    tls_config->sec_tag_count = ARRAY_SIZE(sec_tags);
    tls_config->hostname      = AZURE_IOT_HUB_HOSTNAME;

    LOG_INF("MQTT connecting to %s:%d ...", AZURE_IOT_HUB_HOSTNAME, AZURE_MQTT_PORT);

    ret = mqtt_connect(&client);
    if (ret < 0) {
        LOG_ERR("mqtt_connect failed: %d", ret);
        return ret;
    }

    struct zsock_pollfd fds = {
        .fd     = client.transport.tls.sock,
        .events = ZSOCK_POLLIN,
    };

    int rc = zsock_poll(&fds, 1, 5000);
    if (rc > 0) {
        mqtt_input(&client);
    }

    if (!connected) {
        LOG_ERR("CONNACK failed or timeout");
        mqtt_abort(&client);
        return -ETIMEDOUT;
    }

    return 0;
}

int azure_mqtt_connect(void)
{
    int ret = tls_credentials_register();
    if (ret < 0) {
        return ret;
    }
    return do_connect();
}

int azure_mqtt_publish(const char *json)
{
    if (!connected) {
        LOG_WRN("Not connected — skipping publish");
        return -ENOTCONN;
    }

    size_t len = strlen(json);
    if (len >= sizeof(payload_buf)) {
        LOG_ERR("Payload too large: %zu", len);
        return -EMSGSIZE;
    }
    memcpy(payload_buf, json, len);

    struct mqtt_publish_param pub = {
        .message = {
            .topic = {
                .qos   = MQTT_QOS_1_AT_LEAST_ONCE,
                .topic = {
                    .utf8 = (uint8_t *)AZURE_MQTT_TOPIC,
                    .size = strlen(AZURE_MQTT_TOPIC),
                },
            },
            .payload = {
                .data = payload_buf,
                .len  = len,
            },
        },
        .message_id  = (uint16_t)sys_rand32_get(),
        .dup_flag    = 0,
        .retain_flag = 0,
    };

    int ret = mqtt_publish(&client, &pub);
    if (ret < 0) {
        LOG_ERR("mqtt_publish failed: %d", ret);
        connected = false;
        return ret;
    }

    LOG_INF("Published %zu bytes", len);
    return 0;
}

void azure_mqtt_process(void)
{
    if (!connected) {
        return;
    }

    struct zsock_pollfd fds = {
        .fd     = client.transport.tls.sock,
        .events = ZSOCK_POLLIN,
    };

    if (zsock_poll(&fds, 1, 0) > 0) {
        mqtt_input(&client);
    }
    mqtt_live(&client);
}

/* -----------------------------------------------------------------------
 * azure_mqtt_thread — connection management and keepalive loop only.
 * Publish is driven externally by uart_bridge.c.
 *
 * To test the MQTT connection independently without the BLE board,
 * uncomment the test telemetry block below.
 * --------------------------------------------------------------------- */
#define AZURE_MQTT_STACK    8192
#define AZURE_MQTT_PRIO     7
#define RECONNECT_DELAY_MS  10000

// #define PUBLISH_INTERVAL_MS 30000  /* uncomment for test telemetry */

K_THREAD_STACK_DEFINE(azure_mqtt_stack, AZURE_MQTT_STACK);
static struct k_thread azure_mqtt_tid;

// /* Test telemetry — uncomment to verify MQTT works without BLE board */
// static void build_telemetry_json(char *buf, size_t buf_size, uint32_t uptime_s)
// {
//     snprintf(buf, buf_size,
//         "{"
//           "\"header\":{"
//             "\"messageId\":\"%08X%08X\","
//             "\"gatewayId\":\"GW-01\","
//             "\"schemaVersion\":\"1.0\","
//             "\"messageType\":\"telemetry\""
//           "},"
//           "\"payload\":{"
//             "\"deviceId\":\"" AZURE_DEVICE_ID "\","
//             "\"timestamp\":\"%u\","
//             "\"uptime\":\"%u\","
//             "\"location\":{"
//               "\"latitude\":\"27.5002432\",\"ns\":\"S\","
//               "\"longitude\":\"153.0153600\",\"ew\":\"E\","
//               "\"altitude_m\":\"0.0\""
//             "},"
//             "\"environment\":{"
//               "\"temperature_c\":\"26.22\","
//               "\"humidity_percent\":\"69.00\","
//               "\"pressure_hpa\":\"102.3\","
//               "\"gas_ppm\":\"28.00\""
//             "},"
//             "\"acceleration\":{"
//               "\"x_mps2\":\"2.413\","
//               "\"y_mps2\":\"-0.459\","
//               "\"z_mps2\":\"-6.511\""
//             "}"
//           "},"
//           "\"signature\":{"
//             "\"alg\":\"HS256\","
//             "\"keyId\":\"key-001\","
//             "\"value\":\"FBDA00C64513C32B027DA202C4C0574E86CE9FE462C42B8BB3B7734380810DA8\""
//           "}"
//         "}",
//         sys_rand32_get(), sys_rand32_get(),
//         uptime_s, uptime_s
//     );
// }

void azure_mqtt_thread(void)
{
    LOG_INF("azure_mqtt_thread started");

    // static char json_buf[1300];      /* uncomment for test telemetry */
    // static int64_t last_pub = 0;     /* uncomment for test telemetry */

    while (true) {
        if (!connected) {
            LOG_INF("Connecting to Azure IoT Hub ...");
            int ret = azure_mqtt_connect();
            if (ret < 0) {
                LOG_ERR("Connection failed (%d), retrying in %d s",
                        ret, RECONNECT_DELAY_MS / 1000);
                k_sleep(K_MSEC(RECONNECT_DELAY_MS));
                continue;
            }
        }

        /* Process incoming MQTT packets (PUBACKs, PINGRESPs) */
        azure_mqtt_process();

        // /* Test telemetry — uncomment to publish without BLE board */
        // int64_t now = k_uptime_get();
        // if (now - last_pub >= PUBLISH_INTERVAL_MS) {
        //     last_pub = now;
        //     build_telemetry_json(json_buf, sizeof(json_buf),
        //                          (uint32_t)(now / 1000));
        //     azure_mqtt_publish(json_buf);
        // }

        k_sleep(K_MSEC(500));
    }
}

void azure_mqtt_thread_start(void)
{
    k_thread_create(&azure_mqtt_tid,
                    azure_mqtt_stack,
                    K_THREAD_STACK_SIZEOF(azure_mqtt_stack),
                    (k_thread_entry_t)azure_mqtt_thread,
                    NULL, NULL, NULL,
                    AZURE_MQTT_PRIO, 0, K_NO_WAIT);
    k_thread_name_set(&azure_mqtt_tid, "azure_mqtt");
}
```

## src/sntp_sync.c
```c
/*
 * sntp_sync.c — WiFi Board (ESP32 #2)
 *
 * Periodically queries an NTP server and forwards UTC to the BLE gateway
 * board via UART using the 0xCC frame format expected by uart.c on the
 * gateway.
 *
 * Frame sent on each successful sync:
 *   [ 0xCC ][ utc_b3 ][ utc_b2 ][ utc_b1 ][ utc_b0 ]  (5 bytes, big-endian)
 */

#include "sntp_sync.h"
#include "uart_bridge.h"

#include <zephyr/kernel.h>
#include <zephyr/net/sntp.h>
#include <zephyr/net/socket.h>
#include <zephyr/logging/log.h>

#include <time.h>


LOG_MODULE_REGISTER(sntp_sync, LOG_LEVEL_INF);

#define SNTP_SERVER          "pool.ntp.org"
#define SNTP_PORT            123
#define SNTP_TIMEOUT_MS      5000
#define SNTP_RESYNC_INTERVAL_S  60
#define SNTP_RETRY_DELAY_MS     10000

#define SNTP_STACK_SIZE  2048
#define SNTP_PRIORITY    6        /* same as wifi_thread — runs after it exits */

K_THREAD_STACK_DEFINE(sntp_stack, SNTP_STACK_SIZE);
static struct k_thread sntp_tid;

static uint32_t last_utc_time    = 0;
static uint16_t last_utc_ms      = 0;   /* sub-second ms from NTP fraction */
static uint32_t last_utc_set_ms  = 0;  /* k_uptime when last_utc was stored */

uint32_t sntp_get_last_utc(uint16_t *out_ms)
{
    if (last_utc_time == 0) {
        if (out_ms) *out_ms = 0;
        return 0;
    }
    uint32_t elapsed_ms = k_uptime_get_32() - last_utc_set_ms;
    uint32_t total_ms   = last_utc_ms + elapsed_ms;
    uint32_t sec        = last_utc_time + (total_ms / 1000U);
    uint16_t ms         = (uint16_t)(total_ms % 1000U);
    if (out_ms) *out_ms = ms;
    return sec;
}

static int do_sntp_query(uint32_t *utc_out)
{
    struct sntp_time sntp_time;
    struct sockaddr_in addr = {0};

    /* Resolve NTP server */
    struct addrinfo *result;
    const struct addrinfo hints = {
        .ai_family   = AF_INET,
        .ai_socktype = SOCK_DGRAM,
    };

    int ret = getaddrinfo(SNTP_SERVER, NULL, &hints, &result);
    if (ret != 0) {
        LOG_ERR("DNS failed for %s: %d", SNTP_SERVER, ret);
        return -ENETUNREACH;
    }

    addr.sin_family = AF_INET;
    addr.sin_port   = htons(SNTP_PORT);
    addr.sin_addr   = ((struct sockaddr_in *)result->ai_addr)->sin_addr;
    freeaddrinfo(result);

    ret = sntp_simple_addr((struct sockaddr *)&addr, sizeof(addr),
                           SNTP_TIMEOUT_MS, &sntp_time);
    if (ret < 0) {
        LOG_ERR("SNTP query failed: %d", ret);
        return ret;
    }

    /* sntp_time.seconds is seconds since 1900; convert to Unix (since 1970) */
    /* NTP epoch offset = 70 years = 2208988800 seconds */
    // *utc_out = (uint32_t)(sntp_time.seconds - 2208988800ULL);
    *utc_out = (uint32_t)(sntp_time.seconds);

    /* Extract milliseconds from NTP fraction field (2^32 per second) */
    uint16_t utc_ms = (uint16_t)(((uint64_t)sntp_time.fraction * 1000ULL) >> 32);

    time_t t = (time_t)(*utc_out);
    struct tm *tm = gmtime(&t);
    LOG_INF("SNTP: UTC = %u", *utc_out);

    LOG_INF("SNTP: UTC = %u (%04d-%02d-%02d %02d:%02d:%02d UTC)",
        *utc_out,
        tm->tm_year + 1900,
        tm->tm_mon + 1,
        tm->tm_mday,
        tm->tm_hour,
        tm->tm_min,
        tm->tm_sec);

    /* Store for sntp_get_last_utc() */
    last_utc_time   = *utc_out;
    last_utc_ms     = utc_ms;
    last_utc_set_ms = k_uptime_get_32();

    return 0;
}

static void sntp_thread(void)
{
    LOG_INF("SNTP sync thread started");

    while (true) {
        uint32_t utc = 0;
        int ret = do_sntp_query(&utc);

        if (ret == 0) {
            /* Forward UTC + ms to BLE gateway via UART 0xCC frame */
            uart_bridge_send_utc(utc, last_utc_ms);
        } else {
            LOG_WRN("SNTP failed (%d), retrying in %d ms",
                    ret, SNTP_RETRY_DELAY_MS);
            k_sleep(K_MSEC(SNTP_RETRY_DELAY_MS));
            continue;
        }

        /* Re-sync every 60 seconds */
        k_sleep(K_SECONDS(SNTP_RESYNC_INTERVAL_S));
    }
}

void sntp_sync_start(void)
{
    k_thread_create(&sntp_tid,
                    sntp_stack,
                    K_THREAD_STACK_SIZEOF(sntp_stack),
                    (k_thread_entry_t)sntp_thread,
                    NULL, NULL, NULL,
                    SNTP_PRIORITY, 0, K_NO_WAIT);
    k_thread_name_set(&sntp_tid, "sntp_sync");
}
```

## src/wifi.c
```c
/*
 * Copyright (c) 2017 ARM Ltd.
 * Copyright (c) 2016 Intel Corporation.
 *
 * SPDX-License-Identifier: Apache-2.0
 */

#include <zephyr/kernel.h>
#include <zephyr/net/net_if.h>
#include <zephyr/net/wifi_mgmt.h>
#include <zephyr/net/net_event.h>
#include <zephyr/logging/log.h>
#include <wifi.h>
#include <env.h>

char wifi_ssid[MAX_SSID_LEN] = CONFIG_WIFI_DEFAULT_SSID;
char wifi_psk [MAX_PSK_LEN]  = CONFIG_WIFI_DEFAULT_PSK;

K_MUTEX_DEFINE(wifi_retry_mutex);

static uint8_t wifi_connection_retry_count = 0;
static char    wifi_rety_dots[WIFI_RETRY_COUNT + 1] = {0};

static K_SEM_DEFINE(wifi_connected, 0, 1);
static K_SEM_DEFINE(ipv4_address_obtained, 0, 1);

static bool got_ipv4 = false;

static struct net_mgmt_event_callback wifi_cb;
static struct net_mgmt_event_callback ipv4_cb;
static struct net_mgmt_event_callback l4_cb;

LOG_MODULE_REGISTER(wifi_module, LOG_LEVEL_INF);

/* -------------------------------------------------------------------------
 * Event handlers
 * ----------------------------------------------------------------------- */

static void handle_wifi_connect_result(struct net_mgmt_event_callback *cb)
{
    const struct wifi_status *status = (const struct wifi_status *)cb->info;

    if (status->status) {
        LOG_ERR("Connection request failed (%d)", status->status);
    } else {
        LOG_INF("WiFi connected");
        k_sem_give(&wifi_connected);
    }
}

static void handle_wifi_disconnect_result(struct net_mgmt_event_callback *cb)
{
    const struct wifi_status *status = (const struct wifi_status *)cb->info;

    if (status->status) {
        LOG_ERR("Disconnection request (%d)", status->status);

        k_mutex_lock(&wifi_retry_mutex, K_FOREVER);
        wifi_rety_dots[wifi_connection_retry_count++] = '.';

        if (wifi_connection_retry_count < WIFI_RETRY_COUNT) {
            k_msleep(1000 * wifi_connection_retry_count); /* exponential backoff */
            LOG_INF("Retrying connection (%d)", wifi_connection_retry_count);
            wifi_connect();
        } else {
            LOG_ERR("Max retries reached");
        }

        k_mutex_unlock(&wifi_retry_mutex);
    } else {
        LOG_INF("WiFi disconnected");
        k_sem_take(&wifi_connected, K_NO_WAIT);
    }
}

static void handle_ipv4_result(struct net_if *iface)
{
    if (got_ipv4) {
        return;
    }

    struct net_if_config *cfg  = net_if_get_config(iface);
    struct net_if_ipv4   *ipv4 = cfg->ip.ipv4;
    char buf[NET_IPV4_ADDR_LEN];

    for (int i = 0; i < NET_IF_MAX_IPV4_ADDR; i++) {
        const struct net_if_addr_ipv4 *u = &ipv4->unicast[i];

        if (u->ipv4.addr_type != NET_ADDR_DHCP) {
            continue;
        }

        net_addr_ntop(AF_INET, &u->ipv4.address.in_addr, buf, sizeof(buf));
        LOG_INF("IP: %s", buf);

        net_addr_ntop(AF_INET, &u->netmask, buf, sizeof(buf));
        LOG_INF("Subnet: %s", buf);

        net_addr_ntop(AF_INET, &ipv4->gw, buf, sizeof(buf));
        LOG_INF("Gateway: %s", buf);

        got_ipv4 = true;
        net_mgmt_del_event_callback(&ipv4_cb);
        k_sem_give(&ipv4_address_obtained);
        break;
    }
}

/* Zephyr 4.x: mgmt_event is uint64_t */
static void wifi_mgmt_event_handler(struct net_mgmt_event_callback *cb,
                                     uint64_t mgmt_event,
                                     struct net_if *iface)
{
    if (mgmt_event == NET_EVENT_WIFI_CONNECT_RESULT) {
        handle_wifi_connect_result(cb);
    } else if (mgmt_event == NET_EVENT_WIFI_DISCONNECT_RESULT) {
        handle_wifi_disconnect_result(cb);
    } else if (mgmt_event == NET_EVENT_IPV4_ADDR_ADD ||
               mgmt_event == NET_EVENT_IPV4_DHCP_BOUND ||
               mgmt_event == NET_EVENT_L4_CONNECTED) {
        handle_ipv4_result(iface);
    }
}

/* -------------------------------------------------------------------------
 * Public API
 * ----------------------------------------------------------------------- */

void wifi_connection_retry_reset(void)
{
    net_mgmt_del_event_callback(&ipv4_cb);
    net_mgmt_del_event_callback(&wifi_cb);
    net_mgmt_del_event_callback(&l4_cb);

    wifi_callbacks_init();

    k_mutex_lock(&wifi_retry_mutex, K_FOREVER);
    wifi_connection_retry_count = 0;
    memset(wifi_rety_dots, 0, sizeof(wifi_rety_dots));
    k_mutex_unlock(&wifi_retry_mutex);
}

void wifi_connect(void)
{
    struct net_if *iface = net_if_get_default();

    struct wifi_connect_req_params wifi_params = {0};
    wifi_params.ssid        = wifi_ssid;
    wifi_params.ssid_length = strlen(wifi_ssid);
    wifi_params.psk         = wifi_psk;
    wifi_params.psk_length  = strlen(wifi_psk);
    wifi_params.channel     = WIFI_CHANNEL_ANY;
    wifi_params.security    = WIFI_SECURITY_TYPE_PSK;
    wifi_params.band        = WIFI_FREQ_BAND_2_4_GHZ;
    wifi_params.mfp         = WIFI_MFP_OPTIONAL;

    LOG_INF("Connecting to SSID: %s", wifi_params.ssid);

    if (net_mgmt(NET_REQUEST_WIFI_CONNECT, iface, &wifi_params,
                 sizeof(struct wifi_connect_req_params))) {
        LOG_ERR("WiFi connection request failed");
    }
}

void wifi_callbacks_init(void)
{
    got_ipv4 = false;

    net_mgmt_init_event_callback(&wifi_cb,
        wifi_mgmt_event_handler,
        NET_EVENT_WIFI_CONNECT_RESULT | NET_EVENT_WIFI_DISCONNECT_RESULT);
    net_mgmt_add_event_callback(&wifi_cb);

    net_mgmt_init_event_callback(&ipv4_cb,
        wifi_mgmt_event_handler,
        NET_EVENT_IPV4_ADDR_ADD | NET_EVENT_IPV4_DHCP_BOUND);
    net_mgmt_add_event_callback(&ipv4_cb);

    net_mgmt_init_event_callback(&l4_cb,
        wifi_mgmt_event_handler,
        NET_EVENT_L4_CONNECTED);
    net_mgmt_add_event_callback(&l4_cb);
}

void wifi_thread(void)
{
    LOG_INF("WiFi thread started");

    wifi_callbacks_init();
    wifi_connect();

    k_sem_take(&wifi_connected, K_FOREVER);
    LOG_INF("WiFi associated");

    k_sem_take(&ipv4_address_obtained, K_FOREVER);
    LOG_INF("IP address obtained — WiFi ready");

    /* Thread exits; main.c proceeds to start azure_mqtt_thread */
}
```
