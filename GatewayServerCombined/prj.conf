## CMakeLists.txt
```
cmake_minimum_required(VERSION 3.20.0)
find_package(Zephyr REQUIRED HINTS $ENV{ZEPHYR_BASE})
project(gateway)

include_directories(include)

FILE(GLOB app_sources src/*.c)
target_sources(app PRIVATE ${app_sources})

zephyr_linker_sources(RAM_SECTIONS ${CMAKE_CURRENT_SOURCE_DIR}/app_dram1.ld)
```

## prj.conf
```kconfig
# ============================================================
# Combined: BLE Central + WiFi + Azure IoT Hub MQTT/TLS
# Target: esp32_devkitc/esp32/procpu
# ============================================================

# –– Core ––
CONFIG_INIT_STACKS=y
CONFIG_MAIN_STACK_SIZE=4096
CONFIG_SYSTEM_WORKQUEUE_STACK_SIZE=4096
CONFIG_PRINTK=y
CONFIG_CBPRINTF_FP_SUPPORT=y

# –– Logging (INFO only — debug logging costs ~15KB DRAM) ––
CONFIG_LOG=y
CONFIG_LOG_DEFAULT_LEVEL=3
CONFIG_LOG_MODE_DEFERRED=n
CONFIG_LOG_BUFFER_SIZE=2048
CONFIG_LOG_BACKEND_UART=y
CONFIG_SHELL=y
CONFIG_SHELL_LOG_BACKEND=n

# –– JSON ––
CONFIG_JSON_LIBRARY=y

# –– UUID (for message IDs) ––
CONFIG_UUID=y
CONFIG_UUID_V4=y

# –– Peripherals ––
CONFIG_GPIO=y
CONFIG_I2C=y
CONFIG_SENSOR=y
CONFIG_RTC=y

# –– Bluetooth Central (GATT client) ––
CONFIG_BT=y
CONFIG_BT_CENTRAL=y
CONFIG_BT_PERIPHERAL=n
CONFIG_BT_GATT_CLIENT=y
CONFIG_BT_MAX_CONN=4
CONFIG_BT_MAX_PAIRED=4
CONFIG_BT_SMP=y
CONFIG_BT_BUF_ACL_RX_SIZE=200
CONFIG_BT_BUF_ACL_TX_SIZE=200
CONFIG_BT_L2CAP_TX_MTU=71
CONFIG_BT_L2CAP_TX_BUF_COUNT=8
CONFIG_BT_CONN_TX_MAX=8

# –– Networking Core ––
CONFIG_NETWORKING=y
CONFIG_NET_MGMT=y
CONFIG_NET_MGMT_EVENT=y
CONFIG_NET_MGMT_EVENT_INFO=y
CONFIG_NET_CONFIG_AUTO_INIT=y
CONFIG_NET_CONFIG_SETTINGS=y
CONFIG_NET_CONFIG_INIT_TIMEOUT=1

# –– WiFi ––
CONFIG_WIFI=y
CONFIG_WIFI_ESP32=y
CONFIG_NET_L2_WIFI_MGMT=y

# –– IP (IPv4 only — drop IPv6 saves ~8KB DRAM) ––
CONFIG_NET_IPV4=y
CONFIG_NET_IPV6=n
CONFIG_NET_ARP=y

# –– DHCP ––
CONFIG_NET_DHCPV4=y

# –– Sockets ––
CONFIG_NET_TCP=y
CONFIG_NET_SOCKETS=y
CONFIG_POSIX_API=y

# –– DNS ––
CONFIG_DNS_RESOLVER=y
CONFIG_DNS_RESOLVER_AI_MAX_ENTRIES=4

# –– MQTT ––
CONFIG_MQTT_LIB=y
CONFIG_MQTT_LIB_TLS=y
CONFIG_MQTT_KEEPALIVE=60

# –– TLS / MbedTLS ––
CONFIG_TLS_CREDENTIALS=y
CONFIG_NET_SOCKETS_SOCKOPT_TLS=y
CONFIG_NET_SOCKETS_TLS_MAX_CONTEXTS=2
CONFIG_MBEDTLS=y
CONFIG_MBEDTLS_BUILTIN=y
CONFIG_MBEDTLS_ENABLE_HEAP=y
CONFIG_MBEDTLS_HEAP_SIZE=45000
CONFIG_MBEDTLS_SSL_MAX_CONTENT_LEN=4096
CONFIG_MBEDTLS_PEM_CERTIFICATE_FORMAT=y
CONFIG_MBEDTLS_TLS_VERSION_1_2=y
CONFIG_MBEDTLS_SERVER_NAME_INDICATION=y
CONFIG_MBEDTLS_CIPHER_AES_ENABLED=y
CONFIG_MBEDTLS_CIPHER_GCM_ENABLED=y
CONFIG_MBEDTLS_ECDH_C=y
CONFIG_MBEDTLS_ECP_C=y
CONFIG_MBEDTLS_PKCS1_V15=y
CONFIG_MBEDTLS_KEY_EXCHANGE_ECDHE_RSA_ENABLED=y
CONFIG_MBEDTLS_ECP_DP_SECP256R1_ENABLED=y
CONFIG_MBEDTLS_RSA_C=y

# –– Network Buffers (trimmed) ––
CONFIG_NET_TX_STACK_SIZE=2048
CONFIG_NET_RX_STACK_SIZE=2048
CONFIG_NET_PKT_RX_COUNT=8
CONFIG_NET_PKT_TX_COUNT=8
CONFIG_NET_BUF_RX_COUNT=16
CONFIG_NET_BUF_TX_COUNT=16
CONFIG_NET_BUF_DATA_SIZE=512
CONFIG_NET_MAX_CONTEXTS=6

# –– Heap ––
CONFIG_HEAP_MEM_POOL_SIZE=52000
```

## src/main.c
```c
/*
 * main.c — Combined BLE Central + WiFi + Azure IoT Hub Gateway
 *
 * Boot sequence:
 *   1. WiFi thread connects and obtains IP (blocks up to 30s)
 *   2. Azure MQTT thread starts — connects to IoT Hub
 *   3. BLE threads start — scan, connect, receive, publish
 */

#include <zephyr/kernel.h>
#include <zephyr/logging/log.h>

#include "wifi.h"
#include "azure_mqtt.h"
// #include "bluetooth.h"

LOG_MODULE_REGISTER(main, LOG_LEVEL_INF);

#define WIFI_THREAD_STACK  4096
#define WIFI_THREAD_PRIO   6

K_THREAD_STACK_DEFINE(wifi_stack, WIFI_THREAD_STACK);
static struct k_thread wifi_tid;

// /* BLE threads — defined here so WiFi/Azure are up first */
// K_THREAD_DEFINE(process_data_tid,
//                 BASE_PROCESS_STACK_SIZE,
//                 process_data_thread,
//                 NULL, NULL, NULL,
//                 BASE_PROCESS_PRIORITY, 0,
//                 2000);   /* 2s delay — wait for Azure to connect */

// K_THREAD_DEFINE(base_tid,
//                 BASE_CONTROL_STACK_SIZE,
//                 base_thread,
//                 NULL, NULL, NULL,
//                 BASE_CONTROL_PRIORITY, 0,
//                 2000);   /* 2s delay — wait for Azure to connect */

int main(void)
{
    LOG_INF("=== BLE→Azure Gateway starting ===");

    /* Start WiFi — blocks until IP obtained or 30s timeout */
    k_thread_create(&wifi_tid,
                    wifi_stack,
                    K_THREAD_STACK_SIZEOF(wifi_stack),
                    (k_thread_entry_t)wifi_thread,
                    NULL, NULL, NULL,
                    WIFI_THREAD_PRIO, 0, K_NO_WAIT);
    k_thread_name_set(&wifi_tid, "wifi");
    k_thread_join(&wifi_tid, K_SECONDS(30));

    LOG_INF("WiFi ready — starting Azure MQTT");
    azure_mqtt_thread_start();

    /* BLE threads start automatically after their 2s delay (K_THREAD_DEFINE above) */

    return 0;
}
```

## include/bluetooth.h
```c
#ifndef BASE_SERVICE_H
#define BASE_SERVICE_H

#include <zephyr/kernel.h>
#include <zephyr/types.h>
#include <zephyr/sys/printk.h>
#include <zephyr/bluetooth/bluetooth.h>
#include <zephyr/bluetooth/conn.h>
#include <zephyr/bluetooth/gatt.h>
#include <zephyr/bluetooth/hci.h>
#include <zephyr/bluetooth/uuid.h>

#define BASE_CONTROL_STACK_SIZE 2048
#define BASE_CONTROL_PRIORITY   5

#define BASE_PROCESS_STACK_SIZE 6144   /* needs headroom for 4 KB sound JSON encode */
#define BASE_PROCESS_PRIORITY   5

#define MAX_CONN 4   /* maximum simultaneous BLE peripheral connections */

extern void process_data_thread(void);
extern void base_thread(void);

#endif /* BASE_SERVICE_H */
```

## include/my_json.h
```c
#ifndef BASE_JSON_H
#define BASE_JSON_H

#include <zephyr/kernel.h>
#include <stdint.h>

/* ── Buffer sizes ───────────────────────────────────────── */
#define JSON_BUFFER_SIZE        1600   /* sensor telemetry JSON (increased for soil field) */
#define SOUND_JSON_BUFFER_SIZE  3072  // was 4096, 2600 actual worst case + margin

/* ── AS7343 ─────────────────────────────────────────────── */
#define AS7343_NUM_CH  13

/* ── AS7343 wavelength table ─────────────────────────────── */
extern const uint16_t AS7343_WL[AS7343_NUM_CH];

/* ── Sound ──────────────────────────────────────────────── */
#define SOUND_NUM_BINS  348

/* ═══════════════════════════════════════════════════════════
 * Sensor packet payload  (61-byte UART frame, magic 0xAA)
 *
 * Byte layout:
 *   [0..3]   time              uint32 BE — UTC seconds
 *   [4..5]   time_ms           uint16 BE — UTC milliseconds (0–999)
 *   [6..9]   uptime_ms         uint32 BE
 *   [10]     proto_ver
 *   [11]     dev_id
 *   [12..13] temp_c_x100       int16  BE
 *   [14..15] rh_x100           int16  BE
 *   [16..19] press_hPa_x1000   int32  BE
 *   [20..21] eco2_ppm          uint16 BE
 *   [22..23] tvoc_ppb          uint16 BE
 *   [24]     aqi
 *   [25..50] AS7343 ×13        uint16 BE each (26 bytes)
 *   [51..52] batt_mV           uint16 BE
 *   [53..54] snd_rms_dbfs_x100 int16  BE
 *   [55..56] snd_peak_freq_hz  uint16 BE
 *   [57..58] snd_peak_mag_x10  uint16 BE
 *   [59..60] soil_vwc_x100     uint16 BE — VWC % × 100 (0–10000)
 * ═══════════════════════════════════════════════════════════ */
typedef struct {
    uint32_t time;
    uint16_t time_ms;          /* UTC sub-second milliseconds (0–999)    */
    uint32_t uptime_ms;
    uint8_t  proto_ver;
    uint8_t  dev_id;

    int16_t  temp_c_x100;
    int16_t  rh_x100;
    int32_t  press_hPa_x1000;

    uint16_t eco2_ppm;
    uint16_t tvoc_ppb;
    uint8_t  aqi;

    uint16_t as7343[AS7343_NUM_CH];
    uint16_t batt_mV;

    int16_t  snd_rms_dbfs_x100;
    uint16_t snd_peak_freq_hz;
    uint16_t snd_peak_mag_x10;

    uint16_t soil_vwc_x100;    /* VWC % × 100, e.g. 4567 = 45.67%       */
} tracker_payload_t;

/* ═══════════════════════════════════════════════════════════
 * Sound spectrum payload  (698-byte UART frame, magic 0xBB)
 * ═══════════════════════════════════════════════════════════ */
typedef struct {
    uint8_t  dev_id;
    uint32_t uptime_ms;
    int16_t  rms_dbfs_x100;
    uint16_t bins[SOUND_NUM_BINS];
} sound_payload_t;

/* ── JSON struct blocks (sensor telemetry) ───────────────── */
struct json_payload_environment {
    double   temperature_c;
    double   humidity_percent;
    double   pressure_hpa;
    uint16_t eco2_ppm;
    uint16_t tvoc_ppb;
    uint8_t  aqi;
    uint16_t batt_mV;
};

struct json_payload_spectrum {
    uint16_t AS7343_405nm;
    uint16_t AS7343_425nm;
    uint16_t AS7343_450nm;
    uint16_t AS7343_475nm;
    uint16_t AS7343_515nm;
    uint16_t AS7343_550nm;
    uint16_t AS7343_555nm;
    uint16_t AS7343_600nm;
    uint16_t AS7343_640nm;
    uint16_t AS7343_690nm;
    uint16_t AS7343_745nm;
    uint16_t AS7343_855nm;
    uint16_t AS7343_VISIBLE;
};

struct json_payload_sound_summary {
    double   rms_dbfs;
    uint16_t peak_freq_hz;
    double   peak_mag;
};

struct json_payload {
    char     deviceId[20];
    char     timestamp[72];
    uint32_t uptime_ms;
    uint8_t  proto_ver;
    struct json_payload_environment   environment;
    struct json_payload_spectrum      spectrum;
    struct json_payload_sound_summary sound;
    double   soil_vwc;          /* VWC % as double, e.g. 45.67           */
};

struct json_header {
    char messageId[40];
    char gatewayId[12];
    char schemaVersion[8];
    char messageType[16];
};

struct json_signature {
    char alg[16];
    char keyId[24];
    char value[65];
};

struct json_full_packet {
    struct json_header    header;
    struct json_payload   payload;
    struct json_signature signature;
};

extern const char JSON_FORMAT[];

/* ── Public API ─────────────────────────────────────────── */
void fill_json_packet(const tracker_payload_t *payload,
                      struct json_full_packet  *packet);

void encode_and_print_json(const struct json_full_packet *packet);

int encode_sound_json(const sound_payload_t *sp, char *buf, size_t buf_size);

#endif /* BASE_JSON_H */
```

## src/azure_mqtt.c
```c
/*
 * azure_mqtt.c — Azure IoT Hub MQTT/TLS client for Zephyr 4.x / ESP32
 */

#include "azure_mqtt.h"

#include <zephyr/kernel.h>
#include <zephyr/logging/log.h>
#include <zephyr/net/mqtt.h>
#include <zephyr/net/socket.h>
#include <zephyr/net/tls_credentials.h>
#include <zephyr/random/random.h>
#include <string.h>
#include <errno.h>

LOG_MODULE_REGISTER(azure_mqtt, LOG_LEVEL_DBG);

/* -------------------------------------------------------------------------
 * Buffers and state
 * ----------------------------------------------------------------------- */
static struct mqtt_client     client;
static struct sockaddr_storage broker_addr;

static uint8_t rx_buf[1024];
static uint8_t tx_buf[1024];
static uint8_t payload_buf[1400];

static bool connected = false;

/* -------------------------------------------------------------------------
 * TLS credentials
 * ----------------------------------------------------------------------- */
static const char root_ca[] = AZURE_ROOT_CA_CERT;

static int tls_credentials_register(void)
{
    int ret = tls_credential_add(AZURE_TLS_TAG,
                                 TLS_CREDENTIAL_CA_CERTIFICATE,
                                 root_ca, sizeof(root_ca));
    if (ret < 0 && ret != -EEXIST) {LOG_INF("Client ID bytes: %d", (int)client.client_id.size);
        LOG_ERR("Failed to register CA cert: %d", ret);
        return ret;
    }
    return 0;
}

/* -------------------------------------------------------------------------
 * DNS resolution
 * ----------------------------------------------------------------------- */
static int resolve_broker(void)
{
    struct zsock_addrinfo hints = {
        .ai_family   = AF_INET,
        .ai_socktype = SOCK_STREAM,
    };
    struct zsock_addrinfo *res = NULL;
    char port_str[8];

    snprintf(port_str, sizeof(port_str), "%d", AZURE_MQTT_PORT);

    LOG_INF("Resolving %s ...", AZURE_IOT_HUB_HOSTNAME);
    int ret = zsock_getaddrinfo(AZURE_IOT_HUB_HOSTNAME, port_str, &hints, &res);
    if (ret != 0) {
        LOG_ERR("DNS failed: %d (errno %d)", ret, errno);
        return -ENETUNREACH;
    }

    memcpy(&broker_addr, res->ai_addr, res->ai_addrlen);
    zsock_freeaddrinfo(res);
    LOG_INF("DNS resolved");
    return 0;
}

/* -------------------------------------------------------------------------
 * MQTT event callback
 * ----------------------------------------------------------------------- */
static void mqtt_evt_handler(struct mqtt_client *c, const struct mqtt_evt *evt)
{
    switch (evt->type) {
    case MQTT_EVT_CONNACK:
        if (evt->result == 0) {
            LOG_INF("CONNACK: connected to Azure IoT Hub");
            connected = true;
        } else {
            LOG_ERR("CONNACK error: %d", evt->result);
        }
        break;
    case MQTT_EVT_DISCONNECT:
        LOG_WRN("Disconnected: %d", evt->result);
        connected = false;
        break;
    case MQTT_EVT_PUBACK:
        LOG_DBG("PUBACK mid=%u", evt->param.puback.message_id);
        break;
    case MQTT_EVT_PINGRESP:
        LOG_DBG("PINGRESP");
        break;
    default:
        LOG_DBG("MQTT evt %d", evt->type);
        break;
    }
}

static int do_connect(void)
{
    struct addrinfo *result;
    struct sockaddr_in *broker4;
    char port_str[8];
    static sec_tag_t sec_tags[] = { AZURE_TLS_TAG };
    struct mqtt_sec_config *tls_config;

    const struct addrinfo hints = {
        .ai_family   = AF_INET,
        .ai_socktype = SOCK_STREAM,
    };

    snprintf(port_str, sizeof(port_str), "%d", AZURE_MQTT_PORT);

    LOG_INF("Resolving %s ...", AZURE_IOT_HUB_HOSTNAME);
    int ret = getaddrinfo(AZURE_IOT_HUB_HOSTNAME, port_str, &hints, &result);
    if (ret != 0) {
        LOG_ERR("DNS failed: %d", ret);
        return -ENETUNREACH;
    }

    broker4 = (struct sockaddr_in *)&broker_addr;
    broker4->sin_addr.s_addr =
        ((struct sockaddr_in *)result->ai_addr)->sin_addr.s_addr;
    broker4->sin_family = AF_INET;
    broker4->sin_port =
        ((struct sockaddr_in *)result->ai_addr)->sin_port;
    freeaddrinfo(result);
    LOG_INF("DNS resolved");

    static const char username_str[] = AZURE_MQTT_USERNAME;
    static const char password_str[] = AZURE_SAS_TOKEN;
    static const char client_id_str[] = AZURE_MQTT_CLIENT_ID;

    static struct mqtt_utf8 password;
    static struct mqtt_utf8 username;

    password.utf8 = (uint8_t *)password_str;
    password.size = strlen(password_str);
    username.utf8 = (uint8_t *)username_str;
    username.size = strlen(username_str);

    mqtt_client_init(&client);
    client.broker           = &broker_addr;
    client.evt_cb           = mqtt_evt_handler;
    client.client_id.utf8   = (uint8_t *)client_id_str;
    client.client_id.size   = strlen(client_id_str);
    client.password         = &password;
    client.user_name        = &username;
    client.protocol_version = MQTT_VERSION_3_1_1;
    client.rx_buf           = rx_buf;
    client.rx_buf_size      = sizeof(rx_buf);
    client.tx_buf           = tx_buf;
    client.tx_buf_size      = sizeof(tx_buf);
    client.transport.type   = MQTT_TRANSPORT_SECURE;
    client.keepalive        = CONFIG_MQTT_KEEPALIVE;
    client.clean_session    = 1;

    /* Set TLS config via pointer — same pattern as Zephyr sample */
    tls_config = &client.transport.tls.config;
    tls_config->peer_verify   = TLS_PEER_VERIFY_REQUIRED;
    tls_config->cipher_list   = NULL;
    tls_config->sec_tag_list  = sec_tags;
    tls_config->sec_tag_count = ARRAY_SIZE(sec_tags);
    tls_config->hostname      = AZURE_IOT_HUB_HOSTNAME;

    LOG_INF("MQTT connecting to %s:%d ...", AZURE_IOT_HUB_HOSTNAME, AZURE_MQTT_PORT);

    ret = mqtt_connect(&client);
    if (ret < 0) {
        LOG_ERR("mqtt_connect failed: %d", ret);
        return ret;
    }

    /* Poll for CONNACK — same pattern as sample */
    struct zsock_pollfd fds = {
        .fd     = client.transport.tls.sock,
        .events = ZSOCK_POLLIN,
    };

    int rc = zsock_poll(&fds, 1, 5000);
    if (rc > 0) {
        mqtt_input(&client);
    }

    if (!connected) {
        LOG_ERR("CONNACK failed or timeout");
        mqtt_abort(&client);
        return -ETIMEDOUT;
    }

    return 0;
}

/* -------------------------------------------------------------------------
 * Connect
 * ----------------------------------------------------------------------- */
// static int do_connect(void)
// {
//     int ret = resolve_broker();
//     if (ret < 0) {
//         return ret;
//     }

//     static sec_tag_t sec_tags[] = { AZURE_TLS_TAG };

//     // struct mqtt_sec_config tls_cfg = {
//     //     // .peer_verify  = TLS_PEER_VERIFY_REQUIRED,
//     //     .peer_verify  = TLS_PEER_VERIFY_NONE,
//     //     .cipher_list  = NULL,
//     //     .sec_tag_list = sec_tags,
//     //     .sec_tag_count = ARRAY_SIZE(sec_tags),
//     //     .hostname     = AZURE_IOT_HUB_HOSTNAME,
//     // };
//     static struct mqtt_sec_config tls_cfg = {
//         .peer_verify   = TLS_PEER_VERIFY_NONE,
//         .cipher_list   = NULL,
//         .sec_tag_list  = sec_tags,
//         .sec_tag_count = ARRAY_SIZE(sec_tags),
//         .hostname      = AZURE_IOT_HUB_HOSTNAME,
//     };

//     static const char username_str[] = AZURE_MQTT_USERNAME;
//     static const char password_str[] = AZURE_SAS_TOKEN;

//     struct mqtt_utf8 password = {
//         .utf8 = (uint8_t *)password_str,
//         .size = strlen(password_str),
//     };
//     struct mqtt_utf8 username = {
//         .utf8 = (uint8_t *)username_str,
//         .size = strlen(username_str),
//     };

//     static const char client_id[] = AZURE_MQTT_CLIENT_ID;
    
//     mqtt_client_init(&client);
//     client.broker           = &broker_addr;
//     client.evt_cb           = mqtt_evt_handler;
//     client.client_id.utf8 = (uint8_t *)client_id;
//     client.client_id.size = strlen(client_id);
//     client.password         = &password;
//     client.user_name        = &username;
//     client.protocol_version = MQTT_VERSION_3_1_1;
//     client.rx_buf           = rx_buf;
//     client.rx_buf_size      = sizeof(rx_buf);
//     client.tx_buf           = tx_buf;
//     client.tx_buf_size      = sizeof(tx_buf);
//     client.transport.type   = MQTT_TRANSPORT_SECURE;
//     client.transport.tls.config = tls_cfg;
//     client.keepalive        = CONFIG_MQTT_KEEPALIVE;
//     client.clean_session    = 0;

//     LOG_INF("Client ID: %s (%d)", AZURE_MQTT_CLIENT_ID, (int)strlen(AZURE_MQTT_CLIENT_ID));
//     LOG_INF("Username: %s (%d)", AZURE_MQTT_USERNAME, (int)strlen(AZURE_MQTT_USERNAME));
//     LOG_INF("Token length: %d", (int)strlen(AZURE_SAS_TOKEN));
//     LOG_INF("Token start: %.50s", AZURE_SAS_TOKEN);
//     LOG_INF("Client ID bytes: %d", (int)client.client_id.size);
//     LOG_HEXDUMP_INF((uint8_t *)AZURE_SAS_TOKEN, 
//                 MIN(strlen(AZURE_SAS_TOKEN), 64),
//                 "Token hex:");

//     struct sockaddr_in *addr = (struct sockaddr_in *)&broker_addr;
//     LOG_INF("Broker IP port: %d", ntohs(addr->sin_port));

//     LOG_INF("MQTT connecting to %s:%d ...", AZURE_IOT_HUB_HOSTNAME, AZURE_MQTT_PORT);
//     LOG_INF("Connect flags check - password ptr: %p, username ptr: %p",
//         (void*)client.password, (void*)client.user_name);
    
//     ret = mqtt_connect(&client);
//     if (ret < 0) {
//         LOG_ERR("mqtt_connect failed: %d", ret);
//         return ret;
//     }
//     LOG_INF("Transport sock: %d", client.transport.tls.sock);

//     /* Poll for CONNACK */
//     struct zsock_pollfd fds = {
//         .fd     = client.transport.tls.sock,
//         .events = ZSOCK_POLLIN,
//     };

//     for (int i = 0; i < 20 && !connected; i++) {
//         if (zsock_poll(&fds, 1, 1000) > 0) {
//             mqtt_input(&client);
//         }
//         mqtt_live(&client);
//     }

//     if (!connected) {
//         LOG_ERR("CONNACK timeout");
//         mqtt_disconnect(&client, NULL);
//         return -ETIMEDOUT;
//     }

//     return 0;
// }

/* -------------------------------------------------------------------------
 * Public API
 * ----------------------------------------------------------------------- */
int azure_mqtt_connect(void)
{
    int ret = tls_credentials_register();
    if (ret < 0) {
        return ret;
    }
    return do_connect();
}

int azure_mqtt_publish(const char *json)
{
    if (!connected) {
        LOG_WRN("Not connected — skipping publish");
        return -ENOTCONN;
    }

    size_t len = strlen(json);
    if (len >= sizeof(payload_buf)) {
        LOG_ERR("Payload too large: %zu", len);
        return -EMSGSIZE;
    }
    memcpy(payload_buf, json, len);

    struct mqtt_publish_param pub = {
        .message = {
            .topic = {
                .qos   = MQTT_QOS_1_AT_LEAST_ONCE,
                .topic = {
                    .utf8 = (uint8_t *)AZURE_MQTT_TOPIC,
                    .size = strlen(AZURE_MQTT_TOPIC),
                },
            },
            .payload = {
                .data = payload_buf,
                .len  = len,
            },
        },
        .message_id  = (uint16_t)sys_rand32_get(),
        .dup_flag    = 0,
        .retain_flag = 0,
    };

    int ret = mqtt_publish(&client, &pub);
    if (ret < 0) {
        LOG_ERR("mqtt_publish failed: %d", ret);
        connected = false;
        return ret;
    }

    LOG_INF("Published %zu bytes", len);
    return 0;
}

void azure_mqtt_process(void)
{
    if (!connected) {
        return;
    }

    struct zsock_pollfd fds = {
        .fd     = client.transport.tls.sock,
        .events = ZSOCK_POLLIN,
    };

    if (zsock_poll(&fds, 1, 0) > 0) {
        mqtt_input(&client);
    }
    mqtt_live(&client);
}

/* -------------------------------------------------------------------------
 * Background thread
 * ----------------------------------------------------------------------- */
#define AZURE_MQTT_STACK     8192
#define AZURE_MQTT_PRIO      7
#define PUBLISH_INTERVAL_MS  30000
#define RECONNECT_DELAY_MS   10000

K_THREAD_STACK_DEFINE(azure_mqtt_stack, AZURE_MQTT_STACK);
static struct k_thread azure_mqtt_tid;

static void build_telemetry_json(char *buf, size_t buf_size, uint32_t uptime_s)
{
    /*
     * Replace the literal sensor strings below with live readings
     * from your IMU / BME680 / GPS drivers once wired up.
     */
    snprintf(buf, buf_size,
        "{"
          "\"header\":{"
            "\"messageId\":\"%08X%08X\","
            "\"gatewayId\":\"GW-01\","
            "\"schemaVersion\":\"1.0\","
            "\"messageType\":\"telemetry\""
          "},"
          "\"payload\":{"
            "\"deviceId\":\"" AZURE_DEVICE_ID "\","
            "\"timestamp\":\"%u\","
            "\"uptime\":\"%u\","
            "\"location\":{"
              "\"latitude\":\"27.5002432\",\"ns\":\"S\","
              "\"longitude\":\"153.0153600\",\"ew\":\"E\","
              "\"altitude_m\":\"0.0\""
            "},"
            "\"environment\":{"
              "\"temperature_c\":\"26.22\","
              "\"humidity_percent\":\"69.00\","
              "\"pressure_hpa\":\"102.3\","
              "\"gas_ppm\":\"28.00\""
            "},"
            "\"acceleration\":{"
              "\"x_mps2\":\"2.413\","
              "\"y_mps2\":\"-0.459\","
              "\"z_mps2\":\"-6.511\""
            "}"
          "},"
          "\"signature\":{"
            "\"alg\":\"HS256\","
            "\"keyId\":\"key-001\","
            "\"value\":\"FBDA00C64513C32B027DA202C4C0574E86CE9FE462C42B8BB3B7734380810DA8\""
          "}"
        "}",
        sys_rand32_get(), sys_rand32_get(),
        uptime_s, uptime_s
    );
}

void azure_mqtt_thread(void)
{
    static char json_buf[1300];

    LOG_INF("azure_mqtt_thread started");

    while (true) {
        if (!connected) {
            LOG_INF("Connecting to Azure IoT Hub ...");
            int ret = azure_mqtt_connect();
            if (ret < 0) {
                LOG_ERR("Connection failed (%d), retrying in %d s",
                        ret, RECONNECT_DELAY_MS / 1000);
                k_sleep(K_MSEC(RECONNECT_DELAY_MS));
                continue;
            }
        }

        azure_mqtt_process();

        static int64_t last_pub = 0;
        int64_t now = k_uptime_get();

        if (now - last_pub >= PUBLISH_INTERVAL_MS) {
            last_pub = now;
            build_telemetry_json(json_buf, sizeof(json_buf),
                                 (uint32_t)(now / 1000));
            azure_mqtt_publish(json_buf);
        }

        k_sleep(K_MSEC(500));
    }
}

void azure_mqtt_thread_start(void)
{
    k_thread_create(&azure_mqtt_tid,
                    azure_mqtt_stack,
                    K_THREAD_STACK_SIZEOF(azure_mqtt_stack),
                    (k_thread_entry_t)azure_mqtt_thread,
                    NULL, NULL, NULL,
                    AZURE_MQTT_PRIO, 0, K_NO_WAIT);
    k_thread_name_set(&azure_mqtt_tid, "azure_mqtt");
}
```

## src/my_json.c
```c
#include <zephyr/logging/log.h>
#include <zephyr/logging/log_ctrl.h>
#include <zephyr/sys/uuid.h>
#include "my_json.h"
#include <string.h>
#include <stdio.h>
#include <time.h>

LOG_MODULE_REGISTER(json_module);

const uint16_t AS7343_WL[AS7343_NUM_CH] = {
    405, 425, 450, 475, 515, 550, 555, 600, 640, 690, 745, 855, 999
};

/* ── Sensor telemetry JSON format string ─────────────────── */
const char JSON_FORMAT[] =
    "{"
      "\"header\":{"
        "\"messageId\":\"%s\","
        "\"gatewayId\":\"%s\","
        "\"schemaVersion\":\"%s\","
        "\"messageType\":\"%s\""
      "},"
      "\"payload\":{"
        "\"deviceId\":\"%s\","
        "\"timestamp\":\"%s\","
        "\"uptime_ms\":%u,"
        "\"proto_ver\":%u,"
        "\"environment\":{"
          "\"temperature_c\":%.2f,"
          "\"humidity_percent\":%.2f,"
          "\"pressure_hpa\":%.3f,"
          "\"eco2_ppm\":%u,"
          "\"tvoc_ppb\":%u,"
          "\"aqi\":%u,"
          "\"batt_mV\":%u"
        "},"
        "\"spectrum\":{"
          "\"AS7343_405nm\":%u,"
          "\"AS7343_425nm\":%u,"
          "\"AS7343_450nm\":%u,"
          "\"AS7343_475nm\":%u,"
          "\"AS7343_515nm\":%u,"
          "\"AS7343_550nm\":%u,"
          "\"AS7343_555nm\":%u,"
          "\"AS7343_600nm\":%u,"
          "\"AS7343_640nm\":%u,"
          "\"AS7343_690nm\":%u,"
          "\"AS7343_745nm\":%u,"
          "\"AS7343_855nm\":%u,"
          "\"AS7343_VISIBLE\":%u"
        "},"
        "\"sound\":{"
          "\"rms_dbfs\":%.2f,"
          "\"peak_freq_hz\":%u,"
          "\"peak_mag\":%.1f"
        "},"
        "\"soil\":{"
          "\"vwc_percent\":%.2f"
        "}"
      "}"
    "}";

/* ── UUID helper ────────────────────────────────────────── */
static void generate_uuid(char *uuid_str)
{
    struct uuid u;
    if (uuid_generate_v4(&u) != 0) { uuid_str[0] = '\0'; return; }
    if (uuid_to_string(&u, uuid_str) != 0) { uuid_str[0] = '\0'; }
}

/* ── fill_json_packet ───────────────────────────────────── */
void fill_json_packet(const tracker_payload_t *p, struct json_full_packet *j)
{
    if (!p || !j) return;
    memset(j, 0, sizeof(*j));

    /* Header */
    char uuid_str[UUID_STR_LEN] = {0};
    generate_uuid(uuid_str);
    snprintk(j->header.messageId, sizeof(j->header.messageId),
             "%s", uuid_str[0] ? uuid_str : "00000000-0000-0000-0000-000000000000");
    snprintk(j->header.gatewayId,     sizeof(j->header.gatewayId),     "GW-01");
    snprintk(j->header.schemaVersion, sizeof(j->header.schemaVersion), "1");
    snprintk(j->header.messageType,   sizeof(j->header.messageType),   "telemetry");

    /* Payload — top level */
    snprintk(j->payload.deviceId, sizeof(j->payload.deviceId), "dev-%u", p->dev_id);

    time_t raw = (time_t)p->time;
    struct tm tm_utc;
    if (gmtime_r(&raw, &tm_utc) == NULL) {
        snprintk(j->payload.timestamp, sizeof(j->payload.timestamp), "%u", p->time);
    } else {
        snprintk(j->payload.timestamp, sizeof(j->payload.timestamp),
                 "%04d-%02d-%02dT%02d:%02d:%02d.%03uZ",
                 tm_utc.tm_year + 1900, tm_utc.tm_mon + 1, tm_utc.tm_mday,
                 tm_utc.tm_hour, tm_utc.tm_min, tm_utc.tm_sec, p->time_ms);
    }
    j->payload.uptime_ms = p->uptime_ms;
    j->payload.proto_ver = p->proto_ver;

    /* Environment */
    j->payload.environment.temperature_c    = (double)p->temp_c_x100    / 100.0;
    j->payload.environment.humidity_percent = (double)p->rh_x100        / 100.0;
    j->payload.environment.pressure_hpa     = (double)p->press_hPa_x1000 / 1000.0;
    j->payload.environment.eco2_ppm = p->eco2_ppm;
    j->payload.environment.tvoc_ppb = p->tvoc_ppb;
    j->payload.environment.aqi      = p->aqi;
    j->payload.environment.batt_mV  = p->batt_mV;

    /* AS7343 light spectrum */
    j->payload.spectrum.AS7343_405nm   = p->as7343[0];
    j->payload.spectrum.AS7343_425nm   = p->as7343[1];
    j->payload.spectrum.AS7343_450nm   = p->as7343[2];
    j->payload.spectrum.AS7343_475nm   = p->as7343[3];
    j->payload.spectrum.AS7343_515nm   = p->as7343[4];
    j->payload.spectrum.AS7343_550nm   = p->as7343[5];
    j->payload.spectrum.AS7343_555nm   = p->as7343[6];
    j->payload.spectrum.AS7343_600nm   = p->as7343[7];
    j->payload.spectrum.AS7343_640nm   = p->as7343[8];
    j->payload.spectrum.AS7343_690nm   = p->as7343[9];
    j->payload.spectrum.AS7343_745nm   = p->as7343[10];
    j->payload.spectrum.AS7343_855nm   = p->as7343[11];
    j->payload.spectrum.AS7343_VISIBLE = p->as7343[12];

    /* Sound summary */
    j->payload.sound.rms_dbfs     = (double)p->snd_rms_dbfs_x100 / 100.0;
    j->payload.sound.peak_freq_hz = p->snd_peak_freq_hz;
    j->payload.sound.peak_mag     = (double)p->snd_peak_mag_x10  / 10.0;

    /* Soil moisture */
    j->payload.soil_vwc = (double)p->soil_vwc_x100 / 100.0;
}

/* ── encode_and_print_json ──────────────────────────────── */
void encode_and_print_json(const struct json_full_packet *j)
{
    static char json_output[JSON_BUFFER_SIZE]   __attribute__((section(".ext_ram.bss"))); 

    int ret = snprintk(json_output, sizeof(json_output),
        JSON_FORMAT,
        j->header.messageId,
        j->header.gatewayId,
        j->header.schemaVersion,
        j->header.messageType,
        j->payload.deviceId,
        j->payload.timestamp,
        j->payload.uptime_ms,
        j->payload.proto_ver,
        j->payload.environment.temperature_c,
        j->payload.environment.humidity_percent,
        j->payload.environment.pressure_hpa,
        j->payload.environment.eco2_ppm,
        j->payload.environment.tvoc_ppb,
        j->payload.environment.aqi,
        j->payload.environment.batt_mV,
        j->payload.spectrum.AS7343_405nm,
        j->payload.spectrum.AS7343_425nm,
        j->payload.spectrum.AS7343_450nm,
        j->payload.spectrum.AS7343_475nm,
        j->payload.spectrum.AS7343_515nm,
        j->payload.spectrum.AS7343_550nm,
        j->payload.spectrum.AS7343_555nm,
        j->payload.spectrum.AS7343_600nm,
        j->payload.spectrum.AS7343_640nm,
        j->payload.spectrum.AS7343_690nm,
        j->payload.spectrum.AS7343_745nm,
        j->payload.spectrum.AS7343_855nm,
        j->payload.spectrum.AS7343_VISIBLE,
        j->payload.sound.rms_dbfs,
        j->payload.sound.peak_freq_hz,
        j->payload.sound.peak_mag,
        j->payload.soil_vwc
    );

    if (ret > 0 && ret < (int)sizeof(json_output)) {
        printk("%s\n", json_output);
    } else {
        printk("JSON encoding failed (ret=%d)\n", ret);
    }
    log_flush();
}

/* ── encode_sound_json ──────────────────────────────────── */
int encode_sound_json(const sound_payload_t *sp, char *buf, size_t buf_size)
{
    if (!sp || !buf) return -EINVAL;

    char uuid_str[UUID_STR_LEN] = {0};
    generate_uuid(uuid_str);

    /* Fixed header section */
    int pos = snprintk(buf, buf_size,
        "{"
          "\"header\":{"
            "\"messageId\":\"%s\","
            "\"gatewayId\":\"GW-01\","
            "\"schemaVersion\":\"1\","
            "\"messageType\":\"sound_spectrum\""
          "},"
          "\"payload\":{"
            "\"deviceId\":\"dev-%u\","
            "\"uptime_ms\":%u,"
            "\"rms_dbfs\":%.2f,"
            "\"bin_low_hz\":43,"
            "\"bin_res_hz\":43,"
            "\"bins\":[",
        uuid_str[0] ? uuid_str : "00000000-0000-0000-0000-000000000000",
        (unsigned)sp->dev_id,
        (unsigned)sp->uptime_ms,
        (double)sp->rms_dbfs_x100 / 100.0
    );

    if (pos <= 0 || (size_t)pos >= buf_size) return -ENOMEM;

    /* 348 bin values — built iteratively to avoid a giant format string */
    for (int i = 0; i < SOUND_NUM_BINS; i++) {
        double mag = (double)sp->bins[i] / 10.0;
        int w = snprintk(buf + pos, buf_size - pos,
                         (i < SOUND_NUM_BINS - 1) ? "%.1f," : "%.1f", mag);
        if (w <= 0 || (size_t)(pos + w) >= buf_size) {
            LOG_ERR("Sound JSON buffer overflow at bin %d", i);
            return -ENOMEM;
        }
        pos += w;
    }

    /* Close */
    int tail = snprintk(buf + pos, buf_size - pos, "]}}");
    if (tail <= 0) return -ENOMEM;
    pos += tail;

    return pos;
}
```

## src/sntp_sync.c
```c
/*
 * sntp_sync.c — Combined BLE + WiFi Gateway (ESP32 WROVER)
 *
 * Periodically queries an NTP server and calls time_sync_writer_set_utc()
 * directly. The time_sync_writer then distributes UTC to all connected
 * sensor nodes via GATT WRITE inside process_data_thread().
 *
 * On the combined gateway there is no UART bridge and no 0xCC frame —
 * the UTC reference is set in-process.
 */

#include "sntp_sync.h"
#include "time_sync_writer.h"

#include <zephyr/kernel.h>
#include <zephyr/net/sntp.h>
#include <zephyr/net/socket.h>
#include <zephyr/logging/log.h>

#include <time.h>

LOG_MODULE_REGISTER(sntp_sync, LOG_LEVEL_INF);

#define SNTP_SERVER              "pool.ntp.org"
#define SNTP_PORT                123
#define SNTP_TIMEOUT_MS          5000
#define SNTP_RESYNC_INTERVAL_S   60
#define SNTP_RETRY_DELAY_MS      10000

#define SNTP_STACK_SIZE  2048
#define SNTP_PRIORITY    6

// Replace:
// K_THREAD_STACK_DEFINE(sntp_stack, SNTP_STACK_SIZE);
// With:
Z_KERNEL_STACK_DEFINE_IN(sntp_stack, SNTP_STACK_SIZE,
    __attribute__((section(".ext_ram.bss"))));

static struct k_thread sntp_tid;

/* Last successful UTC — accessible via sntp_get_last_utc() */
static uint32_t last_utc_time   = 0;
static uint16_t last_utc_ms     = 0;
static uint32_t last_utc_set_ms = 0;

uint32_t sntp_get_last_utc(uint16_t *out_ms)
{
    if (last_utc_time == 0) {
        if (out_ms) *out_ms = 0;
        return 0;
    }
    uint32_t elapsed_ms = k_uptime_get_32() - last_utc_set_ms;
    uint32_t total_ms   = last_utc_ms + elapsed_ms;
    uint32_t sec        = last_utc_time + (total_ms / 1000U);
    uint16_t ms         = (uint16_t)(total_ms % 1000U);
    if (out_ms) *out_ms = ms;
    return sec;
}

static int do_sntp_query(uint32_t *utc_out, uint16_t *ms_out)
{
    struct sntp_time sntp_time;
    struct sockaddr_in addr = {0};

    struct addrinfo *result;
    const struct addrinfo hints = {
        .ai_family   = AF_INET,
        .ai_socktype = SOCK_DGRAM,
    };

    int ret = getaddrinfo(SNTP_SERVER, NULL, &hints, &result);
    if (ret != 0) {
        LOG_ERR("DNS failed for %s: %d", SNTP_SERVER, ret);
        return -ENETUNREACH;
    }

    addr.sin_family = AF_INET;
    addr.sin_port   = htons(SNTP_PORT);
    addr.sin_addr   = ((struct sockaddr_in *)result->ai_addr)->sin_addr;
    freeaddrinfo(result);

    ret = sntp_simple_addr((struct sockaddr *)&addr, sizeof(addr),
                           SNTP_TIMEOUT_MS, &sntp_time);
    if (ret < 0) {
        LOG_ERR("SNTP query failed: %d", ret);
        return ret;
    }

    *utc_out = (uint32_t)(sntp_time.seconds);
    *ms_out  = (uint16_t)(((uint64_t)sntp_time.fraction * 1000ULL) >> 32);

    /* Store for sntp_get_last_utc() */
    last_utc_time   = *utc_out;
    last_utc_ms     = *ms_out;
    last_utc_set_ms = k_uptime_get_32();

    time_t t = (time_t)(*utc_out);
    struct tm *tm = gmtime(&t);
    LOG_INF("SNTP: UTC = %u (%04d-%02d-%02d %02d:%02d:%02d UTC)",
        *utc_out,
        tm->tm_year + 1900, tm->tm_mon + 1, tm->tm_mday,
        tm->tm_hour, tm->tm_min, tm->tm_sec);

    return 0;
}

static void sntp_thread(void)
{
    LOG_INF("SNTP sync thread started");

    while (true) {
        uint32_t utc = 0;
        uint16_t ms  = 0;
        int ret = do_sntp_query(&utc, &ms);

        if (ret == 0) {
            /* Set UTC reference directly — no UART frame needed */
            time_sync_writer_set_utc(utc, ms);
        } else {
            LOG_WRN("SNTP failed (%d), retrying in %d ms",
                    ret, SNTP_RETRY_DELAY_MS);
            k_sleep(K_MSEC(SNTP_RETRY_DELAY_MS));
            continue;
        }

        k_sleep(K_SECONDS(SNTP_RESYNC_INTERVAL_S));
    }
}

void sntp_sync_start(void)
{
    k_thread_create(&sntp_tid,
                    sntp_stack,
                    K_THREAD_STACK_SIZEOF(sntp_stack),
                    (k_thread_entry_t)sntp_thread,
                    NULL, NULL, NULL,
                    SNTP_PRIORITY, 0, K_NO_WAIT);
    k_thread_name_set(&sntp_tid, "sntp_sync");
}
```
