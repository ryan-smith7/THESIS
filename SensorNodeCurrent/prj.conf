## prj.conf
```kconfig
# ── Bluetooth ────────────────────────────────────────────
CONFIG_BT=y
CONFIG_BT_PERIPHERAL=y
CONFIG_BT_HCI=y
CONFIG_BT_DEVICE_NAME="SensorNodeCurrent"

# ACL buffer sizes — increased to support extended MTU for
# sound spectrum characteristic (3 × ~236 byte notifications)
CONFIG_BT_BUF_ACL_RX_SIZE=251
CONFIG_BT_BUF_ACL_TX_SIZE=251
# L2CAP MTU — must be ≥ largest notification payload + 4 byte L2CAP header
# Largest sound packet = 244 bytes
CONFIG_BT_L2CAP_TX_MTU=247
# Allow MTU negotiation so gateway can request 244 byte ATT MTU
CONFIG_BT_GATT_CLIENT=n
CONFIG_BT_ATT_PREPARE_COUNT=0

# ── Floating point ────────────────────────────────────────
CONFIG_CBPRINTF_FP_SUPPORT=y

# ── Console / logging ────────────────────────────────────
CONFIG_PRINTK=y
CONFIG_LOG=y
CONFIG_LOG_DEFAULT_LEVEL=3
CONFIG_LOG_BUFFER_SIZE=8192
CONFIG_LOG_MODE_DEFERRED=y
CONFIG_PRINTK_BUFFER_SIZE=4096

# ── Stack sizes ───────────────────────────────────────────
CONFIG_MAIN_STACK_SIZE=4096
# System workqueue — BLE stack uses this heavily
CONFIG_SYSTEM_WORKQUEUE_STACK_SIZE=2048

# ── Heap ──────────────────────────────────────────────────
# BLE stack draws from heap
CONFIG_HEAP_MEM_POOL_SIZE=29696
# you should comment this below one out
CONFIG_ESP32_USE_UNSUPPORTED_REVISION=y
```

## src/main.c
```c
#include <zephyr/kernel.h>
#include <zephyr/device.h>
#include <zephyr/drivers/rtc.h>
#include <zephyr/sys/util.h>
#include <zephyr/shell/shell.h>
#include <zephyr/drivers/sensor.h>
#include <zephyr/drivers/sensor/ens160.h>
 
#include "sensor.h"
#include "bluetooth.h"
#include "cur_ble.h"
 
#include <zephyr/types.h>
#include <zephyr/sys/printk.h>
#include <zephyr/logging/log.h>
#include <zephyr/net_buf.h>
#include <zephyr/bluetooth/bluetooth.h>
#include <zephyr/bluetooth/conn.h>
#include <zephyr/bluetooth/gatt.h>
#include <zephyr/bluetooth/hci.h>
#include <string.h>

/* ── Shared across all nodes ─────────────────────────────────────────────── */
K_THREAD_DEFINE(bluetooth_init_tid, BLUETOOTH_CONTROL_STACK_SIZE, bluetooth_init_thread,
                NULL, NULL, NULL,
                BLUETOOTH_CONTROL_PRIORITY, 0, 0);

                /* Sensor acquisition thread */
K_THREAD_DEFINE(current_tid, 2 * CUR_BLE_STACK_SIZE, current_thread,
                NULL, NULL, NULL,
                CUR_BLE_PRIORITY, 0, 0);
 
/* BLE modality thread */
K_THREAD_DEFINE(cur_ble_tid, CUR_BLE_STACK_SIZE, cur_ble_thread,
                NULL, NULL, NULL,
                CUR_BLE_PRIORITY, 0, 0);
```

## include/bluetooth.h
```c
#ifndef BLUETOOTH_SERVICE_H
#define BLUETOOTH_SERVICE_H

#include <zephyr/types.h>
#include <zephyr/kernel.h>
#include <zephyr/types.h>
#include <zephyr/sys/printk.h>
#include <zephyr/logging/log.h>
#include <zephyr/net_buf.h>
#include <zephyr/bluetooth/bluetooth.h>
#include <zephyr/bluetooth/conn.h>
#include <zephyr/bluetooth/gatt.h>
#include <zephyr/bluetooth/hci.h>

#include <string.h>
#include "sensor.h"

#define BLUETOOTH_CONTROL_STACK_SIZE 2048
#define BLUETOOTH_CONTROL_PRIORITY 5

extern int init_bluetooth(void);

extern int start_advertising(void);

extern int stop_advertising(void);

extern int stop_advertising_and_disconnect();

extern void bluetooth_init_thread(void);

#endif
```

## include/cur_ble.h
```c
/**
 * @file cur_ble.h
 * @brief BLE GATT characteristic for electrical current sensor.
 *
 * Payload (14 bytes, big-endian):
 *   [0-3]  utc_sec    uint32   UTC seconds at measurement (0 = unsynced)
 *   [4-5]  utc_ms     uint16   UTC milliseconds 0-999
 *   [6-7]  current_uA int16    microamps signed, e.g. 1500 = 1.500 mA
 *   [8-9]  voltage_mV uint16   millivolts, e.g. 3300 = 3.300 V
 *
 * Service UUID:  CC000001-0000-ABCD-9078-F6E5D4C3B2CC
 * Char UUID:     CC000002-0000-ABCD-9078-F6E5D4C3B2CC
 */

#ifndef CUR_BLE_H
#define CUR_BLE_H

#include <zephyr/kernel.h>
#include <zephyr/bluetooth/gatt.h>
#include "sensor.h"
// #include "sd_log.h"

/* ── Thread config ──────────────────────────────────────── */
#define CUR_BLE_STACK_SIZE  1024
#define CUR_BLE_PRIORITY    6

/* ── Public API ─────────────────────────────────────────── */
extern void cur_ble_thread(void);
extern void cur_pack_and_notify(const struct current_msg *msg);

#endif /* CUR_BLE_H */
```

## include/modality_ble.h
```c
/**
 * @file modality_ble.h
 * @brief Shared macros for per-modality BLE GATT characteristics.
 *
 * Only covers the parts that are truly identical across all modalities:
 *   - CCC changed callback
 *   - Read handler
 *   - GATT service definition
 *   - Notify helper
 *
 * Connection tracking (connected/disconnected callbacks and
 * bt_conn_cb_register) is written as plain functions in each .c file
 * to avoid macro-expanded function definitions at file scope.
 */

#ifndef MODALITY_BLE_H
#define MODALITY_BLE_H

#include <zephyr/bluetooth/bluetooth.h>
#include <zephyr/bluetooth/gatt.h>
#include <zephyr/bluetooth/conn.h>
#include <zephyr/logging/log.h>

/* ── CCC changed callback ─────────────────────────────────────────────── */
#define MODALITY_CCC_CHANGED(name, flag)                                    \
    static void name##_ccc_changed(const struct bt_gatt_attr *attr,         \
                                   uint16_t value)                          \
    {                                                                       \
        flag = (value == BT_GATT_CCC_NOTIFY);                              \
        LOG_INF(#name " notifications %s", flag ? "on" : "off");           \
    }

/* ── Read handler ─────────────────────────────────────────────────────── */
#define MODALITY_READ_HANDLER(name, buf, bufsz)                             \
    static ssize_t name##_read(struct bt_conn *conn,                        \
                               const struct bt_gatt_attr *attr,             \
                               void *out, uint16_t len, uint16_t offset)    \
    {                                                                       \
        return bt_gatt_attr_read(conn, attr, out, len, offset, buf, bufsz); \
    }

/* ── GATT service definition ──────────────────────────────────────────── */
#define MODALITY_GATT_SERVICE(name, svc_uuid_bytes, chr_uuid_bytes)         \
    BT_GATT_SERVICE_DEFINE(name##_svc,                                      \
        BT_GATT_PRIMARY_SERVICE(                                            \
            BT_UUID_DECLARE_128(svc_uuid_bytes)),                           \
        BT_GATT_CHARACTERISTIC(                                             \
            BT_UUID_DECLARE_128(chr_uuid_bytes),                            \
            BT_GATT_CHRC_READ | BT_GATT_CHRC_NOTIFY,                       \
            BT_GATT_PERM_READ,                                              \
            name##_read, NULL, NULL),                                       \
        BT_GATT_CCC(name##_ccc_changed,                                     \
                    BT_GATT_PERM_READ | BT_GATT_PERM_WRITE),               \
    )

/* ── Notify helper ────────────────────────────────────────────────────── */
#define MODALITY_NOTIFY(name, conn_var, flag, buf, len)                     \
    do {                                                                    \
        if ((flag) && (conn_var)) {                                         \
            int _err = bt_gatt_notify((conn_var),                           \
                                      &name##_svc.attrs[1],                 \
                                      (buf), (len));                        \
            if (_err) {                                                     \
                LOG_ERR(#name " notify failed: %d", _err);                  \
            }                                                               \
        }                                                                   \
    } while (0)

#endif /* MODALITY_BLE_H */
```

## include/sensor.h
```c
/**
 * @file s4744413_sensor.c
 * @brief sensor library header file
 */

#ifndef SENSOR_H
#define SENSOR_H

#include <zephyr/kernel.h>
#include <zephyr/device.h>
#include <zephyr/drivers/sensor.h>
#include <zephyr/logging/log.h>
#include <zephyr/shell/shell.h>

// Define Thread Macros
#define DEVICE_ID 3

// sensor.h
#pragma once
#include <zephyr/kernel.h>
#include <zephyr/types.h>

/* -------- Partial messages (from each sensor thread) --------
 *
 * utc_sec + utc_ms: UTC timestamp stamped at measurement moment via
 * time_sync_get_utc_ms(). utc_sec is 0 and utc_ms is 0 if no time
 * sync has occurred yet. Both fields are sent over BLE so the gateway
 * can forward millisecond-precision timestamps to Azure.
 */

struct current_msg { //CURRENT ADDITION
    int16_t  current_uA;   /* microamps signed — e.g. 1500 = 1.500 mA  */
    uint16_t voltage_mV;   /* millivolts       — e.g. 3300 = 3.300 V   */
    uint32_t utc_sec;      /* UTC seconds at measurement (0 = unsynced) */
    uint16_t utc_ms;       /* UTC milliseconds 0-999                    */
};

/* -------- Message queues -------- */
#define Q_DEPTH 8

extern struct k_msgq current_q;  //CURRENT ADDITION

extern void current_thread(void); //CURRENT ADDITION

#endif /* SENSOR_H */
```

## include/time_sync.h
```c
/**
 * @file time_sync.h
 * @brief UTC wall-clock with BLE-write-based sync and drift correction.
 *
 * The gateway writes a 5-byte packet to the sensor characteristic:
 *   Byte 0:    TIMESYNC_MAGIC (0xFE)
 *   Bytes 1-4: UTC unix timestamp (uint32_t, big-endian)
 *
 * The node accumulates up to SYNC_WINDOW_SIZE sync points and applies
 * least-squares linear regression to estimate clock skew (drift_ppm).
 * time_sync_get_utc() applies this correction at any time, including
 * during BLE disconnection.
 */

#ifndef TIME_SYNC_H
#define TIME_SYNC_H

#include <zephyr/kernel.h>
#include <zephyr/types.h>
#include <stdbool.h>

#define TIMESYNC_MAGIC       0xFE
#define TIMESYNC_PACKET_LEN  7     /* magic(1) + utc_sec(4) + utc_ms(2) */

#define SD_LOG_UTC_MIN  1700000000U

/**
 * @brief Process an incoming GATT write buffer for a time sync packet.
 *
 * Validates the magic byte (0xFE), parses UTC seconds + milliseconds,
 * adds to the regression window, and updates the drift estimate.
 *
 * @param buf  Pointer to the write buffer (must be >= TIMESYNC_PACKET_LEN bytes).
 * @param len  Length of the write buffer.
 * @return     true if this was a valid time sync packet and was consumed.
 */
bool time_sync_handle_write(const void *buf, uint16_t len);

/**
 * @brief Get drift-corrected UTC with millisecond resolution.
 *
 * @param[out] out_ms  Sub-second milliseconds (0–999). May be NULL.
 * @return             UTC unix seconds, or 0 if not yet synced.
 */
uint32_t time_sync_get_utc_ms(uint16_t *out_ms);

/**
 * @brief Get drift-corrected UTC seconds (convenience wrapper).
 *
 * Equivalent to time_sync_get_utc_ms(NULL).
 *
 * @return UTC unix timestamp (seconds since epoch), or 0 if not yet synced.
 */
uint32_t time_sync_get_utc(void);

#endif /* TIME_SYNC_H */
```

## src/bluetooth.c
```c
#include <zephyr/kernel.h>
#include <zephyr/types.h>
#include <zephyr/sys/printk.h>
#include <zephyr/logging/log.h>
#include <zephyr/net_buf.h>
#include <zephyr/bluetooth/bluetooth.h>
#include <zephyr/bluetooth/conn.h>
#include <zephyr/bluetooth/gatt.h>
#include <zephyr/bluetooth/hci.h>
#include <zephyr/sys/timeutil.h>

#include <string.h>
#include "bluetooth.h"
#include "sensor.h"

#include "time_sync.h"

#ifndef CONFIG_BT_DEVICE_NAME
#define CONFIG_BT_DEVICE_NAME "SensorNode"
#endif

#define PACKED_DATA_LEN 61   /* +6 bytes: snd_rms(2) + snd_peak_freq(2) + snd_peak_mag(2) */


LOG_MODULE_REGISTER(bluetooth, LOG_LEVEL_INF);

/* GLOBAL VARIABLES*/
uint8_t packed_data[PACKED_DATA_LEN];
static struct bt_conn *current_conn;
static bool notify_enabled = false;  // NEW
uint8_t ble_tick = 0;

// Custom 128-bit service UUID for advertising (little endian)
static const uint8_t custom_service_uuid[16] = {
    0x12, 0x34, 0x56, 0x78,
    0x12, 0x34, 0x56, 0x78,
    0x12, 0x34, 0x56, 0x78,
    0x9a, 0xbc, 0xde, 0xf0,
};

// Advertising data: Flags for general discovery and custome 128-bit service UUID to display (for base to see then establish gatt connection)
static const struct bt_data ad[] = {
    BT_DATA_BYTES(BT_DATA_FLAGS, (BT_LE_AD_GENERAL | BT_LE_AD_NO_BREDR)),
    BT_DATA(BT_DATA_UUID128_ALL, custom_service_uuid, sizeof(custom_service_uuid)),
};

// Scan response data: Complete device name from configuration (only using for testing on nrf app)
static const struct bt_data sd[] = {
    BT_DATA(BT_DATA_NAME_COMPLETE, CONFIG_BT_DEVICE_NAME, strlen(CONFIG_BT_DEVICE_NAME)),
};

static ssize_t pack_data(struct bt_conn *conn, const struct bt_gatt_attr *attr,
                         void *buf, uint16_t len, uint16_t offset);
static ssize_t write_handler(struct bt_conn *conn,
                             const struct bt_gatt_attr *attr,
                             const void *buf, uint16_t len,
                             uint16_t offset, uint8_t flags);
static void ccc_cfg_changed(const struct bt_gatt_attr *attr, uint16_t value);
static void connected(struct bt_conn *conn, uint8_t err);
static void disconnected(struct bt_conn *conn, uint8_t reason);
extern int init_bluetooth(void);
extern int start_advertising(void);
extern int stop_advertising(void);
extern int stop_advertising_and_disconnect();
void tracker_thread(void);

struct bt_le_adv_param adv_params = {
    .id = BT_ID_DEFAULT,
    .interval_min = BT_GAP_ADV_FAST_INT_MIN_2,
    .interval_max = BT_GAP_ADV_FAST_INT_MAX_2,
    .options = BT_LE_ADV_OPT_CONN, // Connectable mode (this is depreciatetd though only thing i found to work)
};

//Bluetooth connection callbacks structure:
static struct bt_conn_cb conn_callbacks = {
    .connected = connected,
    .disconnected = disconnected,
};

static K_SEM_DEFINE(adv_restart_sem, 0, 1);

/*
GATT (Generic Attribute Profile) is a protocol used in Bluetooth Low Energy (BLE) 
defining how data is structured, discovered, and exchanged between devices. 
Data is organised into services and characteristics.

- Services are collections of data and associated behaviors (like a sensor service).
- Characteristics are individual data points or features within a service (like a temperature value).

Each attribute (service, characteristic, descriptor, etc.) in GATT has a unique handle,
A 16-bit identifier used by the BLE stack to read, write, or discover that attribute. 
Handles allow clients to specifically refer and operate on specific data points.
*/
BT_GATT_SERVICE_DEFINE(custom_svc, //custom service
    BT_GATT_PRIMARY_SERVICE(BT_UUID_DECLARE_128( //primary service with 128-bit custom UUID
        0x12, 0x34, 0x56, 0x78,
        0x12, 0x34,
        0x56, 0x78,
        0x12, 0x34,
        0x56, 0x78, 0x9a, 0xbc, 0xde, 0xf0)),
    BT_GATT_CHARACTERISTIC(BT_UUID_DECLARE_128( //characteristic defined within the service
        0x99, 0x88, 0x77, 0x66,
        0x55, 0x44,
        0x33, 0x22,
        0x11, 0x00,
        0xff, 0xee, 0xdd, 0xcc, 0xbb, 0xaa),
        BT_GATT_CHRC_READ | BT_GATT_CHRC_WRITE | BT_GATT_CHRC_NOTIFY, // read, write and notifying characteristic permissions
        BT_GATT_PERM_READ | BT_GATT_PERM_WRITE, // read and write attribute permissions
        pack_data, //read callback
        write_handler, //write callback
        NULL),
    // Client Characteristic Configuration Descriptor (CCCD)
    // Allows the client to enable or disable notifications
    BT_GATT_CCC(ccc_cfg_changed,
                BT_GATT_PERM_READ | BT_GATT_PERM_WRITE),
);

/**
 * @brief Read callback for the custom characteristic to return packed sensor data.
 *
 * This function called when a connected BLE client reads the value of the
 * custom characteristic. It returns the current contents of the `packed_data` buffer,
 * which containing the tracker sensor data
 *
 * @param conn   Pointer to the connection object.
 * @param attr   Pointer to the GATT attribute being read.
 * @param buf    Buffer to store the read data.
 * @param len    Maximum number of bytes the buffer can hold.
 * @param offset Offset from the beginning of the attribute value.
 *
 * @return Number of bytes read and copied to the buffer, or a negative error code.
 */
static ssize_t pack_data(struct bt_conn *conn, const struct bt_gatt_attr *attr,
                         void *buf, uint16_t len, uint16_t offset) {
    printk("[TRACKER] packing data\n");
    return bt_gatt_attr_read(conn, attr, buf, len, offset, packed_data, PACKED_DATA_LEN);
}

/**
 * @brief Write callback for the custom characteristic to handle time synchronisation.
 *
 * This function is called when a connected BLE client (gateway) writes to the
 * custom characteristic. It passes the incoming buffer to time_sync_handle_write()
 * which validates the magic byte (0xFE) and, if matched, updates the node's
 * drift-corrected UTC clock model. Any write not matching the time sync packet
 * format is logged and ignored.
 *
 * @param conn   Pointer to the connection object.
 * @param attr   Pointer to the GATT attribute being written.
 * @param buf    Pointer to the data buffer provided by the client.
 * @param len    Length of the data being written (expected TIMESYNC_PACKET_LEN).
 * @param offset Offset into the attribute value.
 * @param flags  Flags indicating write behavior.
 *
 * @return Number of bytes written (always len).
 */
static ssize_t write_handler(struct bt_conn *conn,
                             const struct bt_gatt_attr *attr,
                             const void *buf, uint16_t len,
                             uint16_t offset, uint8_t flags) {
    if (time_sync_handle_write(buf, len)) {
        return len;
    }

    LOG_WRN("write_handler: unexpected write (len=%u) ignored", len);
    return len;
}


/**
 * @brief Callback triggered when the CCC (Client Characteristic Configuration) is changed.
 *
 * This function is invoked when a BLE client writes to the CCC descriptor of a
 * characteristic to enable or disable notifications. It updates the global
 * notify_enabled flag to indicate.
 *
 * @param attr  Pointer to the CCC GATT attribute.
 * @param value New CCC value set by the client (BT_GATT_CCC_NOTIFY to enable notifications).
 */
static void ccc_cfg_changed(const struct bt_gatt_attr *attr, uint16_t value) {

    if (value == BT_GATT_CCC_NOTIFY) {
        notify_enabled = true;
        printk("Notifications enabled\n");
    } else {
        printk("Notifications disabled\n");
        notify_enabled = false;
    }
}

/**
 * @brief Bluetooth connection callback when a connection is successfully established.
 *
 * It checks for connection errors, stores a reference to the current connection,
 * prints a status message, and sets the BLE tick flag indicating a BT connection.
 *
 * @param conn Pointer to the new connection object.
 * @param err  Error code (0 if successful, non-zero on failure).
 */
static void connected(struct bt_conn *conn, uint8_t err) {
    if (err) {
        printk("[TRACKER] Failed to connect (err %u)\n", err);
        return;
    }

    current_conn = bt_conn_ref(conn);
    printk("[TRACKER] Connected\n");
    ble_tick = 1;
}

/*
 * On disconnect, unreference the connection and give semaphore to restart advertising so
 * the gateway can reconnect
 */
static void disconnected(struct bt_conn *conn, uint8_t reason) {
    printk("[TRACKER] Disconnected (reason 0x%02x)\n", reason);

    if (current_conn) {
        bt_conn_unref(current_conn);
        current_conn = NULL;
    }

    notify_enabled = false;
    ble_tick = 0;

    k_sem_give(&adv_restart_sem);
}

static void start_advertising_with_retry(bool after_disconnect) {
    if (after_disconnect) {
        k_sleep(K_MSEC(500));
    }

    while (1) {
        int err = bt_le_adv_start(&adv_params, ad, ARRAY_SIZE(ad),
                                   sd, ARRAY_SIZE(sd));
        if (err == 0) {
            printk("[SENSOR] Advertising started\n");
            return;
        }
        printk("[SENSOR] Advertising failed (%d) — retrying in 1s\n", err);
        k_sleep(K_SECONDS(1));
    }
}

/**
 * @brief Initialize Bluetooth.
 *
 * Enables Bluetooth and registers connection callbacks.
 *
 * @return 0 on success, or a negative error code on failure.
 */
extern int init_bluetooth(void) {
    int err;
    printk("[SENSOR] Initializing Bluetooth...\n");
    err = bt_enable(NULL);
    if (err) {
        printk("[SENSOR] Bluetooth init failed (err %d)\n", err);
        return err;
    }
    bt_conn_cb_register(&conn_callbacks);

    return 0;
}

/**
 * @brief Start Bluetooth advertising.
 *
 * Begins advertising with predefined parameters and advertising data.
 * Waits briefly after starting to allow advertising packets to propagate.
 *
 * @return 0 on success, or a negative error code on failure.
 */
extern int start_advertising(void) {
    int err;
    printk("[SENSOR] Starting advertising...\n");
    err = bt_le_adv_start(&adv_params, ad, ARRAY_SIZE(ad), sd, ARRAY_SIZE(sd));
    if (err) {
        printk("[SENSOR] Advertising failed to start (err %d)\n", err);
        return err;
    }

    printk("[SENSOR] Advertising started\n");
    k_msleep(3000);  // Wait before restarting next advertisement cycle ?????
    return 0;
}

/**
 * @brief Stop Bluetooth advertising.
 *
 * Waits briefly to ensure packets clear, then stops advertising.
 *
 * @return 0 on success, or a negative error code on failure.
 */
extern int stop_advertising(void) {
    k_msleep(2000); // wait for packets to clear before stopping
    int err;
    printk("[SENSOR] Stopping advertising...\n");

    err = bt_le_adv_stop();
    if (err) {
        printk("[SENSOR] Failed to stop advertising (err %d)\n", err);
        return err;
    }

    printk("[SENSOR] Advertising stopped\n");
    return 0;
}

/**
 * @brief Stop advertising and disconnect any active connection.
 *
 * Stops advertising, then if a connection exists, disconnects it with
 * a remote user termination reason.
 *
 * @return 0 on success, or a negative error code on failure.
 */
extern int stop_advertising_and_disconnect() {
    int err;

    err = stop_advertising();
    if (err) {
        printk("[SENSOR] Failed to stop advertising\n");
        return err;
    }

    if (current_conn) {
        err = bt_conn_disconnect(current_conn, BT_HCI_ERR_REMOTE_USER_TERM_CONN);
        if (err) {
            printk("[SENSOR] Disconnection failed (err %d)\n", err);
            return err;
        } else {
            printk("[SENSOR] Disconnection initiated\n");
        }
    }

    return 0;
}

/*
 *
 * Initialise BT, start advertising once, then block forever.
 * All reconnection logic lives in disconnected() above
 * needed here.
 *
 * Modality BLE threads handle all data flow
 * independently
 */
void bluetooth_init_thread(void) {
    int err = init_bluetooth();
    if (err) {
        printk("[TRACKER] Bluetooth init failed (%d)\n", err);
        return;
    }

    start_advertising_with_retry(false);

    while (1) {
        k_sem_take(&adv_restart_sem, K_FOREVER);
        start_advertising_with_retry(true);
    }
}
```

## src/cur_ble.c
```c
/**
 * @file cur_ble.c
 * @brief BLE GATT characteristic for electrical current sensor.
 *
 * Payload (14 bytes, big-endian):
 *   [0-3]  utc_sec    uint32   UTC seconds at measurement (0 = unsynced)
 *   [4-5]  utc_ms     uint16   UTC milliseconds 0-999
 *   [6-7]  current_uA int16    microamps signed, e.g. 1500 = 1.500 mA
 *   [8-9]  voltage_mV uint16   millivolts, e.g. 3300 = 3.300 V
 *
 * Service UUID:  CC000001-0000-ABCD-9078-F6E5D4C3B2CC
 * Char UUID:     CC000002-0000-ABCD-9078-F6E5D4C3B2CC
 */

#include "cur_ble.h"
#include "modality_ble.h"

#define LOG_UTC_MIN  1700000000U
LOG_MODULE_REGISTER(cur_ble, LOG_LEVEL_INF);

#define CUR_SVC_UUID_BYTES \
    0xCC, 0xB2, 0xC3, 0xD4, 0xE5, 0xF6, \
    0x78, 0x90, 0xCD, 0xAB, 0x00, 0x00, \
    0x01, 0x00, 0x00, 0xCC

#define CUR_CHR_UUID_BYTES \
    0xCC, 0xB2, 0xC3, 0xD4, 0xE5, 0xF6, \
    0x78, 0x90, 0xCD, 0xAB, 0x00, 0x00, \
    0x02, 0x00, 0x00, 0xCC

#define CUR_BUF_LEN 11  /* utc_sec(4) + utc_ms(2) + current_uA(2) + voltage_mV(2) */

static bool            cur_notify_enabled = false;
static struct bt_conn *cur_conn           = NULL;
static uint8_t         cur_buf[CUR_BUF_LEN];

MODALITY_CCC_CHANGED(cur, cur_notify_enabled);
MODALITY_READ_HANDLER(cur, cur_buf, CUR_BUF_LEN);
MODALITY_GATT_SERVICE(cur, CUR_SVC_UUID_BYTES, CUR_CHR_UUID_BYTES);

static void cur_connected(struct bt_conn *conn, uint8_t err)
{
    if (!err) {
        cur_conn = bt_conn_ref(conn);
    }
}

static void cur_disconnected(struct bt_conn *conn, uint8_t reason) {
    
    if (cur_conn) {
        bt_conn_unref(cur_conn);
        cur_conn = NULL;
    }
    cur_notify_enabled = false;
}

static struct bt_conn_cb cur_conn_cb = {
    .connected    = cur_connected,
    .disconnected = cur_disconnected,
};

void cur_pack_and_notify(const struct current_msg *msg) {
    struct bt_conn *conn = cur_conn;

    if (!conn || !cur_notify_enabled) {
        return;
    }

    cur_buf[0] = (msg->utc_sec    >> 24) & 0xFF;  /* utc_sec [0-3] */
    cur_buf[1] = (msg->utc_sec    >> 16) & 0xFF;
    cur_buf[2] = (msg->utc_sec    >>  8) & 0xFF;
    cur_buf[3] =  msg->utc_sec           & 0xFF;
    cur_buf[4] = (msg->utc_ms     >>  8) & 0xFF;  /* utc_ms  [4-5] */
    cur_buf[5] =  msg->utc_ms            & 0xFF;
    cur_buf[6] = (msg->current_uA >>  8) & 0xFF;  /* current [6-7] */
    cur_buf[7] =  msg->current_uA        & 0xFF;
    cur_buf[8] = (msg->voltage_mV >>  8) & 0xFF;  /* voltage [8-9] */
    cur_buf[9] =  msg->voltage_mV        & 0xFF;
    cur_buf[10] =  3;                      /* dev_id  [10]   */

    MODALITY_NOTIFY(cur, conn, cur_notify_enabled, cur_buf, CUR_BUF_LEN);
}

void cur_ble_thread(void) {

    bt_conn_cb_register(&cur_conn_cb);
    LOG_INF("cur_ble thread ready");

    while (1) {
        struct current_msg msg;
        if (k_msgq_get(&current_q, &msg, K_FOREVER) != 0) {
            continue;
        }

        if (cur_notify_enabled && cur_conn) {
            if (msg.utc_sec > LOG_UTC_MIN) {
                cur_pack_and_notify(&msg);
            } else {
                /* Connected but no UTC sync yet — drop rather than
                 * send untimestampable data. No SD logging for this
                 * modality (not yet implemented). */
                LOG_DBG("CUR: dropping live sample — no UTC sync");
            }
        }
        /* No SD logging for current modality — not yet implemented */
    }
}
```

## src/current_sensor.c
```c
/* ═══════════════════════════════════════════════════════════════════════════
 * current_thread.c — with dummy implementation
 *
 * Replace dummy_read_current_uA() and dummy_read_voltage_mV()
 * with their actual reads. Everything else
 * (queue, thread structure) stays identical
 * ═══════════════════════════════════════════════════════════════════════════
 */
 
#include <zephyr/kernel.h>
#include <zephyr/logging/log.h>
#include "sensor.h"
#include "time_sync.h"
 
LOG_MODULE_REGISTER(current_sensor, LOG_LEVEL_INF);
 
/* ── Queue ───────────────────────────────────────────────────────────────── */
#define CURRENT_Q_DEPTH     8
#define CURRENT_STACK_SIZE  2048
#define CURRENT_PRIORITY    6
#define SAMPLE_PERIOD_MS    1000 //Need to increase sampling (next thing to do)
 
K_MSGQ_DEFINE(current_q, sizeof(struct current_msg), CURRENT_Q_DEPTH, 4);
 
/*
 * Replace these two functions with your actual sensor reads.
 * Return values:
 *   current_uA
 *   voltage_mV
 */
static int16_t dummy_read_current_uA(void) {
    /* Placeholder: simple triangle wave between -5000 uA and +5000 uA */
    static int32_t t = 0;
    t += 100;
    int32_t phase = t % 20000;
    if (phase < 10000) {
        return (int16_t)(phase - 5000);
    } else {
        return (int16_t)(15000 - phase);
    }
}
 
static uint16_t dummy_read_voltage_mV(void) {
    /* Placeholder: returns 3300 mV (3.3V rail) */
    return 3300;
}
 
void current_thread(void) {
    LOG_INF("Current sensor thread ready");
 
    while (1) {
        // READ SENSOR — replace dummy calls with real reads
        int16_t  current_uA = dummy_read_current_uA();
        uint16_t voltage_mV = dummy_read_voltage_mV();
 
        // STAMP UTC AT MEASUREMENT MOMENT
        uint16_t utc_ms;
        uint32_t utc_sec = time_sync_get_utc_ms(&utc_ms);
 
        struct current_msg m = {
            .current_uA = current_uA,
            .voltage_mV = voltage_mV,
            .utc_sec    = utc_sec,
            .utc_ms     = utc_ms,
        };
 
        printk("CURR put: current=%d uA  (%.3f mA)  voltage=%u mV  UTC=%u.%03u\n",
               m.current_uA,
               (double)m.current_uA / 1000.0,
               m.voltage_mV,
               m.utc_sec,
               m.utc_ms);
 
        if (k_msgq_put(&current_q, &m, K_NO_WAIT) != 0) {
            // if queue is full
            struct current_msg dump;
            (void)k_msgq_get(&current_q, &dump, K_NO_WAIT); //dequeue oldest message
            (void)k_msgq_put(&current_q, &m, K_NO_WAIT); // enqueu new message
        }
 
        k_msleep(SAMPLE_PERIOD_MS);
    }
}
```

## src/time_sync.c
```c
/**
 * @file time_sync.c
 * @brief UTC wall-clock with drift correction for Zephyr sensor nodes.
 *
 * Sync packets are delivered via GATT write from the gateway.
 * Two sync points are stored; once both are populated a linear drift
 * model is built and applied when getCorrectedUTC() is called.
 *
 * Thread safety: all state is protected by a Zephyr spinlock so
 * time_sync_get_utc() can safely be called from any thread context
 * (combiner_thread, tracker_thread, etc.).
 */

#include "time_sync.h"
#include <zephyr/logging/log.h>
#include <string.h>

LOG_MODULE_REGISTER(time_sync, LOG_LEVEL_INF);

/* ── Constants ──────────────────────────────────────────── */
#define SYNC_WINDOW_SIZE  8    /* number of sync points for regression */

/* ── Sync point ─────────────────────────────────────────── */
struct sync_point {
    uint32_t local_uptime_ms;
    int64_t  utc_ms;          /* UTC in milliseconds since epoch */
};

/* ── Module state ───────────────────────────────────────── */
static struct sync_point  points[SYNC_WINDOW_SIZE];
static uint8_t            point_count;   /* 0..SYNC_WINDOW_SIZE        */
static uint8_t            point_head;    /* index of oldest entry       */
static int32_t            drift_ppm;
static int64_t            base_utc_ms;   /* regression anchor (oldest) — UTC ms */
static uint32_t           base_local_ms; /* regression anchor (oldest)  */
static struct k_spinlock  lock;

/*
 * Least-squares linear regression over the sync window.
 *
 * We model:  utc_elapsed = (1 + ε) × local_elapsed
 * i.e. fit a line through the origin of (local_elapsed, utc_elapsed)
 * pairs, where both are measured relative to the oldest point in the
 * window to keep the numbers small and avoid 64-bit overflow.
 *
 * Least-squares slope through the origin:
 *   slope = Σ(x_i × y_i) / Σ(x_i²)
 *
 * slope > 1  → local clock runs fast (positive drift_ppm)
 * slope < 1  → local clock runs slow (negative drift_ppm)
 */
static void update_drift(void) {
    
    if (point_count < 2) {
        return;
    }

    /* Anchor = oldest point in the circular buffer */
    uint8_t oldest = point_head % point_count;  /* valid once count >= 1 */
    base_utc_ms   = points[oldest].utc_ms;
    base_local_ms = points[oldest].local_uptime_ms;

    int64_t sum_xx = 0;   /* Σ local_elapsed² */
    int64_t sum_xy = 0;   /* Σ local_elapsed × utc_elapsed_ms */

    for (uint8_t i = 0; i < point_count; i++) {
        uint8_t idx = (point_head + i) % SYNC_WINDOW_SIZE;

        /* x = local elapsed ms from anchor */
        int64_t x = (int64_t)points[idx].local_uptime_ms
                  - (int64_t)base_local_ms;

        /* y = UTC elapsed ms from anchor (already in ms) */
        int64_t y = points[idx].utc_ms - base_utc_ms;

        sum_xx += x * x;
        sum_xy += x * y;
    }

    if (sum_xx == 0) {
        return;  /* all points at same local time — shouldn't happen */
    }

    /*
     * slope = sum_xy / sum_xx
     * drift_ppm = (slope - 1) × 1e6
     *           = (sum_xy - sum_xx) / sum_xx × 1e6
     */
    int64_t ppm = ((sum_xy - sum_xx) * 1000000LL) / sum_xx;

    if (ppm >  1000) ppm =  1000;
    if (ppm < -1000) ppm = -1000;
    drift_ppm = (int32_t)ppm;

    LOG_INF("time_sync: regression over %u points  drift=%" PRId32
            " PPM  (%.2f sec/day)",
            point_count, drift_ppm,
            (double)drift_ppm * 86400.0 / 1e6);
}

/* ── Public API ─────────────────────────────────────────── */

bool time_sync_handle_write(const void *buf, uint16_t len) {

    if (len < TIMESYNC_PACKET_LEN) {
        return false;
    }

    const uint8_t *b = (const uint8_t *)buf;

    if (b[0] != TIMESYNC_MAGIC) {
        return false;
    }

    uint32_t utc_sec = ((uint32_t)b[1] << 24) |
                       ((uint32_t)b[2] << 16) |
                       ((uint32_t)b[3] <<  8) |
                        (uint32_t)b[4];

    uint16_t utc_ms_part = ((uint16_t)b[5] << 8) | b[6];
    if (utc_ms_part > 999) utc_ms_part = 999;

    int64_t utc_ms = (int64_t)utc_sec * 1000LL + utc_ms_part;

    uint32_t local_now = k_uptime_get_32();

    k_spinlock_key_t key = k_spin_lock(&lock);

    uint8_t slot = (point_head + point_count) % SYNC_WINDOW_SIZE;

    if (point_count < SYNC_WINDOW_SIZE) {
        points[slot].local_uptime_ms = local_now;
        points[slot].utc_ms          = utc_ms;
        point_count++;
    } else {
        points[point_head].local_uptime_ms = local_now;
        points[point_head].utc_ms          = utc_ms;
        point_head = (point_head + 1) % SYNC_WINDOW_SIZE;
    }

    update_drift();

    k_spin_unlock(&lock, key);

    LOG_INF("time_sync: synced UTC=%" PRIu32 ".%03u  local_ms=%" PRIu32
            "  drift=%" PRId32 " PPM",
            utc_sec, utc_ms_part, local_now, drift_ppm);

    return true;
}

uint32_t time_sync_get_utc_ms(uint16_t *out_ms) {
    k_spinlock_key_t key = k_spin_lock(&lock);

    if (point_count == 0) {
        k_spin_unlock(&lock, key);
        uint32_t uptime_ms = k_uptime_get_32();
        if (out_ms) *out_ms = (uint16_t)(uptime_ms % 1000U);
        return uptime_ms / 1000U;
    }

    uint32_t local_elapsed_ms = k_uptime_get_32() - base_local_ms;

    /* Apply regression slope: real_ms = local_ms × (1 - drift_ppm/1e6) */
    int64_t real_elapsed_ms = (int64_t)local_elapsed_ms
                            - ((int64_t)local_elapsed_ms * drift_ppm / 1000000LL);

    int64_t total_utc_ms = base_utc_ms + real_elapsed_ms;

    uint32_t utc_sec = (uint32_t)(total_utc_ms / 1000LL);
    uint16_t utc_ms  = (uint16_t)(total_utc_ms % 1000LL);

    k_spin_unlock(&lock, key);

    if (out_ms) *out_ms = utc_ms;
    return utc_sec;
}

uint32_t time_sync_get_utc(void) {
    return time_sync_get_utc_ms(NULL);
}
```
