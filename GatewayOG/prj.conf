## prj.conf
```kconfig
# Enable Peripheral
CONFIG_RTC=y

#enabled GPIO for button
CONFIG_GPIO=y

# enable prints for serial
CONFIG_PRINTK=y
# enable floating point suppport
CONFIG_CBPRINTF_FP_SUPPORT=y

CONFIG_I2C=y
CONFIG_SENSOR=y

#for JSON libraries
CONFIG_JSON_LIBRARY=y

# fs_dirent structures are big.
CONFIG_MAIN_STACK_SIZE=4096

CONFIG_LOG=y
CONFIG_LOG_DEFAULT_LEVEL=3
CONFIG_LOG_MODE_DEFERRED=n
CONFIG_LOG_BUFFER_SIZE=4096
CONFIG_LOG_BACKEND_UART=y
CONFIG_PRINTK=y
# Enable Zephyr shell
CONFIG_SHELL=y
# Stop logs being backended automatically through shell
CONFIG_SHELL_LOG_BACKEND=n

# CONFIG_FLASH=y 
# CONFIG_FLASH_MAP=y

# CONFIG_FILE_SYSTEM=y
# CONFIG_FILE_SYSTEM_LITTLEFS=y

CONFIG_BT=y
CONFIG_BT_CENTRAL=y            # Central role support
CONFIG_BT_PERIPHERAL=n         # Disable peripheral role if not needed
CONFIG_BT_GATT_CLIENT=y        # Enable GATT client APIs (discovery, read)
CONFIG_BT_MAX_CONN=4
CONFIG_BT_MAX_PAIRED=4

# Enable logging (optional but recommended for printk output)

# Kernel essentials (default usually sufficient)
CONFIG_SYSTEM_WORKQUEUE_STACK_SIZE=4096

CONFIG_BT_BUF_ACL_RX_SIZE=200
CONFIG_BT_BUF_ACL_TX_SIZE=200
CONFIG_BT_L2CAP_TX_MTU= 71
CONFIG_UUID=y
CONFIG_UUID_V4=y

# ESP specific
CONFIG_BT_L2CAP_TX_BUF_COUNT=12
CONFIG_BT_CONN_TX_MAX=12
CONFIG_BT_SMP=y
```

## src/main.c
```c
#include <zephyr/kernel.h>
#include <zephyr/types.h>
#include <zephyr/sys/printk.h>
#include <zephyr/bluetooth/bluetooth.h>
#include <zephyr/bluetooth/conn.h>
#include <zephyr/bluetooth/gatt.h>
#include <zephyr/bluetooth/hci.h>
#include <zephyr/bluetooth/uuid.h>

#include "bluetooth.h"

K_THREAD_DEFINE(process_data_tid, BASE_PROCESS_STACK_SIZE, process_data_thread, NULL, NULL, NULL, BASE_PROCESS_PRIORITY, 0, 0);
K_THREAD_DEFINE(base_tid, BASE_CONTROL_STACK_SIZE, base_thread, NULL, NULL, NULL, BASE_CONTROL_PRIORITY, 0, 0);
```

## src/bluetooth.h
```c
#ifndef BASE_SERVICE_H
#define BASE_SERVICE_H

#include <zephyr/kernel.h>
#include <zephyr/types.h>
#include <zephyr/sys/printk.h>
#include <zephyr/bluetooth/bluetooth.h>
#include <zephyr/bluetooth/conn.h>
#include <zephyr/bluetooth/gatt.h>
#include <zephyr/bluetooth/hci.h>
#include <zephyr/bluetooth/uuid.h>

#define BASE_CONTROL_STACK_SIZE 2048
#define BASE_CONTROL_PRIORITY 5

#define BASE_PROCESS_STACK_SIZE 2048
#define BASE_PROCESS_PRIORITY 5

extern void process_data_thread(void);
extern void base_thread(void);

#endif // BASE_SERVICE_H
```

## src/my_json.c
```c
#include <zephyr/logging/log.h>
#include <zephyr/logging/log_ctrl.h>
#include <zephyr/sys/uuid.h>
#include <zephyr/sys/timeutil.h>

#include "my_json.h"
#include <string.h>
#include <stdio.h>
#include <time.h>

LOG_MODULE_REGISTER(json_module);

/* Generate a v4 UUID string (e.g., "550e8400-e29b-41d4-a716-446655440000") */
static void generate_uuid(char *uuid_str)
{
    struct uuid u;
    if (uuid_generate_v4(&u) != 0) {
        uuid_str[0] = '\0';
        return;
    }
    if (uuid_to_string(&u, uuid_str) != 0) {
        uuid_str[0] = '\0';
        return;
    }
}

/* Fill JSON packet from the compact tracker payload (49-byte layout) */
void fill_json_packet(const tracker_payload_t *p, struct json_full_packet *j)
{
    if (!p || !j) return;

    /* ---------------- Header ---------------- */
    char uuid_str[UUID_STR_LEN] = {0};
    generate_uuid(uuid_str);

    /* Reasonable defaults; adjust if you have real IDs/versions */
    snprintk(j->header.messageId,     sizeof j->header.messageId,     "%s", uuid_str[0] ? uuid_str : "00000000-0000-0000-0000-000000000000");
    snprintk(j->header.gatewayId,     sizeof j->header.gatewayId,     "GW-01");
    snprintk(j->header.schemaVersion, sizeof j->header.schemaVersion, "1");
    snprintk(j->header.messageType,   sizeof j->header.messageType,   "telemetry");

    /* ---------------- Payload (top) ---------------- */
    snprintk(j->payload.deviceId, sizeof j->payload.deviceId, "dev-%u", p->dev_id);

    /* Timestamp as ISO8601 UTC (YYYY-MM-DDTHH:MM:SSZ). If you prefer unix string, change format. */
    time_t raw = (time_t)p->time;
    struct tm tm_utc;
    if (gmtime_r(&raw, &tm_utc) == NULL) {
        /* Fallback to unix seconds as string */
        snprintk(j->payload.timestamp, sizeof j->payload.timestamp, "%u", p->time);
    } else {
        snprintk(j->payload.timestamp, sizeof j->payload.timestamp,
                 "%04d-%02d-%02dT%02d:%02d:%02dZ",
                 tm_utc.tm_year + 1900, tm_utc.tm_mon + 1, tm_utc.tm_mday,
                 tm_utc.tm_hour, tm_utc.tm_min, tm_utc.tm_sec);
    }

    j->payload.uptime_ms = p->uptime_ms;
    j->payload.proto_ver = p->proto_ver;

    /* ---------------- Environment ---------------- */
    snprintk(j->payload.environment.temperature_c,
             sizeof j->payload.environment.temperature_c,
             "%.2f", p->temp_c_x100 / 100.0f);

    snprintk(j->payload.environment.humidity_percent,
             sizeof j->payload.environment.humidity_percent,
             "%.2f", p->rh_x100 / 100.0f);

    snprintk(j->payload.environment.pressure_hpa,
             sizeof j->payload.environment.pressure_hpa,
             "%.3f", p->press_hPa_x1000 / 1000.0f);

    snprintk(j->payload.environment.eco2_ppm,
             sizeof j->payload.environment.eco2_ppm,
             "%u", p->eco2_ppm);

    snprintk(j->payload.environment.tvoc_ppb,
             sizeof j->payload.environment.tvoc_ppb,
             "%u", p->tvoc_ppb);

    snprintk(j->payload.environment.aqi,
             sizeof j->payload.environment.aqi,
             "%u", p->aqi);

    snprintk(j->payload.environment.batt_mV,
             sizeof j->payload.environment.batt_mV,
             "%u", p->batt_mV);

    /* ---------------- Spectrum (AS7343) ---------------- */
    snprintk(j->payload.spectrum.AS7343_405nm,   sizeof j->payload.spectrum.AS7343_405nm,   "%u", p->as7343[0]);
    snprintk(j->payload.spectrum.AS7343_425nm,   sizeof j->payload.spectrum.AS7343_425nm,   "%u", p->as7343[1]);
    snprintk(j->payload.spectrum.AS7343_450nm,   sizeof j->payload.spectrum.AS7343_450nm,   "%u", p->as7343[2]);
    snprintk(j->payload.spectrum.AS7343_475nm,   sizeof j->payload.spectrum.AS7343_475nm,   "%u", p->as7343[3]);
    snprintk(j->payload.spectrum.AS7343_515nm,   sizeof j->payload.spectrum.AS7343_515nm,   "%u", p->as7343[4]);
    snprintk(j->payload.spectrum.AS7343_550nm,   sizeof j->payload.spectrum.AS7343_550nm,   "%u", p->as7343[5]);
    snprintk(j->payload.spectrum.AS7343_555nm,   sizeof j->payload.spectrum.AS7343_555nm,   "%u", p->as7343[6]);
    snprintk(j->payload.spectrum.AS7343_600nm,   sizeof j->payload.spectrum.AS7343_600nm,   "%u", p->as7343[7]);
    snprintk(j->payload.spectrum.AS7343_640nm,   sizeof j->payload.spectrum.AS7343_640nm,   "%u", p->as7343[8]);
    snprintk(j->payload.spectrum.AS7343_690nm,   sizeof j->payload.spectrum.AS7343_690nm,   "%u", p->as7343[9]);
    snprintk(j->payload.spectrum.AS7343_745nm,   sizeof j->payload.spectrum.AS7343_745nm,   "%u", p->as7343[10]);
    snprintk(j->payload.spectrum.AS7343_855nm,   sizeof j->payload.spectrum.AS7343_855nm,   "%u", p->as7343[11]);
    snprintk(j->payload.spectrum.AS7343_VISIBLE, sizeof j->payload.spectrum.AS7343_VISIBLE, "%u", p->as7343[12]);

    /* ---------------- Signature (kept for schema compat; no hash) ---------------- */
    snprintk(j->signature.alg,   sizeof j->signature.alg,   "none");
    snprintk(j->signature.keyId, sizeof j->signature.keyId, "na");
    snprintk(j->signature.value, sizeof j->signature.value, "");
}

/* Encode to JSON using JSON_FORMAT and print to UART/log */
void encode_and_print_json(const struct json_full_packet *j)
{
    static char json_output[JSON_BUFFER_SIZE];

    int ret = snprintk(json_output, sizeof json_output,
        JSON_FORMAT,
        /* header */
        j->header.messageId,
        j->header.gatewayId,
        j->header.schemaVersion,
        j->header.messageType,
        /* payload (top) */
        j->payload.deviceId,
        j->payload.timestamp,
        j->payload.uptime_ms,
        j->payload.proto_ver,
        /* environment */
        j->payload.environment.temperature_c,
        j->payload.environment.humidity_percent,
        j->payload.environment.pressure_hpa,
        j->payload.environment.eco2_ppm,
        j->payload.environment.tvoc_ppb,
        j->payload.environment.aqi,
        j->payload.environment.batt_mV,
        /* spectrum */
        j->payload.spectrum.AS7343_405nm,
        j->payload.spectrum.AS7343_425nm,
        j->payload.spectrum.AS7343_450nm,
        j->payload.spectrum.AS7343_475nm,
        j->payload.spectrum.AS7343_515nm,
        j->payload.spectrum.AS7343_550nm,
        j->payload.spectrum.AS7343_555nm,
        j->payload.spectrum.AS7343_600nm,
        j->payload.spectrum.AS7343_640nm,
        j->payload.spectrum.AS7343_690nm,
        j->payload.spectrum.AS7343_745nm,
        j->payload.spectrum.AS7343_855nm,
        j->payload.spectrum.AS7343_VISIBLE,
        /* signature */
        j->signature.alg,
        j->signature.keyId,
        j->signature.value
    );

    if (ret > 0 && ret < (int)sizeof json_output) {
        printk("%s\n", json_output);
    } else {
        printk("JSON encoding failed or buffer too small.\n");
    }

    /* ensure it flushes promptly over UART/logging backends */
    log_flush();
}
```

## src/my_json.h
```c
#ifndef BASE_JSON_H
#define BASE_JSON_H

#include <zephyr/kernel.h>

#define JSON_BUFFER_SIZE 1024
#define AS7343_NUM_CH 13

// wavelengths used to label AS7343 metrics
static const uint16_t AS7343_WL[AS7343_NUM_CH] = {
    405, 425, 450, 475, 515, 550, 555, 600, 640, 690, 745, 855, 999 /*VISIBLE*/
};

// ------------- Gateway-side unpacked payload (matches 49B packet) -------------
typedef struct {
    uint32_t time;          // epoch s
    uint32_t uptime_ms;     // ms
    uint8_t  proto_ver;     // PROTO_VER from node
    uint8_t  dev_id;        // node id

    // BME280 (integer scaled on node)
    int16_t  temp_c_x100;   // e.g. 2350 -> 23.50 °C
    int16_t  rh_x100;       // e.g. 4567 -> 45.67 %
    int32_t  press_hPa_x1000; // e.g. 10132 -> 1013.2 hPa

    // ENS160
    uint16_t eco2_ppm;      // ppm
    uint16_t tvoc_ppb;      // ppb
    uint8_t  aqi;           // 0..5 (pass-through)

    // AS7343 spectrum (fixed order above)
    uint16_t as7343[AS7343_NUM_CH];

    // Battery
    uint16_t batt_mV;
} tracker_payload_t;


// ----------------------------- JSON blocks -----------------------------
// Environment block (stringified for printf-based JSON build)
struct json_payload_environment {
    char temperature_c[16];    // e.g., "23.50"
    char humidity_percent[16]; // e.g., "45.67"
    char pressure_hpa[16];     // e.g., "1013.2"
    char eco2_ppm[16];         // e.g., "415"
    char tvoc_ppb[16];         // e.g., "28"
    char aqi[8];               // e.g., "1"
    char batt_mV[16];          // e.g., "3820"
};

// Spectrum block (AS7343_* keys as strings)
struct json_payload_spectrum {
    char AS7343_405nm[12];
    char AS7343_425nm[12];
    char AS7343_450nm[12];
    char AS7343_475nm[12];
    char AS7343_515nm[12];
    char AS7343_550nm[12];
    char AS7343_555nm[12];
    char AS7343_600nm[12];
    char AS7343_640nm[12];
    char AS7343_690nm[12];
    char AS7343_745nm[12];
    char AS7343_855nm[12];
    char AS7343_VISIBLE[12];   // sum/visible channel
};

// Payload block (no location/acceleration)
struct json_payload {
    char deviceId[20];       // dev_id as string
    char timestamp[72];      // ISO8601 or unix string
    uint32_t uptime_ms;      // keep as number
    uint8_t  proto_ver;      // keep as number
    struct json_payload_environment environment;
    struct json_payload_spectrum    spectrum;
};

// Header block (kept for compatibility; adjust if you like)
struct json_header {
    char messageId[40];
    char gatewayId[12];
    char schemaVersion[8];
    char messageType[12];
};

// Signature block (kept for compatibility; unused for now)
struct json_signature {
    char alg[16];
    char keyId[24];
    char value[65];
};

// Final full packet
struct json_full_packet {
    struct json_header  header;
    struct json_payload payload;
    struct json_signature signature;
};

// ----------------------------- JSON format -----------------------------
// NOTE: Numbers that should remain numeric are unquoted in this format.
// Strings stay quoted. Adjust to your backend expectations.
static const char JSON_FORMAT[] =
    "{"
      "\"header\":{"
        "\"messageId\":\"%s\","
        "\"gatewayId\":\"%s\","
        "\"schemaVersion\":\"%s\","
        "\"messageType\":\"%s\""
      "},"
      "\"payload\":{"
        "\"deviceId\":\"%s\","
        "\"timestamp\":\"%s\","
        "\"uptime_ms\":%u,"
        "\"proto_ver\":%u,"
        "\"environment\":{"
          "\"temperature_c\":\"%s\","
          "\"humidity_percent\":\"%s\","
          "\"pressure_hpa\":\"%s\","
          "\"eco2_ppm\":\"%s\","
          "\"tvoc_ppb\":\"%s\","
          "\"aqi\":\"%s\","
          "\"batt_mV\":\"%s\""
        "},"
        "\"spectrum\":{"
          "\"AS7343_405nm\":\"%s\","
          "\"AS7343_425nm\":\"%s\","
          "\"AS7343_450nm\":\"%s\","
          "\"AS7343_475nm\":\"%s\","
          "\"AS7343_515nm\":\"%s\","
          "\"AS7343_550nm\":\"%s\","
          "\"AS7343_555nm\":\"%s\","
          "\"AS7343_600nm\":\"%s\","
          "\"AS7343_640nm\":\"%s\","
          "\"AS7343_690nm\":\"%s\","
          "\"AS7343_745nm\":\"%s\","
          "\"AS7343_855nm\":\"%s\","
          "\"AS7343_VISIBLE\":\"%s\""
        "}"
      "},"
      "\"signature\":{"
        "\"alg\":\"%s\","
        "\"keyId\":\"%s\","
        "\"value\":\"%s\""
      "}"
    "}";

// API
extern void fill_json_packet(const tracker_payload_t *payload, struct json_full_packet *packet);
extern void encode_and_print_json(const struct json_full_packet *packet);

#endif // BASE_JSON_H
```
