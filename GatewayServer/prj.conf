## prj.conf
```kconfig
# ============================================================
# WiFi Board (ESP32 #2) — UART RX from BLE board + Azure MQTT
# ============================================================

# –– Core ––
CONFIG_INIT_STACKS=y
CONFIG_MAIN_STACK_SIZE=2048
CONFIG_SYSTEM_WORKQUEUE_STACK_SIZE=2048
CONFIG_PRINTK=y

# –– Logging (INFO only) ––
CONFIG_LOG=y
CONFIG_LOG_DEFAULT_LEVEL=3
CONFIG_LOG_MODE_DEFERRED=n
CONFIG_LOG_BUFFER_SIZE=2048
CONFIG_LOG_BACKEND_UART=y

# –– UART (for receiving JSON from BLE board) ––
CONFIG_SERIAL=y
CONFIG_UART_INTERRUPT_DRIVEN=y

# –– Networking Core ––
CONFIG_NETWORKING=y
CONFIG_NET_MGMT=y
CONFIG_NET_MGMT_EVENT=y
CONFIG_NET_MGMT_EVENT_INFO=y
CONFIG_NET_CONFIG_AUTO_INIT=y
CONFIG_NET_CONFIG_SETTINGS=y
CONFIG_NET_CONFIG_INIT_TIMEOUT=1

# –– WiFi ––
CONFIG_WIFI=y
CONFIG_WIFI_ESP32=y
CONFIG_NET_L2_WIFI_MGMT=y

# SNTP
CONFIG_SNTP=y

# –– IP (IPv4 only) ––
CONFIG_NET_IPV4=y
CONFIG_NET_IPV6=n
CONFIG_NET_ARP=y

# –– DHCP ––
CONFIG_NET_DHCPV4=y

# –– Sockets ––
CONFIG_NET_TCP=y
CONFIG_NET_SOCKETS=y
CONFIG_POSIX_API=y

# –– DNS ––
CONFIG_DNS_RESOLVER=y
CONFIG_DNS_RESOLVER_AI_MAX_ENTRIES=4

# –– MQTT ––
CONFIG_MQTT_LIB=y
CONFIG_MQTT_LIB_TLS=y
CONFIG_MQTT_KEEPALIVE=60

# –– TLS / MbedTLS ––
CONFIG_TLS_CREDENTIALS=y
CONFIG_NET_SOCKETS_SOCKOPT_TLS=y
CONFIG_NET_SOCKETS_TLS_MAX_CONTEXTS=2
CONFIG_MBEDTLS=y
CONFIG_MBEDTLS_BUILTIN=y
CONFIG_MBEDTLS_ENABLE_HEAP=y
CONFIG_MBEDTLS_HEAP_SIZE=45000
CONFIG_MBEDTLS_SSL_MAX_CONTENT_LEN=4096
CONFIG_MBEDTLS_PEM_CERTIFICATE_FORMAT=y
CONFIG_MBEDTLS_TLS_VERSION_1_2=y
CONFIG_MBEDTLS_SERVER_NAME_INDICATION=y
CONFIG_MBEDTLS_CIPHER_AES_ENABLED=y
CONFIG_MBEDTLS_CIPHER_GCM_ENABLED=y
CONFIG_MBEDTLS_ECDH_C=y
CONFIG_MBEDTLS_ECP_C=y
CONFIG_MBEDTLS_PKCS1_V15=y
CONFIG_MBEDTLS_KEY_EXCHANGE_ECDHE_RSA_ENABLED=y
CONFIG_MBEDTLS_ECP_DP_SECP256R1_ENABLED=y
CONFIG_MBEDTLS_RSA_C=y

# –– Network Buffers ––
CONFIG_NET_TX_STACK_SIZE=2048
CONFIG_NET_RX_STACK_SIZE=2048
CONFIG_NET_PKT_RX_COUNT=8
CONFIG_NET_PKT_TX_COUNT=8
CONFIG_NET_BUF_RX_COUNT=16
CONFIG_NET_BUF_TX_COUNT=16
CONFIG_NET_BUF_DATA_SIZE=512
CONFIG_NET_MAX_CONTEXTS=6

# –– Heap ––
CONFIG_HEAP_MEM_POOL_SIZE=52000

# –– JSON + UUID ––
CONFIG_JSON_LIBRARY=y
CONFIG_UUID=y
CONFIG_UUID_V4=y


# Enable float formatting in cbprintf
CONFIG_CBPRINTF_FP_SUPPORT=y

# ── ESP32-specific ────────────────────────────────────────
CONFIG_ESP32_USE_UNSUPPORTED_REVISION=y
```

## src/main.c
```c
/*
 * main.c — WiFi Board (ESP32 #2)
 *
 * Boot sequence:
 *   1. WiFi thread — connects and obtains IP
 *   2. Azure MQTT thread — connects to IoT Hub, runs keepalive loop
 *   3. UART bridge — receives sensor JSON frames from BLE gateway, publishes to Azure
 *   4. SNTP sync — queries NTP, forwards UTC to BLE gateway via UART every 60s
 */

#include <zephyr/kernel.h>
#include <zephyr/logging/log.h>
#include "wifi.h"
#include "azure_mqtt.h"
#include "uart_bridge.h"
#include "sntp_sync.h"

LOG_MODULE_REGISTER(main, LOG_LEVEL_INF);

#define WIFI_THREAD_STACK  4096
#define WIFI_THREAD_PRIO   6

K_THREAD_STACK_DEFINE(wifi_stack, WIFI_THREAD_STACK);
static struct k_thread wifi_tid;

int main(void)
{
    LOG_INF("=== WiFi+Azure Gateway starting ===");

    /* 1. Start WiFi — blocks until IP obtained */
    k_thread_create(&wifi_tid,
                    wifi_stack,
                    K_THREAD_STACK_SIZEOF(wifi_stack),
                    (k_thread_entry_t)wifi_thread,
                    NULL, NULL, NULL,
                    WIFI_THREAD_PRIO, 0, K_NO_WAIT);
    k_thread_name_set(&wifi_tid, "wifi");
    k_thread_join(&wifi_tid, K_SECONDS(30));

    /* 2. Start Azure MQTT thread */
    LOG_INF("Starting Azure MQTT thread");
    azure_mqtt_thread_start();

    /* 3. Give MQTT a moment to connect */
    k_sleep(K_SECONDS(5));

    /* 4. Start UART bridge (RX: sensor frames from gateway → Azure publish) */
    LOG_INF("Starting UART bridge");
    uart_bridge_start();

    /* 5. Start SNTP sync (TX: UTC frames → gateway → sensor nodes) */
    LOG_INF("Starting SNTP sync");
    sntp_sync_start();

    return 0;
}
```

## src/my_json.c
```c
#include <zephyr/logging/log.h>
#include <zephyr/logging/log_ctrl.h>
#include <zephyr/sys/uuid.h>
#include "my_json.h"
#include <string.h>
#include <stdio.h>
#include <time.h>

LOG_MODULE_REGISTER(json_module);

/* ── UUID helper ────────────────────────────────────────── */
static void generate_uuid(char *uuid_str)
{
    struct uuid u;
    if (uuid_generate_v4(&u) != 0) { uuid_str[0] = '\0'; return; }
    if (uuid_to_string(&u, uuid_str) != 0) { uuid_str[0] = '\0'; }
}

/* ── fill_json_packet ───────────────────────────────────── */
void fill_json_packet(const tracker_payload_t *p, struct json_full_packet *j)
{
    if (!p || !j) return;
    memset(j, 0, sizeof(*j));

    /* Header */
    char uuid_str[UUID_STR_LEN] = {0};
    generate_uuid(uuid_str);
    snprintk(j->header.messageId, sizeof(j->header.messageId),
             "%s", uuid_str[0] ? uuid_str : "00000000-0000-0000-0000-000000000000");
    snprintk(j->header.gatewayId,     sizeof(j->header.gatewayId),     "GW-01");
    snprintk(j->header.schemaVersion, sizeof(j->header.schemaVersion), "1");
    snprintk(j->header.messageType,   sizeof(j->header.messageType),   "telemetry");

    /* Payload — top level */
    snprintk(j->payload.deviceId, sizeof(j->payload.deviceId), "dev-%u", p->dev_id);

    time_t raw = (time_t)p->time;
    struct tm tm_utc;
    if (gmtime_r(&raw, &tm_utc) == NULL) {
        snprintk(j->payload.timestamp, sizeof(j->payload.timestamp), "%u", p->time);
    } else {
        snprintk(j->payload.timestamp, sizeof(j->payload.timestamp),
                 "%04d-%02d-%02dT%02d:%02d:%02d.%03uZ",
                 tm_utc.tm_year + 1900, tm_utc.tm_mon + 1, tm_utc.tm_mday,
                 tm_utc.tm_hour, tm_utc.tm_min, tm_utc.tm_sec, p->time_ms);
    }
    j->payload.uptime_ms = p->uptime_ms;
    j->payload.proto_ver = p->proto_ver;

    /* Environment */
    j->payload.environment.temperature_c    = (double)p->temp_c_x100    / 100.0;
    j->payload.environment.humidity_percent = (double)p->rh_x100        / 100.0;
    j->payload.environment.pressure_hpa     = (double)p->press_hPa_x1000 / 1000.0;
    j->payload.environment.eco2_ppm = p->eco2_ppm;
    j->payload.environment.tvoc_ppb = p->tvoc_ppb;
    j->payload.environment.aqi      = p->aqi;
    j->payload.environment.batt_mV  = p->batt_mV;

    /* AS7343 light spectrum */
    j->payload.spectrum.AS7343_405nm   = p->as7343[0];
    j->payload.spectrum.AS7343_425nm   = p->as7343[1];
    j->payload.spectrum.AS7343_450nm   = p->as7343[2];
    j->payload.spectrum.AS7343_475nm   = p->as7343[3];
    j->payload.spectrum.AS7343_515nm   = p->as7343[4];
    j->payload.spectrum.AS7343_550nm   = p->as7343[5];
    j->payload.spectrum.AS7343_555nm   = p->as7343[6];
    j->payload.spectrum.AS7343_600nm   = p->as7343[7];
    j->payload.spectrum.AS7343_640nm   = p->as7343[8];
    j->payload.spectrum.AS7343_690nm   = p->as7343[9];
    j->payload.spectrum.AS7343_745nm   = p->as7343[10];
    j->payload.spectrum.AS7343_855nm   = p->as7343[11];
    j->payload.spectrum.AS7343_VISIBLE = p->as7343[12];

    /* Sound summary */
    j->payload.sound.rms_dbfs     = (double)p->snd_rms_dbfs_x100 / 100.0;
    j->payload.sound.peak_freq_hz = p->snd_peak_freq_hz;
    j->payload.sound.peak_mag     = (double)p->snd_peak_mag_x10  / 10.0;

    /* Soil moisture */
    j->payload.soil_vwc = (double)p->soil_vwc_x100 / 100.0;
}

/* ── encode_and_print_json ──────────────────────────────── */
void encode_and_print_json(const struct json_full_packet *j)
{
    static char json_output[JSON_BUFFER_SIZE];

    int ret = snprintk(json_output, sizeof(json_output),
        JSON_FORMAT,
        j->header.messageId,
        j->header.gatewayId,
        j->header.schemaVersion,
        j->header.messageType,
        j->payload.deviceId,
        j->payload.timestamp,
        j->payload.uptime_ms,
        j->payload.proto_ver,
        j->payload.environment.temperature_c,
        j->payload.environment.humidity_percent,
        j->payload.environment.pressure_hpa,
        j->payload.environment.eco2_ppm,
        j->payload.environment.tvoc_ppb,
        j->payload.environment.aqi,
        j->payload.environment.batt_mV,
        j->payload.spectrum.AS7343_405nm,
        j->payload.spectrum.AS7343_425nm,
        j->payload.spectrum.AS7343_450nm,
        j->payload.spectrum.AS7343_475nm,
        j->payload.spectrum.AS7343_515nm,
        j->payload.spectrum.AS7343_550nm,
        j->payload.spectrum.AS7343_555nm,
        j->payload.spectrum.AS7343_600nm,
        j->payload.spectrum.AS7343_640nm,
        j->payload.spectrum.AS7343_690nm,
        j->payload.spectrum.AS7343_745nm,
        j->payload.spectrum.AS7343_855nm,
        j->payload.spectrum.AS7343_VISIBLE,
        j->payload.sound.rms_dbfs,
        j->payload.sound.peak_freq_hz,
        j->payload.sound.peak_mag,
        j->payload.soil_vwc
    );

    if (ret > 0 && ret < (int)sizeof(json_output)) {
        printk("%s\n", json_output);
    } else {
        printk("JSON encoding failed (ret=%d)\n", ret);
    }
    log_flush();
}

/* ── encode_sound_json ──────────────────────────────────── */
int encode_sound_json(const sound_payload_t *sp, char *buf, size_t buf_size)
{
    if (!sp || !buf) return -EINVAL;

    char uuid_str[UUID_STR_LEN] = {0};
    generate_uuid(uuid_str);

    /* Fixed header section */
    int pos = snprintk(buf, buf_size,
        "{"
          "\"header\":{"
            "\"messageId\":\"%s\","
            "\"gatewayId\":\"GW-01\","
            "\"schemaVersion\":\"1\","
            "\"messageType\":\"sound_spectrum\""
          "},"
          "\"payload\":{"
            "\"deviceId\":\"dev-%u\","
            "\"uptime_ms\":%u,"
            "\"rms_dbfs\":%.2f,"
            "\"bin_low_hz\":43,"
            "\"bin_res_hz\":43,"
            "\"bins\":[",
        uuid_str[0] ? uuid_str : "00000000-0000-0000-0000-000000000000",
        (unsigned)sp->dev_id,
        (unsigned)sp->uptime_ms,
        (double)sp->rms_dbfs_x100 / 100.0
    );

    if (pos <= 0 || (size_t)pos >= buf_size) return -ENOMEM;

    /* 348 bin values — built iteratively to avoid a giant format string */
    for (int i = 0; i < SOUND_NUM_BINS; i++) {
        double mag = (double)sp->bins[i] / 10.0;
        int w = snprintk(buf + pos, buf_size - pos,
                         (i < SOUND_NUM_BINS - 1) ? "%.1f," : "%.1f", mag);
        if (w <= 0 || (size_t)(pos + w) >= buf_size) {
            LOG_ERR("Sound JSON buffer overflow at bin %d", i);
            return -ENOMEM;
        }
        pos += w;
    }

    /* Close */
    int tail = snprintk(buf + pos, buf_size - pos, "]}}");
    if (tail <= 0) return -ENOMEM;
    pos += tail;

    return pos;
}
```

## src/uart_bridge.c
```c
/*
 * uart_bridge.c — WiFi Board (ESP32 #2)
 *
 * Receives framed binary packets from the BLE gateway board via UART2
 * (GPIO16 RX), decodes them, encodes JSON, and publishes to Azure IoT Hub.
 *
 * Two frame types:
 *
 *   Sensor:  [ 0xAA ] [ 0x00 ] [ 0x3D ] [ 61 bytes  ]
 *   Sound   [ 0xBB ][ len_hi ][ len_lo ][ 698 bytes ]
 *
 * Length is big-endian uint16:
 *   Sensor = 57  (0x00 0x39)
 *   Sound  = 698 (0x02 0xBA)
 *
 * Sensor packet → messageType "telemetry"       (~1.5 KB JSON)
 * Sound  packet → messageType "sound_spectrum"  (~4 KB JSON)
 *
 * Sensor binary layout (57 bytes):
 *   [0..3]   time           uint32 BE
 *   [4..7]   uptime_ms      uint32 BE
 *   [8]      proto_ver
 *   [9]      dev_id
 *   [10..11] temp_c_x100    int16 BE
 *   [12..13] rh_x100        int16 BE
 *   [14..17] press_hPa_x1000 int32 BE
 *   [18..19] eco2_ppm       uint16 BE
 *   [20..21] tvoc_ppb       uint16 BE
 *   [22]     aqi
 *   [23..48] AS7343 ×13     uint16 BE each (26 bytes)
 *   [49..50] batt_mV        uint16 BE
 *   [51..52] snd_rms_dbfs_x100 int16 BE
 *   [53..54] snd_peak_freq_hz  uint16 BE
 *   [55..56] snd_peak_mag_x10  uint16 BE
 *   [57..58] soil_vwc_x100     uint16 BE  — VWC % × 100
 *
 * Sound binary layout (698 bytes):
 *   [0..1]   rms_dbfs_x100  int16 BE
 *   [2..697] bins[348]      uint16 BE each, magnitude × 10
 */

#include <zephyr/kernel.h>
#include <zephyr/device.h>
#include <zephyr/drivers/uart.h>
#include <zephyr/logging/log.h>
#include <string.h>

#include "uart_bridge.h"
#include "azure_mqtt.h"
#include "my_json.h"

LOG_MODULE_REGISTER(uart_bridge, LOG_LEVEL_INF);

#define UART_DEVICE_NODE  DT_NODELABEL(uart2)

/* ── Frame constants ────────────────────────────────────── */
#define MAGIC_SENSOR       0xAA
#define MAGIC_SOUND        0xBB

#define SENSOR_PAYLOAD_LEN  61    /* +2 bytes for soil_vwc_x100 */
#define SOUND_PAYLOAD_LEN   698   /* 2 (rms) + 348×2 (bins) */
#define MAX_PAYLOAD_LEN     SOUND_PAYLOAD_LEN

/*
 * Ring buffer must comfortably hold the largest frame in flight.
 * Largest frame = 3 header bytes + 698 payload = 701 bytes.
 * Use 1024 for safe headroom.
 */
#define RING_BUF_SIZE   1024
#define UART_STACK_SIZE 4096   /* larger: sound JSON encode needs ~4 KB stack headroom */
#define UART_PRIO       8
/* ── UTC TX frame ───────────────────────────────────────── */
#define FRAME_MAGIC_UTC  0xCC

static const struct device *uart_dev;

/* ── Interrupt-driven ring buffer ───────────────────────── */
static uint8_t  rx_ring[RING_BUF_SIZE];
static volatile int rx_head = 0;
static volatile int rx_tail = 0;

static void uart_isr(const struct device *dev, void *user_data)
{
    ARG_UNUSED(user_data);
    while (uart_irq_update(dev) && uart_irq_rx_ready(dev)) {
        uint8_t byte;
        if (uart_fifo_read(dev, &byte, 1) != 1) break;
        int next = (rx_head + 1) % RING_BUF_SIZE;
        if (next != rx_tail) {
            rx_ring[rx_head] = byte;
            rx_head = next;
        } else {
            LOG_WRN("Ring buffer full — dropping byte");
        }
    }
}

static inline int ring_available(void)
{
    return (rx_head - rx_tail + RING_BUF_SIZE) % RING_BUF_SIZE;
}

static inline uint8_t ring_read(void)
{
    uint8_t b = rx_ring[rx_tail];
    rx_tail = (rx_tail + 1) % RING_BUF_SIZE;
    return b;
}

/* ── Sensor decode: 61 bytes → tracker_payload_t ────────── */
static void decode_sensor(const uint8_t *d, tracker_payload_t *p)
{
    size_t i = 0;

    p->time = ((uint32_t)d[i]<<24)|((uint32_t)d[i+1]<<16)|
              ((uint32_t)d[i+2]<<8)|d[i+3];       i += 4;
    p->time_ms = ((uint16_t)d[i]<<8)|d[i+1];      i += 2;
    p->uptime_ms = ((uint32_t)d[i]<<24)|((uint32_t)d[i+1]<<16)|
                   ((uint32_t)d[i+2]<<8)|d[i+3];  i += 4;

    p->proto_ver = d[i++];
    p->dev_id    = d[i++];

    p->temp_c_x100     = (int16_t)((d[i]<<8)|d[i+1]);  i += 2;
    p->rh_x100         = (int16_t)((d[i]<<8)|d[i+1]);  i += 2;
    p->press_hPa_x1000 = (int32_t)(((uint32_t)d[i]<<24)|((uint32_t)d[i+1]<<16)|
                                    ((uint32_t)d[i+2]<<8)|d[i+3]); i += 4;
    p->eco2_ppm = (uint16_t)((d[i]<<8)|d[i+1]); i += 2;
    p->tvoc_ppb = (uint16_t)((d[i]<<8)|d[i+1]); i += 2;
    p->aqi      = d[i++];

    for (int k = 0; k < AS7343_NUM_CH; k++) {
        p->as7343[k] = (uint16_t)((d[i]<<8)|d[i+1]); i += 2;
    }

    p->batt_mV           = (uint16_t)((d[i]<<8)|d[i+1]); i += 2;
    p->snd_rms_dbfs_x100 = (int16_t) ((d[i]<<8)|d[i+1]); i += 2;
    p->snd_peak_freq_hz  = (uint16_t)((d[i]<<8)|d[i+1]); i += 2;
    p->snd_peak_mag_x10  = (uint16_t)((d[i]<<8)|d[i+1]); i += 2;
    p->soil_vwc_x100     = (uint16_t)((d[i]<<8)|d[i+1]);
}

/* ── Sound decode: 698 bytes → sound_payload_t ──────────── */
static void decode_sound(const uint8_t *d, sound_payload_t *sp)
{
    sp->rms_dbfs_x100 = (int16_t)(((uint16_t)d[0] << 8) | d[1]);
    for (int i = 0; i < SOUND_NUM_BINS; i++) {
        sp->bins[i] = (uint16_t)(((uint16_t)d[2 + i*2] << 8) | d[2 + i*2 + 1]);
    }
    /* dev_id and uptime_ms filled by caller */
}

/* ── State machine ──────────────────────────────────────── */
typedef enum {
    STATE_HUNT,      /* scanning for 0xAA or 0xBB     */
    STATE_LEN_HI,    /* high byte of 16-bit length     */
    STATE_LEN_LO,    /* low byte  of 16-bit length     */
    STATE_PAYLOAD,   /* accumulating payload bytes     */
} frame_state_t;

/*
 * Static payload accumulation buffer — 698 bytes.
 * Lives in BSS, never on the thread stack.
 */
static uint8_t s_payload[MAX_PAYLOAD_LEN];

K_THREAD_STACK_DEFINE(uart_bridge_stack, UART_STACK_SIZE);
static struct k_thread uart_bridge_tid;

static void uart_bridge_thread(void)
{
    LOG_INF("UART bridge started (UART2 GPIO16 RX)");

    frame_state_t state        = STATE_HUNT;
    uint8_t       frame_magic  = 0;
    uint16_t      expected_len = 0;
    uint16_t      payload_idx  = 0;

    /*
     * All working buffers are static — the sound JSON is ~4 KB which
     * would overflow a 4 KB thread stack if placed on it.
     */
    static tracker_payload_t   sensor_pkt;
    static sound_payload_t     sound_pkt;
    static struct json_full_packet jp;
    static char sensor_json[JSON_BUFFER_SIZE];
    static char sound_json[SOUND_JSON_BUFFER_SIZE];

    while (true) {
        if (ring_available() == 0) {
            k_sleep(K_MSEC(2));
            continue;
        }

        uint8_t b = ring_read();

        switch (state) {

        /* ── Hunt for a known magic byte ── */
        case STATE_HUNT:
            if (b == MAGIC_SENSOR || b == MAGIC_SOUND) {
                frame_magic = b;
                state       = STATE_LEN_HI;
            }
            break;

        /* ── High byte of payload length ── */
        case STATE_LEN_HI:
            expected_len = (uint16_t)b << 8;
            state        = STATE_LEN_LO;
            break;

        /* ── Low byte of payload length — validate ── */
        case STATE_LEN_LO:
            expected_len |= b;

            if (frame_magic == MAGIC_SENSOR && expected_len == SENSOR_PAYLOAD_LEN) {
                payload_idx = 0;
                state       = STATE_PAYLOAD;
            } else if (frame_magic == MAGIC_SOUND && expected_len == SOUND_PAYLOAD_LEN) {
                payload_idx = 0;
                state       = STATE_PAYLOAD;
            } else {
                LOG_WRN("Bad frame: magic=0x%02x len=%u — re-hunting",
                        frame_magic, expected_len);
                state = STATE_HUNT;
            }
            break;

        /* ── Accumulate payload bytes ── */
        case STATE_PAYLOAD:
            s_payload[payload_idx++] = b;

            if (payload_idx < expected_len) {
                break;  /* still collecting */
            }

            /* ════ Complete frame received ════ */

            if (frame_magic == MAGIC_SENSOR) {
                /* Decode → fill JSON structs → encode → publish */
                memset(&sensor_pkt, 0, sizeof(sensor_pkt));
                memset(&jp,         0, sizeof(jp));

                decode_sensor(s_payload, &sensor_pkt);
                fill_json_packet(&sensor_pkt, &jp);

                int ret = snprintk(sensor_json, sizeof(sensor_json),
                    JSON_FORMAT,
                    jp.header.messageId,
                    jp.header.gatewayId,
                    jp.header.schemaVersion,
                    jp.header.messageType,
                    jp.payload.deviceId,
                    jp.payload.timestamp,
                    jp.payload.uptime_ms,
                    jp.payload.proto_ver,
                    jp.payload.environment.temperature_c,
                    jp.payload.environment.humidity_percent,
                    jp.payload.environment.pressure_hpa,
                    jp.payload.environment.eco2_ppm,
                    jp.payload.environment.tvoc_ppb,
                    jp.payload.environment.aqi,
                    jp.payload.environment.batt_mV,
                    jp.payload.spectrum.AS7343_405nm,
                    jp.payload.spectrum.AS7343_425nm,
                    jp.payload.spectrum.AS7343_450nm,
                    jp.payload.spectrum.AS7343_475nm,
                    jp.payload.spectrum.AS7343_515nm,
                    jp.payload.spectrum.AS7343_550nm,
                    jp.payload.spectrum.AS7343_555nm,
                    jp.payload.spectrum.AS7343_600nm,
                    jp.payload.spectrum.AS7343_640nm,
                    jp.payload.spectrum.AS7343_690nm,
                    jp.payload.spectrum.AS7343_745nm,
                    jp.payload.spectrum.AS7343_855nm,
                    jp.payload.spectrum.AS7343_VISIBLE,
                    jp.payload.sound.rms_dbfs,
                    jp.payload.sound.peak_freq_hz,
                    jp.payload.sound.peak_mag,
                    jp.payload.soil_vwc
                );

                if (ret > 0 && ret < (int)sizeof(sensor_json)) {
                    int pub = azure_mqtt_publish(sensor_json);
                    if (pub < 0) LOG_WRN("Sensor publish failed (%d)", pub);
                    else         LOG_INF("Sensor published dev-%u (%d bytes)",
                                         sensor_pkt.dev_id, ret);
                } else {
                    LOG_ERR("Sensor JSON encode failed (ret=%d)", ret);
                }

            } else { /* MAGIC_SOUND */
                memset(&sound_pkt, 0, sizeof(sound_pkt));

                decode_sound(s_payload, &sound_pkt);
                sound_pkt.uptime_ms = sntp_get_last_utc(NULL);
                /* dev_id unknown at this layer — gateway has no per-conn context */
                sound_pkt.dev_id = 0;

                int ret = encode_sound_json(&sound_pkt,
                                            sound_json, sizeof(sound_json));
                if (ret > 0) {
                    // int pub = azure_mqtt_publish(sound_json);
                    // if (pub < 0) LOG_WRN("Sound publish failed (%d)", pub);
                    // else         LOG_INF("Sound spectrum published (%d bytes JSON)", ret);
                    static uint8_t sound_pkt_count = 0;
                    if (++sound_pkt_count >= 10) {
                        sound_pkt_count = 0;
                        int pub = azure_mqtt_publish(sound_json);
                        if (pub < 0) LOG_WRN("Sound publish failed (%d)", pub);
                        else         LOG_INF("Sound spectrum published (%d bytes JSON)", ret);
                    } else {
                        LOG_DBG("Sound spectrum skipped (%u/10)", sound_pkt_count);
                    }
                } else {
                    LOG_ERR("Sound JSON encode failed (%d)", ret);
                }
            }

            state = STATE_HUNT;
            break;
        }
    }
}

/* ── Public API ─────────────────────────────────────────── */
void uart_bridge_start(void)
{
    uart_dev = DEVICE_DT_GET(UART_DEVICE_NODE);
    if (!device_is_ready(uart_dev)) {
        LOG_ERR("UART2 not ready — check overlay");
        return;
    }

    uart_irq_callback_set(uart_dev, uart_isr);
    uart_irq_rx_enable(uart_dev);

    k_thread_create(&uart_bridge_tid,
                    uart_bridge_stack,
                    K_THREAD_STACK_SIZEOF(uart_bridge_stack),
                    (k_thread_entry_t)uart_bridge_thread,
                    NULL, NULL, NULL,
                    UART_PRIO, 0, K_NO_WAIT);
    k_thread_name_set(&uart_bridge_tid, "uart_bridge");

    LOG_INF("UART bridge started");
}

void uart_bridge_send_utc(uint32_t utc_time, uint16_t utc_ms)
{
    if (!uart_dev || !device_is_ready(uart_dev)) {
        LOG_WRN("uart_bridge_send_utc: UART not ready");
        return;
    }

    uint8_t frame[7] = {
        FRAME_MAGIC_UTC,
        (uint8_t)(utc_time >> 24),
        (uint8_t)(utc_time >> 16),
        (uint8_t)(utc_time >>  8),
        (uint8_t)(utc_time       ),
        (uint8_t)(utc_ms   >>  8),
        (uint8_t)(utc_ms         ),
    };

    for (int i = 0; i < (int)sizeof(frame); i++) {
        uart_poll_out(uart_dev, frame[i]);
    }

    LOG_INF("UTC frame sent: %" PRIu32 ".%03u", utc_time, utc_ms);
}
```
