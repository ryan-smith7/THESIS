## prj.conf
```kconfig
# ============================================================
# Combined: BLE Central + WiFi + Azure IoT Hub MQTT/TLS
# Target: esp32_devkitc_wrover/esp32/procpu
# ============================================================

# –– Core ––
CONFIG_INIT_STACKS=y
CONFIG_MAIN_STACK_SIZE=2048
CONFIG_SYSTEM_WORKQUEUE_STACK_SIZE=1536
CONFIG_PRINTK=y
CONFIG_CBPRINTF_FP_SUPPORT=y

# –– Logging ––
CONFIG_LOG=y
CONFIG_LOG_DEFAULT_LEVEL=3
CONFIG_LOG_MODE_DEFERRED=n
CONFIG_LOG_BUFFER_SIZE=256
CONFIG_LOG_BACKEND_UART=y
CONFIG_SHELL=n
CONFIG_SHELL_LOG_BACKEND=n

# –– JSON ––
CONFIG_JSON_LIBRARY=y

# –– UUID ––
CONFIG_UUID=y
CONFIG_UUID_V4=y

# –– Peripherals ––
CONFIG_GPIO=y
CONFIG_I2C=y
CONFIG_SENSOR=y
# CONFIG_RTC=y

# –– Bluetooth Central (GATT client) ––
# Uncomment this entire block when adding BT.
# BT host buffers are PSRAM-safe (no DMA); only the controller
# HCI buffers (managed by ESP-IDF, not these Kconfig symbols) need DRAM.
# The dual-heap in esp_wifi_adapter.c reserves 32KB DRAM for WiFi DMA,
# leaving the remaining DRAM headroom for BT controller HCI buffers.
CONFIG_BT=y
CONFIG_BT_CENTRAL=y
CONFIG_BT_PERIPHERAL=n
CONFIG_BT_GATT_CLIENT=y
CONFIG_BT_MAX_CONN=2
CONFIG_BT_MAX_PAIRED=2
CONFIG_BT_SMP=y
CONFIG_BT_BUF_ACL_RX_SIZE=200
CONFIG_BT_BUF_ACL_TX_SIZE=200
CONFIG_BT_L2CAP_TX_MTU=71
CONFIG_BT_L2CAP_TX_BUF_COUNT=4
CONFIG_BT_CONN_TX_MAX=4

# –– Networking Core ––
CONFIG_NETWORKING=y
CONFIG_NET_MGMT=y
CONFIG_NET_MGMT_EVENT=y
CONFIG_NET_MGMT_EVENT_INFO=y
CONFIG_NET_CONFIG_AUTO_INIT=y
CONFIG_NET_CONFIG_SETTINGS=y
CONFIG_NET_CONFIG_INIT_TIMEOUT=0

# –– WiFi ––
CONFIG_WIFI=y
CONFIG_WIFI_ESP32=y
CONFIG_NET_L2_WIFI_MGMT=y
# Dual-heap in esp_wifi_adapter.c routes WiFi management allocs to PSRAM
# and DMA/internal allocs to a dedicated 32KB DRAM heap. Both flags now
# work correctly — no longer breaks WiFi connection.
# CONFIG_ESP_WIFI_HEAP_SPIRAM=y
CONFIG_ESP32_WIFI_NET_ALLOC_SPIRAM=y

# –– ESP32 WiFi internal buffer sizing ––
# RX BA window raised back to 16 — DRAM pressure relieved by dual-heap.
CONFIG_ESP32_WIFI_RX_BA_WIN=16

# –– IP (IPv4 only) ––
CONFIG_NET_IPV4=y
CONFIG_NET_IPV6=n
CONFIG_NET_ARP=y

# –– DHCP ––
CONFIG_NET_DHCPV4=y

# –– Sockets ––
CONFIG_NET_TCP=y
CONFIG_NET_SOCKETS=y
CONFIG_POSIX_API=y

# –– DNS ––
CONFIG_DNS_RESOLVER=y
CONFIG_DNS_RESOLVER_AI_MAX_ENTRIES=2

# –– MQTT ––
CONFIG_MQTT_LIB=y
CONFIG_MQTT_LIB_TLS=n
CONFIG_MQTT_KEEPALIVE=10


# –– TLS / MbedTLS ––

# –– Network Buffers ––
# 128-byte data size keeps net_buf allocations small enough to stay in DRAM.
CONFIG_NET_TX_STACK_SIZE=1536
CONFIG_NET_RX_STACK_SIZE=1536
CONFIG_NET_MAX_CONTEXTS=6
CONFIG_NET_PKT_RX_COUNT=12
CONFIG_NET_PKT_TX_COUNT=8
CONFIG_NET_BUF_RX_COUNT=24
CONFIG_NET_BUF_TX_COUNT=16
CONFIG_NET_BUF_DATA_SIZE=512

# –– Heap ––
# 16KB DRAM anchor for early boot and general Zephyr allocations.
# The dual-heap in esp_wifi_adapter.c manages its own 32KB DRAM pool
# for WiFi DMA and 120KB PSRAM pool for WiFi management separately —
# those do not draw from this general heap.
CONFIG_HEAP_MEM_POOL_SIZE=16384

# –– SNTP ––
CONFIG_SNTP=y

# –– PSRAM ––
# Skip memtest to reduce boot time — saves ~1 second which previously
CONFIG_ESP_SPIRAM=y
```

## src/main.c
```c
/*
 * main.c — Combined BLE Central + WiFi + Azure IoT Hub Gateway (WROVER)
 *
 * Boot sequence:
 *   1. WiFi thread — connects and obtains IP (retries forever, no false-start)
 *   2. Azure MQTT thread — connects to IoT Hub, keepalive loop
 *   3. SNTP sync — sets UTC reference for time_sync_writer
 *   4. BLE threads — scan, connect to sensor nodes, decode + publish direct
 */

#include <zephyr/kernel.h>
#include <zephyr/logging/log.h>

#include "wifi.h"
#include "azure_mqtt.h"
#include "bluetooth.h"
#include "sntp_sync.h"

LOG_MODULE_REGISTER(main, LOG_LEVEL_INF);

#define WIFI_THREAD_STACK  4096
#define WIFI_THREAD_PRIO   4

K_THREAD_STACK_DEFINE(wifi_stack, WIFI_THREAD_STACK);
static struct k_thread wifi_tid;

/*
 * BLE threads — use K_THREAD_DEFINE with a delay so WiFi + Azure
 * are up before BLE starts trying to publish.
 * Delay is 15s: WiFi ~5s + MQTT connect ~5s + margin.
 */
K_THREAD_DEFINE(process_data_tid,
                BASE_PROCESS_STACK_SIZE,
                process_data_thread,
                NULL, NULL, NULL,
                BASE_PROCESS_PRIORITY, 0,
                15000);

K_THREAD_DEFINE(base_tid,
                BASE_CONTROL_STACK_SIZE,
                base_thread,
                NULL, NULL, NULL,
                BASE_CONTROL_PRIORITY, 0,
                15000);

int main(void)
{
    LOG_INF("=== Combined BLE+WiFi Gateway starting (WROVER) ===");

    /*
     * Start WiFi thread and wait for it to exit (it exits only after
     * obtaining an IP address). No timeout — if WiFi never connects,
     * there is nothing useful to do anyway.
     */
    k_thread_create(&wifi_tid,
                    wifi_stack,
                    K_THREAD_STACK_SIZEOF(wifi_stack),
                    (k_thread_entry_t)wifi_thread,
                    NULL, NULL, NULL,
                    WIFI_THREAD_PRIO, 0, K_NO_WAIT);
    k_thread_name_set(&wifi_tid, "wifi");
    k_thread_join(&wifi_tid, K_FOREVER);   /* block until IP obtained */

    LOG_INF("WiFi ready — starting Azure MQTT");
    azure_mqtt_thread_start();

    /* Give MQTT a moment to connect before SNTP tries DNS */
    k_sleep(K_SECONDS(3));

    LOG_INF("Starting SNTP sync");
    sntp_sync_start();

    /* BLE threads start automatically via K_THREAD_DEFINE delay above */
    LOG_INF("Boot complete — BLE threads will start in ~15s");

    return 0;
}
```

## include/azure_mqtt.h
```c
#ifndef AZURE_MQTT_H_
#define AZURE_MQTT_H_

#include <zephyr/kernel.h>
#include <zephyr/net/mqtt.h>

/* -----------------------------------------------------------------------
 * USER CONFIGURATION — fill these in before building
 * --------------------------------------------------------------------- */

/* Oracle Cloud MQTT bridge — plaintext, no TLS required on device.
 * Bridge forwards to Azure IoT Hub over TLS server-side.
 * For production replace with ESP32-WROVER and direct Azure connection. */
#define AZURE_IOT_HUB_HOSTNAME   "161.33.232.177"

/* Device ID registered in your IoT Hub */
#define AZURE_DEVICE_ID          "esp32-device-01"

/* SAS Token — only used for direct Azure connection (TLS mode).
 * Not required for plaintext bridge connection but kept for reference. */
#define AZURE_SAS_TOKEN "SharedAccessSignature sr=iot-hub-esp32-Ryan-Smith.azure-devices.net%2Fdevices%2Fesp32-device-01&sig=UW9GXFziBPCEIqktFMXPJWlr%2FOT3QcqcGpT8sDedLmA%3D&se=1805251216"

/* Root CA cert — not used in plaintext bridge mode.
 * Kept for reference for production WROVER deployment. */
#define AZURE_ROOT_CA_CERT \
"-----BEGIN CERTIFICATE-----\r\n"\
"MIIDjjCCAnagAwIBAgIQAzrx5qcRqaC7KGSxHQn65TANBgkqhkiG9w0BAQsFADBh\r\n"\
"MQswCQYDVQQGEwJVUzEVMBMGA1UEChMMRGlnaUNlcnQgSW5jMRkwFwYDVQQLExB3\r\n"\
"d3cuZGlnaWNlcnQuY29tMSAwHgYDVQQDExdEaWdpQ2VydCBHbG9iYWwgUm9vdCBH\r\n"\
"MjAeFw0xMzA4MDExMjAwMDBaFw0zODAxMTUxMjAwMDBaMGExCzAJBgNVBAYTAlVT\r\n"\
"MRUwEwYDVQQKEwxEaWdpQ2VydCBJbmMxGTAXBgNVBAsTEHd3dy5kaWdpY2VydC5j\r\n"\
"b20xIDAeBgNVBAMTF0RpZ2lDZXJ0IEdsb2JhbCBSb290IEcyMIIBIjANBgkqhkiG\r\n"\
"9w0BAQEFAAOCAQ8AMIIBCgKCAQEAuzfNNNx7a8myaJCtSnX/RrohCgiN9RlUyfuI\r\n"\
"2/Ou8jqJkTx65qsGGmvPrC3oXgkkRLpimn7Wo6h+4FR1IAWsULecYxpsMNzaHxmx\r\n"\
"1x7e/dfgy5SDN67sH0NO3Xss0r0upS/kqbitOtSZpLYl6ZtrAGCSYP9PIUkY92eQ\r\n"\
"q2EGnI/yuum06ZIya7XzV+hdG82MHauVBJVJ8zUtluNJbd134/tJS7SsVQepj5Wz\r\n"\
"tCO7TG1F8PapspUwtP1MVYwnSlcUfIKdzXOS0xZKBgyMUNGPHgm+F6HmIcr9g+UQ\r\n"\
"vIOlCsRnKPZzFBQ9RnbDhxSJITRNrw9FDKZJobq7nMWxM4MphQIDAQABo0IwQDAP\r\n"\
"BgNVHRMBAf8EBTADAQH/MA4GA1UdDwEB/wQEAwIBhjAdBgNVHQ4EFgQUTiJUIBiV\r\n"\
"5uNu5g/6+rkS7QYXjzkwDQYJKoZIhvcNAQELBQADggEBAGBnKJRvDkhj6zHd6mcY\r\n"\
"1Yl9PMWLSn/pvtsrF9+wX3N3KjITOYFnQoQj8kVnNeyIv/iPsGEMNKSuIEyExtv4\r\n"\
"NeF22d+mQrvHRAiGfzZ0JFrabA0UWTW98kndth/Jsw1HKj2ZL7tcu7XUIOGZX1NG\r\n"\
"Fdtom/DzMNU+MeKNhJ7jitralj41E6Vf8PlwUHBHQRFXGU7Aj64GxJUTFy8bJZ91\r\n"\
"8rGOmaFvE7FBcf6IKshPECBV1/MUReXgRPTqh5Uykw7+U0b6LJ3/iyK5S9kJRaTe\r\n"\
"pLiaWN0bfVKfjllDiIGknibVb63dDcY3fe0Dkhvld1927jyNxF1WW6LZZm6zNTfl\r\n"\
"MrY=\r\n"\
"-----END CERTIFICATE-----\r\n"

/* -----------------------------------------------------------------------
 * MQTT connection settings
 * --------------------------------------------------------------------- */
/* Plaintext port for Oracle bridge — no TLS on device */
#define AZURE_MQTT_PORT      1883
#define AZURE_MQTT_CLIENT_ID AZURE_DEVICE_ID

/* Username/password not required for anonymous Oracle bridge connection */
#define AZURE_MQTT_USERNAME  ""
#define AZURE_MQTT_TOPIC  "devices/" AZURE_DEVICE_ID "/messages/events/$.ct=application%2Fjson&$.ce=utf-8"
#define AZURE_TLS_TAG        1

/* -----------------------------------------------------------------------
 * Public API
 * --------------------------------------------------------------------- */
int  azure_mqtt_connect(void);
int  azure_mqtt_publish(const char *json);
void azure_mqtt_process(void);
void azure_mqtt_thread(void);
void azure_mqtt_thread_start(void);

#endif /* AZURE_MQTT_H_ */
```

## include/env.h
```c
#ifndef ENV_H_
#define ENV_H_

#define PHONE_SSID    "Ryan IPhone 12 Mini"
#define PHONE_PSK     "Cedar2019"

/* Wi-Fi credentials */
#define CONFIG_WIFI_DEFAULT_SSID    PHONE_SSID
#define CONFIG_WIFI_DEFAULT_PSK     PHONE_PSK 

/* Backend API */
#define API_HOST    "your-backend-host.com"
#define API_KEY     "your-api-key-here"

#endif /* ENV_H_ */
```

## include/http_get.h
```c
#ifndef HTTP_GET_H
#define HTTP_GET_H

#include <zephyr/net/socket.h>

void nslookup(const char * hostname, struct zsock_addrinfo **results);

void print_addrinfo_results(struct zsock_addrinfo **results);

void http_get(int sock, char * hostname, char * url);

int connect_socket(struct zsock_addrinfo **results, uint16_t port);

int http_query(char * hostname, char * url);

#endif // HTTP_GET_H
```

## include/sntp_sync.h
```c
#ifndef SNTP_SYNC_H
#define SNTP_SYNC_H

#include <stdint.h>
/**
 * @brief Start the SNTP sync thread.
 *
 * Queries pool.ntp.org immediately after WiFi is ready, then re-syncs
 * every SNTP_RESYNC_INTERVAL_S seconds. On each successful sync, calls
 * uart_bridge_send_utc() to push the 0xCC UTC frame to the gateway.
 *
 * Call after WiFi is confirmed up (after wifi_thread joins in main.c).
 */
void sntp_sync_start(void);

/**
 * @brief Get the last successfully synced UTC timestamp, extrapolated to now.
 *
 * @param[out] out_ms  Sub-second milliseconds (0–999). May be NULL.
 * @return Unix UTC seconds, or 0 if no sync has occurred yet.
 */
uint32_t sntp_get_last_utc(uint16_t *out_ms);

#endif /* SNTP_SYNC_H */
```

## include/wifi.h
```c
#ifndef WIFI_H_
#define WIFI_H_

#define WIFI_RETRY_COUNT 10
#define MAX_SSID_LEN     32
#define MAX_PSK_LEN      64

extern char wifi_ssid[MAX_SSID_LEN];
extern char wifi_psk [MAX_PSK_LEN];

void wifi_connection_retry_reset(void);
void wifi_connect(void);
void wifi_callbacks_init(void);
void wifi_thread(void);

#endif /* WIFI_H_ */
```

## src/wifi.c
```c
// /*
//  * Copyright (c) 2017 ARM Ltd.
//  * Copyright (c) 2016 Intel Corporation.
//  *
//  * SPDX-License-Identifier: Apache-2.0
//  */

// #include <zephyr/kernel.h>
// #include <zephyr/net/net_if.h>
// #include <zephyr/net/wifi_mgmt.h>
// #include <zephyr/net/net_event.h>
// #include <zephyr/logging/log.h>
// #include <wifi.h>
// #include <env.h>

// char wifi_ssid[MAX_SSID_LEN] = CONFIG_WIFI_DEFAULT_SSID;
// char wifi_psk [MAX_PSK_LEN]  = CONFIG_WIFI_DEFAULT_PSK;

// K_MUTEX_DEFINE(wifi_retry_mutex);

// static uint8_t wifi_connection_retry_count = 0;
// static char    wifi_rety_dots[WIFI_RETRY_COUNT + 1] = {0};

// static K_SEM_DEFINE(wifi_connected, 0, 1);
// static K_SEM_DEFINE(ipv4_address_obtained, 0, 1);

// static bool got_ipv4 = false;

// static struct net_mgmt_event_callback wifi_cb;
// static struct net_mgmt_event_callback ipv4_cb;
// static struct net_mgmt_event_callback l4_cb;

// LOG_MODULE_REGISTER(wifi_module, LOG_LEVEL_INF);

// /* -------------------------------------------------------------------------
//  * Event handlers
//  * ----------------------------------------------------------------------- */

// static void handle_wifi_connect_result(struct net_mgmt_event_callback *cb)
// {
//     const struct wifi_status *status = (const struct wifi_status *)cb->info;

//     if (status->status) {
//         LOG_ERR("Connection request failed (%d)", status->status);
//     } else {
//         LOG_INF("WiFi connected");
//         k_sem_give(&wifi_connected);
//     }
// }

// static void handle_wifi_disconnect_result(struct net_mgmt_event_callback *cb)
// {
//     const struct wifi_status *status = (const struct wifi_status *)cb->info;

//     if (status->status) {
//         LOG_ERR("Disconnection request (%d)", status->status);

//         k_mutex_lock(&wifi_retry_mutex, K_FOREVER);
//         wifi_rety_dots[wifi_connection_retry_count++] = '.';

//         if (wifi_connection_retry_count < WIFI_RETRY_COUNT) {
//             k_msleep(1000 * wifi_connection_retry_count); /* exponential backoff */
//             LOG_INF("Retrying connection (%d)", wifi_connection_retry_count);
//             wifi_connect();
//         } else {
//             LOG_ERR("Max retries reached");
//         }

//         k_mutex_unlock(&wifi_retry_mutex);
//     } else {
//         LOG_INF("WiFi disconnected");
//         k_sem_take(&wifi_connected, K_NO_WAIT);
//     }
// }

// static void handle_ipv4_result(struct net_if *iface)
// {
//     if (got_ipv4) {
//         return;
//     }

//     struct net_if_config *cfg  = net_if_get_config(iface);
//     struct net_if_ipv4   *ipv4 = cfg->ip.ipv4;
//     char buf[NET_IPV4_ADDR_LEN];

//     for (int i = 0; i < NET_IF_MAX_IPV4_ADDR; i++) {
//         const struct net_if_addr_ipv4 *u = &ipv4->unicast[i];

//         if (u->ipv4.addr_type != NET_ADDR_DHCP) {
//             continue;
//         }

//         net_addr_ntop(AF_INET, &u->ipv4.address.in_addr, buf, sizeof(buf));
//         LOG_INF("IP: %s", buf);

//         net_addr_ntop(AF_INET, &u->netmask, buf, sizeof(buf));
//         LOG_INF("Subnet: %s", buf);

//         net_addr_ntop(AF_INET, &ipv4->gw, buf, sizeof(buf));
//         LOG_INF("Gateway: %s", buf);

//         got_ipv4 = true;
//         net_mgmt_del_event_callback(&ipv4_cb);
//         k_sem_give(&ipv4_address_obtained);
//         break;
//     }
// }

// /* Zephyr 4.x: mgmt_event is uint64_t */
// static void wifi_mgmt_event_handler(struct net_mgmt_event_callback *cb,
//                                      uint64_t mgmt_event,
//                                      struct net_if *iface)
// {
//     if (mgmt_event == NET_EVENT_WIFI_CONNECT_RESULT) {
//         handle_wifi_connect_result(cb);
//     } else if (mgmt_event == NET_EVENT_WIFI_DISCONNECT_RESULT) {
//         handle_wifi_disconnect_result(cb);
//     } else if (mgmt_event == NET_EVENT_IPV4_ADDR_ADD ||
//                mgmt_event == NET_EVENT_IPV4_DHCP_BOUND ||
//                mgmt_event == NET_EVENT_L4_CONNECTED) {
//         handle_ipv4_result(iface);
//     }
// }

// /* -------------------------------------------------------------------------
//  * Public API
//  * ----------------------------------------------------------------------- */

// void wifi_connection_retry_reset(void)
// {
//     net_mgmt_del_event_callback(&ipv4_cb);
//     net_mgmt_del_event_callback(&wifi_cb);
//     net_mgmt_del_event_callback(&l4_cb);

//     wifi_callbacks_init();

//     k_mutex_lock(&wifi_retry_mutex, K_FOREVER);
//     wifi_connection_retry_count = 0;
//     memset(wifi_rety_dots, 0, sizeof(wifi_rety_dots));
//     k_mutex_unlock(&wifi_retry_mutex);
// }

// void wifi_connect(void)
// {
//     struct net_if *iface = net_if_get_default();

//     struct wifi_connect_req_params wifi_params = {0};
//     wifi_params.ssid        = wifi_ssid;
//     wifi_params.ssid_length = strlen(wifi_ssid);
//     wifi_params.psk         = wifi_psk;
//     wifi_params.psk_length  = strlen(wifi_psk);
//     wifi_params.channel     = WIFI_CHANNEL_ANY;
//     wifi_params.security    = WIFI_SECURITY_TYPE_PSK;
//     wifi_params.band        = WIFI_FREQ_BAND_2_4_GHZ;
//     wifi_params.mfp         = WIFI_MFP_OPTIONAL;

//     LOG_INF("Connecting to SSID: %s", wifi_params.ssid);

//     if (net_mgmt(NET_REQUEST_WIFI_CONNECT, iface, &wifi_params,
//                  sizeof(struct wifi_connect_req_params))) {
//         LOG_ERR("WiFi connection request failed");
//     }
// }

// void wifi_callbacks_init(void)
// {
//     got_ipv4 = false;

//     net_mgmt_init_event_callback(&wifi_cb,
//         wifi_mgmt_event_handler,
//         NET_EVENT_WIFI_CONNECT_RESULT | NET_EVENT_WIFI_DISCONNECT_RESULT);
//     net_mgmt_add_event_callback(&wifi_cb);

//     net_mgmt_init_event_callback(&ipv4_cb,
//         wifi_mgmt_event_handler,
//         NET_EVENT_IPV4_ADDR_ADD | NET_EVENT_IPV4_DHCP_BOUND);
//     net_mgmt_add_event_callback(&ipv4_cb);

//     net_mgmt_init_event_callback(&l4_cb,
//         wifi_mgmt_event_handler,
//         NET_EVENT_L4_CONNECTED);
//     net_mgmt_add_event_callback(&l4_cb);
// }

// void wifi_thread(void)
// {
//     LOG_INF("WiFi thread started");

//     wifi_callbacks_init();
//     wifi_connect();

//     k_sem_take(&wifi_connected, K_FOREVER);
//     LOG_INF("WiFi associated");

//     k_sem_take(&ipv4_address_obtained, K_FOREVER);
//     LOG_INF("IP address obtained — WiFi ready");

//     /* Thread exits; main.c proceeds to start azure_mqtt_thread */
// }

/*
 * Copyright (c) 2017 ARM Ltd.
 * Copyright (c) 2016 Intel Corporation.
 *
 * SPDX-License-Identifier: Apache-2.0
 */

#include <zephyr/kernel.h>
#include <zephyr/net/net_if.h>
#include <zephyr/net/wifi_mgmt.h>
#include <zephyr/net/net_event.h>
#include <zephyr/logging/log.h>
#include <wifi.h>
#include <env.h>

char wifi_ssid[MAX_SSID_LEN] = CONFIG_WIFI_DEFAULT_SSID;
char wifi_psk [MAX_PSK_LEN]  = CONFIG_WIFI_DEFAULT_PSK;

K_MUTEX_DEFINE(wifi_retry_mutex);

static uint8_t wifi_connection_retry_count = 0;

static K_SEM_DEFINE(wifi_connected, 0, 1);
static K_SEM_DEFINE(ipv4_address_obtained, 0, 1);

static bool got_ipv4 = false;

static struct net_mgmt_event_callback wifi_cb;
static struct net_mgmt_event_callback ipv4_cb;
static struct net_mgmt_event_callback l4_cb;
static struct net_mgmt_event_callback scan_cb;

/* Cached AP info from scan — used to lock BSSID at connect time */
static struct wifi_scan_result cached_ap = {0};
static bool have_cached_ap = false;

/* Retry thread — runs off event handler context */
// Replace:
// static K_THREAD_STACK_DEFINE(wifi_retry_stack, 2048);
// With:
static Z_KERNEL_STACK_DEFINE_IN(wifi_retry_stack, 2048,
    __attribute__((section(".ext_ram.bss"))));
    
static struct k_thread wifi_retry_thread_data;

LOG_MODULE_REGISTER(wifi_module, LOG_LEVEL_INF);

/* -------------------------------------------------------------------------
 * Scan callback — caches the target AP's current BSSID
 * ----------------------------------------------------------------------- */

static void wifi_scan_result_cb(struct net_mgmt_event_callback *cb,
                                uint64_t mgmt_event,
                                struct net_if *iface)
{
    if (mgmt_event != NET_EVENT_WIFI_SCAN_RESULT) {
        return;
    }

    const struct wifi_scan_result *entry =
        (const struct wifi_scan_result *)cb->info;

    if (strncmp(entry->ssid, wifi_ssid, entry->ssid_length) == 0) {
        memcpy(&cached_ap, entry, sizeof(cached_ap));
        have_cached_ap = true;
    }
}

/* -------------------------------------------------------------------------
 * Event handlers
 * ----------------------------------------------------------------------- */

static void handle_wifi_connect_result(struct net_mgmt_event_callback *cb)
{
    const struct wifi_status *status = (const struct wifi_status *)cb->info;

    if (status->status) {
        LOG_ERR("Connection request failed (%d)", status->status);
    } else {
        LOG_INF("WiFi connected");
        k_sem_give(&wifi_connected);
    }
}

static void wifi_retry_thread_fn(void *a, void *b, void *c);

static void handle_wifi_disconnect_result(struct net_mgmt_event_callback *cb)
{
    const struct wifi_status *status = (const struct wifi_status *)cb->info;

    if (status->status) {
        LOG_ERR("Disconnection request (%d)", status->status);

        /* Spawn retry thread — never call wifi_connect from event handler
         * context as it can deadlock the net mgmt event queue */
        k_thread_create(&wifi_retry_thread_data, wifi_retry_stack,
                        K_THREAD_STACK_SIZEOF(wifi_retry_stack),
                        wifi_retry_thread_fn,
                        NULL, NULL, NULL,
                        K_PRIO_COOP(7), 0, K_NO_WAIT);
    } else {
        LOG_INF("WiFi disconnected");
        k_sem_take(&wifi_connected, K_NO_WAIT);
    }
}

static void handle_ipv4_result(struct net_if *iface)
{
    if (got_ipv4) {
        return;
    }

    struct net_if_config *cfg  = net_if_get_config(iface);
    struct net_if_ipv4   *ipv4 = cfg->ip.ipv4;
    char buf[NET_IPV4_ADDR_LEN];

    for (int i = 0; i < NET_IF_MAX_IPV4_ADDR; i++) {
        const struct net_if_addr_ipv4 *u = &ipv4->unicast[i];

        if (u->ipv4.addr_type != NET_ADDR_DHCP) {
            continue;
        }

        net_addr_ntop(AF_INET, &u->ipv4.address.in_addr, buf, sizeof(buf));
        LOG_INF("IP: %s", buf);

        net_addr_ntop(AF_INET, &u->netmask, buf, sizeof(buf));
        LOG_INF("Subnet: %s", buf);

        net_addr_ntop(AF_INET, &ipv4->gw, buf, sizeof(buf));
        LOG_INF("Gateway: %s", buf);

        got_ipv4 = true;
        net_mgmt_del_event_callback(&ipv4_cb);
        k_sem_give(&ipv4_address_obtained);
        break;
    }
}

/* Zephyr 4.x: mgmt_event is uint64_t */
static void wifi_mgmt_event_handler(struct net_mgmt_event_callback *cb,
                                    uint64_t mgmt_event,
                                    struct net_if *iface)
{
    if (mgmt_event == NET_EVENT_WIFI_CONNECT_RESULT) {
        handle_wifi_connect_result(cb);
    } else if (mgmt_event == NET_EVENT_WIFI_DISCONNECT_RESULT) {
        handle_wifi_disconnect_result(cb);
    } else if (mgmt_event == NET_EVENT_IPV4_ADDR_ADD ||
               mgmt_event == NET_EVENT_IPV4_DHCP_BOUND ||
               mgmt_event == NET_EVENT_L4_CONNECTED) {
        handle_ipv4_result(iface);
    }
}

/* -------------------------------------------------------------------------
 * Scan-then-connect — locks BSSID at last moment to avoid iPhone rotation
 * ----------------------------------------------------------------------- */

void wifi_connect_with_bssid(void)
{
    struct net_if *iface = net_if_get_default();

    /* Register scan callback and trigger scan */
    have_cached_ap = false;
    net_mgmt_init_event_callback(&scan_cb, wifi_scan_result_cb,
                                 NET_EVENT_WIFI_SCAN_RESULT |
                                 NET_EVENT_WIFI_SCAN_DONE);
    net_mgmt_add_event_callback(&scan_cb);

    net_mgmt(NET_REQUEST_WIFI_SCAN, iface, NULL, 0);

    /* Wait up to 5 seconds for scan to find our AP */
    int waited = 0;

    while (!have_cached_ap && waited < 5000) {
        k_msleep(100);
        waited += 100;
    }

    net_mgmt_del_event_callback(&scan_cb);

    struct wifi_connect_req_params wifi_params = {0};

    wifi_params.ssid        = wifi_ssid;
    wifi_params.ssid_length = strlen(wifi_ssid);
    wifi_params.psk         = wifi_psk;
    wifi_params.psk_length  = strlen(wifi_psk);
    wifi_params.security    = WIFI_SECURITY_TYPE_PSK;
    wifi_params.band        = WIFI_FREQ_BAND_2_4_GHZ;
    wifi_params.mfp         = WIFI_MFP_OPTIONAL;

    if (have_cached_ap) {
        wifi_params.channel = cached_ap.channel;
        memcpy(wifi_params.bssid, cached_ap.mac, WIFI_MAC_ADDR_LEN);
        LOG_INF("Connecting to SSID: %s (BSSID locked, ch %d)",
                wifi_params.ssid, wifi_params.channel);
    } else {
        wifi_params.channel = WIFI_CHANNEL_ANY;
        LOG_INF("Connecting to SSID: %s (no BSSID lock — AP not found in scan)",
                wifi_params.ssid);
    }

    if (net_mgmt(NET_REQUEST_WIFI_CONNECT, iface, &wifi_params,
                 sizeof(struct wifi_connect_req_params))) {
        LOG_ERR("WiFi connection request failed");
    }
}

/* -------------------------------------------------------------------------
 * Retry thread — runs off event handler context with exponential backoff
 * ----------------------------------------------------------------------- */

static void wifi_retry_thread_fn(void *a, void *b, void *c)
{
    ARG_UNUSED(a);
    ARG_UNUSED(b);
    ARG_UNUSED(c);

    k_mutex_lock(&wifi_retry_mutex, K_FOREVER);
    uint8_t retry = wifi_connection_retry_count++;
    k_mutex_unlock(&wifi_retry_mutex);

    if (retry >= WIFI_RETRY_COUNT) {
        LOG_ERR("Max retries reached");
        return;
    }

    /* Minimum 3 seconds to let iPhone stabilise BSSID after failed attempt,
     * plus quadratic backoff to avoid hammering the AP */
    uint32_t delay_ms = 3000 + (1000 * retry * retry);

    LOG_INF("Retrying connection (%d) in %d ms", retry + 1, delay_ms);
    k_msleep(delay_ms);

    wifi_connect_with_bssid();
}

/* -------------------------------------------------------------------------
 * Public API
 * ----------------------------------------------------------------------- */

void wifi_connection_retry_reset(void)
{
    net_mgmt_del_event_callback(&ipv4_cb);
    net_mgmt_del_event_callback(&wifi_cb);
    net_mgmt_del_event_callback(&l4_cb);
    net_mgmt_del_event_callback(&scan_cb);

    wifi_callbacks_init();

    k_mutex_lock(&wifi_retry_mutex, K_FOREVER);
    wifi_connection_retry_count = 0;
    k_mutex_unlock(&wifi_retry_mutex);
}

void wifi_callbacks_init(void)
{
    got_ipv4 = false;

    net_mgmt_init_event_callback(&wifi_cb,
        wifi_mgmt_event_handler,
        NET_EVENT_WIFI_CONNECT_RESULT | NET_EVENT_WIFI_DISCONNECT_RESULT);
    net_mgmt_add_event_callback(&wifi_cb);

    net_mgmt_init_event_callback(&ipv4_cb,
        wifi_mgmt_event_handler,
        NET_EVENT_IPV4_ADDR_ADD | NET_EVENT_IPV4_DHCP_BOUND);
    net_mgmt_add_event_callback(&ipv4_cb);

    net_mgmt_init_event_callback(&l4_cb,
        wifi_mgmt_event_handler,
        NET_EVENT_L4_CONNECTED);
    net_mgmt_add_event_callback(&l4_cb);
}

void wifi_thread(void)
{
    LOG_INF("WiFi thread started");

    wifi_callbacks_init();
    wifi_connect_with_bssid();

    k_sem_take(&wifi_connected, K_FOREVER);
    LOG_INF("WiFi associated");

    k_sem_take(&ipv4_address_obtained, K_FOREVER);
    LOG_INF("IP address obtained — WiFi ready");

    /* Thread exits; main.c proceeds to start azure_mqtt_thread */
}
```
