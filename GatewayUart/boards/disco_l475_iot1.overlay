/*
 * Copyright (c) 2024 STMicroelectronics
 *
 * SPDX-License-Identifier: Apache-2.0
 */

/ {
	aliases {
		rtc = &rtc;
	};
};

&i2c2 {
    vl53l0x@29 {
        status = "disabled";  // Disable this specific device
    };
};